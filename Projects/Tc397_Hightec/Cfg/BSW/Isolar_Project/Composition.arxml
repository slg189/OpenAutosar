AUTOSAR XML (schema 4-2-2)
package /Composition
  composition sw component type Composition
    42 x component:
      CPT_BswM: type=BswM
      CPT_EcuM: type=EcuM
      CPT_ComM: type=ComM
      CPT_Det: type=Det
      CPT_ASW_NVM: type=ASW_NVM
      CPT_NvM: type=NvM
      CPT_Dem: type=Dem
      CPT_WdgM: type=WdgM
      CPT_XCP: type=ASW_XCP
      CPT_ASW_COM: type=ASW_COM
      CPT_ASW_NM: type=ASW_NM
      CPT_ASW_CORE1: type=ASW_CORE1
      CPT_ASW_CORE2: type=ASW_CORE2
      CPT_IoHwAb_DIO: type=IoHwAb_DIO
      CPT_SensorActuator_DIO: type=SensorActuator_DIO
      CPT_IoHwAb_ADC: type=IoHwAb_ADC
      CPT_SensorActuator_ADC: type=SensorActuator_ADC
      CPT_SensorActuator_ICU: type=SensorActuator_ICU
      CPT_IoHwAb_PWM: type=IoHwAb_PWM
      CPT_IoHwAb_ICU: type=IoHwAb_ICU
      CPT_SensorActuator_PWM: type=SensorActuator_PWM
      CPT_rba_DiagLib: type=rba_DiagLib
      CPT_CDD_CORE2: type=CDD_CORE2
      CPT_CDD_CORE0: type=CDD_CORE0
      CPT_CDD_CORE1: type=CDD_CORE1
      CPT_ASW_DEM: type=ASW_DEM
      CPT_CDD_CORE3: type=CDD_CORE3
      CPT_ASW_CORE0: type=ASW_CORE0
      CPT_ASW_CORE{3..5}: type=ASW_CORE{3..5}
      CPT_ASW_WDG: type=ASW_WDG
      CPT_CDD_CORE5: type=CDD_CORE5
      CPT_CDD_CORE4: type=CDD_CORE4
      CPT_ASW_ETH: type=ASW_ETH
      CPT_DoIP: type=DoIP
      CPT_Dcm: type=Dcm
      CPT_ASW_DCM: type=ASW_DCM
      CPT_ASW_StbM: type=ASW_StbM
      CPT_StbM: type=StbM
      CPT_SensorActuator_DIO_Test: type=SensorActuator_DIO_Test
      CPT_IoHwAb_DIO_Test: type=IoHwAb_DIO_Test
    connect CPT_ComM.UR_ComMUser_Can_Network_Channel -> CPT_ASW_NM.RP_ComM_UserRequest_CAN0
    connect CPT_ComM.modeLimitation -> CPT_ASW_NM.RPort_EcuModeLimitation
    connect CPT_ASW_NM.PP_BswMArbitration_BswM_MRP_Network -> CPT_BswM.RP_BswMArbitration_BswM_MRP_SWC_Network
    connect CPT_ASW_NM.PP_BswMArbitration_BswM_MRP_NmState -> CPT_BswM.RP_BswMArbitration_BswM_MRP_SWC_Network
    connect CPT_NvM.NvM_NativeBlock_2 -> CPT_ASW_NVM.RPort_ASW_NVM_BlockNative_1024_1
    connect CPT_NvM.NvM_NativeBlock_3 -> CPT_ASW_NVM.RPort_ASW_NVM_BlockNative_1024_2
    connect CPT_IoHwAb_ADC.PPortADC_SAR0_10 -> CPT_SensorActuator_ADC.RPort_ADC_Get_SAR0_10
    connect CPT_IoHwAb_ADC.PPortADC_SAR0_31 -> CPT_SensorActuator_ADC.RPort_ADC_Get_SAR0_31
    connect CPT_IoHwAb_ADC.PPortADC_SAR1_12 -> CPT_SensorActuator_ADC.RPort_ADC_Get_SAR1_12
    connect CPT_IoHwAb_PWM.PPort_PWM_PG_9 -> CPT_SensorActuator_PWM.RPort_PWM_PG_9
    connect CPT_IoHwAb_ICU.PPort_ICU_PZ_1 -> CPT_SensorActuator_ICU.RPort_ICU_PZ_1
    connect CPT_IoHwAb_DIO.PPort_DIO_Get_0 -> CPT_SensorActuator_DIO.RPort_DIO_Get_0
    connect CPT_IoHwAb_DIO.PPort_DIO_Get_1 -> CPT_SensorActuator_DIO.RPort_DIO_Get_1
    connect CPT_IoHwAb_DIO.PPort_DIO_Set_0 -> CPT_SensorActuator_DIO.RPort_DIO_Set_0
    connect CPT_IoHwAb_DIO.PPort_DIO_Set_1 -> CPT_SensorActuator_DIO.RPort_DIO_Set_1
    connect CPT_WdgM.globalMode -> CPT_ASW_WDG.RPort_WdgM_GlobalMode
    connect CPT_WdgM.localSupervision_WdgMSupervisedEntity_Alive_Supervision_Entity1_WdgMCheckpoint_Alive_Supervision_Entity1 -> CPT_ASW_WDG.RPort_Alive_Supervision_Entity1
    connect CPT_WdgM.localSupervision_WdgMSupervisedEntity_Deadline_Supervision_Entity1_WdgMCheckpoint_Deadline_Supervision_Entity1 -> CPT_ASW_WDG.RPort_Deadline_Supervision_Entity1
    connect CPT_WdgM.localSupervision_WdgMSupervisedEntity_Deadline_Supervision_Entity1_WdgMCheckpoint_Deadline_Supervision_Entity2 -> CPT_ASW_WDG.RPort_Deadline_Supervision_Entity2
    connect CPT_CDD_CORE2.PPort_CPUUtilizationCore2 -> CPT_ASW_CORE2.RPort_CPUUtilizationCore2
    connect CPT_CDD_CORE3.PPort_CPUUtilizationCore3 -> CPT_ASW_CORE3.RPort_CPUUtilizationCore3
    connect CPT_CDD_CORE1.PPort_CPUUtilizationCore1 -> CPT_ASW_CORE1.RPort_CPUUtilizationCore1
    connect CPT_CDD_CORE0.PPort_CPUUtilizationCore0 -> CPT_ASW_CORE0.RPort_CPUUtilizationCore0
    connect CPT_CDD_CORE4.PPort_CPUUtilizationCore4 -> CPT_ASW_CORE4.RPort_CPUUtilizationCore4
    connect CPT_CDD_CORE5.PPort_CPUUtilizationCore5 -> CPT_ASW_CORE5.RPort_CPUUtilizationCore5
    connect CPT_ASW_CORE0.PPort_SwcModeRequest -> CPT_BswM.RP_BswMArbitration_BswMSwcModeRequest
    connect CPT_ASW_DCM.P_DataServices_DcmDspData_VIN -> CPT_Dcm.R_DataServices_DcmDspData_VIN
    connect CPT_ASW_DCM.PPort_Routine_CheckMemoryCRC -> CPT_Dcm.RoutineServices_DcmDspRoutine_CheckMemoryCRC
    connect CPT_ASW_DCM.PPort_Routine_DriveVacuumPump -> CPT_Dcm.RoutineServices_DcmDspRoutine_DriveVacuumPump
    connect CPT_ASW_DCM.PPortPrototype_NRC22 -> CPT_Dcm.Rp_ModeDeclarationGroup_NRC22
    connect CPT_ASW_DCM.PPortPrototype_NRC72 -> CPT_Dcm.Rp_ModeDeclarationGroup_NRC72
    connect CPT_Dcm.P_DataServices_DcmDspData_VIN -> CPT_ASW_DCM.R_DataServices_DcmDspData_VIN
    connect CPT_Dcm.DCMServices -> CPT_ASW_DCM.RPort_DCMServices
    connect CPT_ASW_DEM.DataServices_CS_ExtendedDataRecord_Aged_counter -> CPT_Dem.DataServices_CS_ExtendedDataRecord_Aged_counter
    connect CPT_ASW_DEM.DataServices_DemDataElementClass_Day -> CPT_Dem.DataServices_DemDataElementClass_Day
    connect CPT_ASW_DEM.DataServices_DemDataElementClass_Hour -> CPT_Dem.DataServices_DemDataElementClass_Hour
    connect CPT_ASW_DEM.DataServices_DemDataElementClass_Minute -> CPT_Dem.DataServices_DemDataElementClass_Minute
    connect CPT_ASW_DEM.DataServices_DemDataElementClass_Month -> CPT_Dem.DataServices_DemDataElementClass_Month
    connect CPT_ASW_DEM.DataServices_DemDataElementClass_OdometerReading -> CPT_Dem.DataServices_DemDataElementClass_OdometerReading
    connect CPT_ASW_DEM.DataServices_DemDataElementClass_PowerMode -> CPT_Dem.DataServices_DemDataElementClass_PowerMode
    connect CPT_ASW_DEM.DataServices_DemDataElementClass_SupplyVoltage -> CPT_Dem.DataServices_DemDataElementClass_SupplyVoltage
    connect CPT_ASW_DEM.DataServices_DemDataElementClass_Year -> CPT_Dem.DataServices_DemDataElementClass_Year
    connect CPT_Dem.Event_DemEventParameter_0D01_SWC -> CPT_ASW_DEM.Event_DemEventParameter_0D01
    connect CPT_Dem.Event_DemEventParameter_0D02_SWC -> CPT_ASW_DEM.Event_DemEventParameter_0D02
    connect CPT_Dem.Event_DemEventParameter_0D06_Comb0 -> CPT_ASW_DEM.Event_DemEventParameter_0D06_Comb0
    connect CPT_Dem.Event_DemEventParameter_0D06_Comb1 -> CPT_ASW_DEM.Event_DemEventParameter_0D06_Comb1
    connect CPT_ASW_DEM.PPort_CBStatusComp_DemComponent_0D{01..05} -> CPT_Dem.CBStatusComp_DemComponent_0D{01..05}
    connect CPT_ASW_DEM.PPort_CBStatusComp_DemComponent_0D06_Comb0 -> CPT_Dem.CBStatusComp_DemComponent_0D06_Comb0
    connect CPT_ASW_DEM.PPort_CBStatusComp_DemComponent_0D06_Comb1 -> CPT_Dem.CBStatusComp_DemComponent_0D06_Comb1
    connect CPT_Dem.OpCycle_DemOperationCycle_Power -> CPT_ASW_DEM.RPort_OpCycle_DemOperationCycle_Power
    connect CPT_CDD_CORE{0..5}.PPort_GetMaxUserStackUtilization -> CPT_ASW_CORE{0..5}.RPort_GetMaxUserStackUtilization
    connect CPT_ASW_ETH.PPort_DoIPActivationLineSwitchNotification -> CPT_DoIP.DoIPActivationLineSwitchNotification
    connect CPT_ASW_ETH.PPort_CallbackGetPowerMode -> CPT_DoIP.CBGetPowerMode
    connect CPT_ASW_DEM.DataServices_CS_ExtendedDataRecord_Fault_pending_counter -> CPT_Dem.DataServices_CS_ExtendedDataRecord_Fault_pending_counter
    connect CPT_ASW_DCM.P_DataServices_DcmDspData_ECU_NCF_Reference_Number -> CPT_Dcm.R_DataServices_ECU_NCF_Ref_Num
    connect CPT_ASW_DCM.P_DataServices_DcmDspData_ECU_Serial_Number -> CPT_Dcm.R_DataServices_ECU_Serial_Number
    connect CPT_ASW_DCM.P_DataServices_DcmDspData_HaRef -> CPT_Dcm.R_DataServices_ECU_HW_Ref_Num
    connect CPT_ASW_DCM.P_DataServices_DcmDspData_SwRef -> CPT_Dcm.R_DataServices_ECU_SW_Ref_Num
    connect CPT_ASW_DCM.P_DataServices_DcmDspData_SystemFaultRank_Read -> CPT_Dcm.R_DataServices_SystemFaultRank
    connect CPT_ASW_DCM.P_DataServices_DcmDspData_VehicleSpeed_Read -> CPT_Dcm.R_DataServices_VehicleSpeed
    connect CPT_ASW_DCM.PPort_IOControl_EngineTemperature -> CPT_Dcm.DataServices_EngineTemperature
    connect CPT_ASW_DCM.PPort_IOControl_PowerMode -> CPT_Dcm.DataServices_PowerMode
    connect CPT_ASW_DCM.PPort_IOControl_VacuumPumpPressure -> CPT_Dcm.DataServices_VacuumPumpPres
    connect CPT_Dcm.P_DataServices_ECU_Serial_Number -> CPT_ASW_DCM.R_DataServices_DcmDspData_ECU_Serial_Number
    connect CPT_Dcm.P_DataServices_SystemFaultRank -> CPT_ASW_DCM.RPort_DataServices_DcmDspData_SystemFaultRank_Write
    connect CPT_Dcm.P_DataServices_VehicleSpeed -> CPT_ASW_DCM.RPort_DataServices_DcmDspData_VehicleSpeed_Write
    connect CPT_StbM.GlobalTime_Master_StbMSynchronizedTimeBase_Eth -> CPT_ASW_StbM.RP_GlobalTime_Master_StbMSynchronizedTimeBase_Eth
    connect CPT_IoHwAb_DIO_Test.PPort_Dio_SetChannel -> CPT_SensorActuator_DIO_Test.RPort_Dio_Set
package /Composition/PortInterfaceMappingSets
  port interface mapping set PIMSet_Composition
