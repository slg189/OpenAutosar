AUTOSAR XML (schema 4-2-2)
package /Pkg_Interfaces
  client server interface IoHwAb_DIO_Interface
    operation Dio_Read: possible-error=[E_OK, E_NOT_OK]
      arg DioLevel: type=boolean, direction=OUT, server-argument-impl-policy=USE-ARGUMENT-TYPE
    operation Dio_Write: possible-error=[E_OK, E_NOT_OK]
      arg DioLevel: type=boolean, direction=IN, server-argument-impl-policy=USE-ARGUMENT-TYPE
    error E_OK
    error E_NOT_OK
