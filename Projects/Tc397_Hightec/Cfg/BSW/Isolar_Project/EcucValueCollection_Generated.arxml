AUTOSAR XML (schema 4-2-2)
package /EcucValueCollection
  ecuc value collection EcucValueCollection: ecu-extract=EXTR_MCU
    ecuc-values:
      Os
      Rte
      BswM
      EcuM
      Can
      CanTp
      Dem
      Dcm
      WdgM
      Xcp
      Com
      CanSM
      CanNm
      EcuC
      EthIf
      TcpIp
      SoAd
      DoIP
      Platform
      Bfx
      Wdg
      MemIf
      Nm
      NvM
      Fee
      ComM
      WdgIf
      CanIf
      Det
      PduR
      Crc
      Eth
      rba_ArxmlGen
      rba_MemLib
      EthSM
      ComStack
      rba_ArxmlGen
      StbM
      EthTSyn
      Mfl
