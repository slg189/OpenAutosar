AUTOSAR XML (schema 4-2-2)
package /MCU_FlatView
  flat map MCU_FlatMap
    134 x flat instance descriptor:
      AppMode: upstream-reference=RootSwCompositionPrototype.CPT_ASW_CORE0.PPort_SwcModeRequest.AppMode, ecu-extract-reference=CPT_MCU_FlatView.CPT_ASW_CORE0.PPort_SwcModeRequest.AppMode
      CPT_ASW_COM: upstream-reference=RootSwCompositionPrototype.CPT_ASW_COM, ecu-extract-reference=CPT_MCU_FlatView.CPT_ASW_COM
      CPT_ASW_CORE{0..5}: upstream-reference=RootSwCompositionPrototype.CPT_ASW_CORE{0..5}, ecu-extract-reference=CPT_MCU_FlatView.CPT_ASW_CORE{0..5}
      CPT_ASW_DCM: upstream-reference=RootSwCompositionPrototype.CPT_ASW_DCM, ecu-extract-reference=CPT_MCU_FlatView.CPT_ASW_DCM
      CPT_ASW_DEM: upstream-reference=RootSwCompositionPrototype.CPT_ASW_DEM, ecu-extract-reference=CPT_MCU_FlatView.CPT_ASW_DEM
      CPT_ASW_ETH: upstream-reference=RootSwCompositionPrototype.CPT_ASW_ETH, ecu-extract-reference=CPT_MCU_FlatView.CPT_ASW_ETH
      CPT_ASW_NM: upstream-reference=RootSwCompositionPrototype.CPT_ASW_NM, ecu-extract-reference=CPT_MCU_FlatView.CPT_ASW_NM
      CPT_ASW_NVM: upstream-reference=RootSwCompositionPrototype.CPT_ASW_NVM, ecu-extract-reference=CPT_MCU_FlatView.CPT_ASW_NVM
      CPT_ASW_StbM: upstream-reference=RootSwCompositionPrototype.CPT_ASW_StbM, ecu-extract-reference=CPT_MCU_FlatView.CPT_ASW_StbM
      CPT_ASW_WDG: upstream-reference=RootSwCompositionPrototype.CPT_ASW_WDG, ecu-extract-reference=CPT_MCU_FlatView.CPT_ASW_WDG
      CPT_BswM: upstream-reference=RootSwCompositionPrototype.CPT_BswM, ecu-extract-reference=CPT_MCU_FlatView.CPT_BswM
      CPT_CDD_CORE{0..5}: upstream-reference=RootSwCompositionPrototype.CPT_CDD_CORE{0..5}, ecu-extract-reference=CPT_MCU_FlatView.CPT_CDD_CORE{0..5}
      CPT_ComM: upstream-reference=RootSwCompositionPrototype.CPT_ComM, ecu-extract-reference=CPT_MCU_FlatView.CPT_ComM
      CPT_Dcm: upstream-reference=RootSwCompositionPrototype.CPT_Dcm, ecu-extract-reference=CPT_MCU_FlatView.CPT_Dcm
      CPT_Dem: upstream-reference=RootSwCompositionPrototype.CPT_Dem, ecu-extract-reference=CPT_MCU_FlatView.CPT_Dem
      CPT_Det: upstream-reference=RootSwCompositionPrototype.CPT_Det, ecu-extract-reference=CPT_MCU_FlatView.CPT_Det
      CPT_DoIP: upstream-reference=RootSwCompositionPrototype.CPT_DoIP, ecu-extract-reference=CPT_MCU_FlatView.CPT_DoIP
      CPT_EcuM: upstream-reference=RootSwCompositionPrototype.CPT_EcuM, ecu-extract-reference=CPT_MCU_FlatView.CPT_EcuM
      CPT_IoHwAb_ADC: upstream-reference=RootSwCompositionPrototype.CPT_IoHwAb_ADC, ecu-extract-reference=CPT_MCU_FlatView.CPT_IoHwAb_ADC
      CPT_IoHwAb_DIO: upstream-reference=RootSwCompositionPrototype.CPT_IoHwAb_DIO, ecu-extract-reference=CPT_MCU_FlatView.CPT_IoHwAb_DIO
      CPT_IoHwAb_DIO_Test: upstream-reference=RootSwCompositionPrototype.CPT_IoHwAb_DIO_Test, ecu-extract-reference=CPT_MCU_FlatView.CPT_IoHwAb_DIO_Test
      CPT_IoHwAb_ICU: upstream-reference=RootSwCompositionPrototype.CPT_IoHwAb_ICU, ecu-extract-reference=CPT_MCU_FlatView.CPT_IoHwAb_ICU
      CPT_IoHwAb_PWM: upstream-reference=RootSwCompositionPrototype.CPT_IoHwAb_PWM, ecu-extract-reference=CPT_MCU_FlatView.CPT_IoHwAb_PWM
      CPT_NvM: upstream-reference=RootSwCompositionPrototype.CPT_NvM, ecu-extract-reference=CPT_MCU_FlatView.CPT_NvM
      CPT_SensorActuator_ADC: upstream-reference=RootSwCompositionPrototype.CPT_SensorActuator_ADC, ecu-extract-reference=CPT_MCU_FlatView.CPT_SensorActuator_ADC
      CPT_SensorActuator_DIO: upstream-reference=RootSwCompositionPrototype.CPT_SensorActuator_DIO, ecu-extract-reference=CPT_MCU_FlatView.CPT_SensorActuator_DIO
      CPT_SensorActuator_DIO_Test: upstream-reference=RootSwCompositionPrototype.CPT_SensorActuator_DIO_Test, ecu-extract-reference=CPT_MCU_FlatView.CPT_SensorActuator_DIO_Test
      CPT_SensorActuator_ICU: upstream-reference=RootSwCompositionPrototype.CPT_SensorActuator_ICU, ecu-extract-reference=CPT_MCU_FlatView.CPT_SensorActuator_ICU
      CPT_SensorActuator_PWM: upstream-reference=RootSwCompositionPrototype.CPT_SensorActuator_PWM, ecu-extract-reference=CPT_MCU_FlatView.CPT_SensorActuator_PWM
      CPT_StbM: upstream-reference=RootSwCompositionPrototype.CPT_StbM, ecu-extract-reference=CPT_MCU_FlatView.CPT_StbM
      CPT_WdgM: upstream-reference=RootSwCompositionPrototype.CPT_WdgM, ecu-extract-reference=CPT_MCU_FlatView.CPT_WdgM
      CPT_XCP: upstream-reference=RootSwCompositionPrototype.CPT_XCP, ecu-extract-reference=CPT_MCU_FlatView.CPT_XCP
      CPT_rba_DiagLib: upstream-reference=RootSwCompositionPrototype.CPT_rba_DiagLib, ecu-extract-reference=CPT_MCU_FlatView.CPT_rba_DiagLib
      Data: sw-refresh-timing={cse-code=4, cse-code-factor=1}, upstream-reference=RootSwCompositionPrototype.CPT_ASW_DCM.P_DataServices_DcmDspData_ECU_NCF_Reference_Number.Data, ecu-extract-reference=CPT_MCU_FlatView.CPT_ASW_DCM.P_DataServices_DcmDspData_ECU_NCF_Reference_Number.Data
      Data_0: sw-refresh-timing={cse-code=4, cse-code-factor=1}, upstream-reference=RootSwCompositionPrototype.CPT_ASW_DCM.P_DataServices_DcmDspData_ECU_Serial_Number.Data, ecu-extract-reference=CPT_MCU_FlatView.CPT_ASW_DCM.P_DataServices_DcmDspData_ECU_Serial_Number.Data
      Data_1: sw-refresh-timing={cse-code=4, cse-code-factor=1}, upstream-reference=RootSwCompositionPrototype.CPT_ASW_DCM.P_DataServices_DcmDspData_HaRef.Data, ecu-extract-reference=CPT_MCU_FlatView.CPT_ASW_DCM.P_DataServices_DcmDspData_HaRef.Data
      Data_2: sw-refresh-timing={cse-code=4, cse-code-factor=1}, upstream-reference=RootSwCompositionPrototype.CPT_ASW_DCM.P_DataServices_DcmDspData_SwRef.Data, ecu-extract-reference=CPT_MCU_FlatView.CPT_ASW_DCM.P_DataServices_DcmDspData_SwRef.Data
      Data_3: sw-refresh-timing={cse-code=4, cse-code-factor=1}, upstream-reference=RootSwCompositionPrototype.CPT_ASW_DCM.P_DataServices_DcmDspData_SystemFaultRank_Read.Data, ecu-extract-reference=CPT_MCU_FlatView.CPT_ASW_DCM.P_DataServices_DcmDspData_SystemFaultRank_Read.Data
      Data_4: sw-refresh-timing={cse-code=4, cse-code-factor=1}, upstream-reference=RootSwCompositionPrototype.CPT_ASW_DCM.P_DataServices_DcmDspData_VIN.Data, ecu-extract-reference=CPT_MCU_FlatView.CPT_ASW_DCM.P_DataServices_DcmDspData_VIN.Data
      Data_5: sw-refresh-timing={cse-code=4, cse-code-factor=1}, upstream-reference=RootSwCompositionPrototype.CPT_ASW_DCM.P_DataServices_DcmDspData_VehicleSpeed_Read.Data, ecu-extract-reference=CPT_MCU_FlatView.CPT_ASW_DCM.P_DataServices_DcmDspData_VehicleSpeed_Read.Data
      Data_6: upstream-reference=RootSwCompositionPrototype.CPT_Dcm.P_DataServices_DcmDspData_VIN.Data, ecu-extract-reference=CPT_MCU_FlatView.CPT_Dcm.P_DataServices_DcmDspData_VIN.Data
      Data_7: upstream-reference=RootSwCompositionPrototype.CPT_Dcm.P_DataServices_ECU_Serial_Number.Data, ecu-extract-reference=CPT_MCU_FlatView.CPT_Dcm.P_DataServices_ECU_Serial_Number.Data
      Data_8: upstream-reference=RootSwCompositionPrototype.CPT_Dcm.P_DataServices_SystemFaultRank.Data, ecu-extract-reference=CPT_MCU_FlatView.CPT_Dcm.P_DataServices_SystemFaultRank.Data
      Data_9: upstream-reference=RootSwCompositionPrototype.CPT_Dcm.P_DataServices_VehicleSpeed.Data, ecu-extract-reference=CPT_MCU_FlatView.CPT_Dcm.P_DataServices_VehicleSpeed.Data
      HCU01_ActiveDischarge: sw-refresh-timing={cse-code=4, cse-code-factor=1}, upstream-reference=RootSwCompositionPrototype.CPT_ASW_COM.RPort_HCU01_ActiveDischarge.HCU01_ActiveDischarge, ecu-extract-reference=CPT_MCU_FlatView.CPT_ASW_COM.RPort_HCU01_ActiveDischarge.HCU01_ActiveDischarge
      HCU01_CheckSum: sw-refresh-timing={cse-code=4, cse-code-factor=1}, upstream-reference=RootSwCompositionPrototype.CPT_ASW_COM.RPort_HCU01_CheckSum.HCU01_CheckSum, ecu-extract-reference=CPT_MCU_FlatView.CPT_ASW_COM.RPort_HCU01_CheckSum.HCU01_CheckSum
      HCU01_Counter: sw-refresh-timing={cse-code=4, cse-code-factor=1}, upstream-reference=RootSwCompositionPrototype.CPT_ASW_COM.RPort_HCU01_Counter.HCU01_Counter, ecu-extract-reference=CPT_MCU_FlatView.CPT_ASW_COM.RPort_HCU01_Counter.HCU01_Counter
      HCU01_EmergShutDown: sw-refresh-timing={cse-code=4, cse-code-factor=1}, upstream-reference=RootSwCompositionPrototype.CPT_ASW_COM.RPort_HCU01_EmergShutDown.HCU01_EmergShutDown, ecu-extract-reference=CPT_MCU_FlatView.CPT_ASW_COM.RPort_HCU01_EmergShutDown.HCU01_EmergShutDown
      HCU01_EnaMCU: sw-refresh-timing={cse-code=4, cse-code-factor=1}, upstream-reference=RootSwCompositionPrototype.CPT_ASW_COM.RPort_HCU01_EnaMCU.HCU01_EnaMCU, ecu-extract-reference=CPT_MCU_FlatView.CPT_ASW_COM.RPort_HCU01_EnaMCU.HCU01_EnaMCU
      HCU01_McuModeCmd: sw-refresh-timing={cse-code=4, cse-code-factor=1}, upstream-reference=RootSwCompositionPrototype.CPT_ASW_COM.RPort_HCU01_McuModeCmd.HCU01_McuModeCmd, ecu-extract-reference=CPT_MCU_FlatView.CPT_ASW_COM.RPort_HCU01_McuModeCmd.HCU01_McuModeCmd
      HCU01_Shift: sw-refresh-timing={cse-code=4, cse-code-factor=1}, upstream-reference=RootSwCompositionPrototype.CPT_ASW_COM.RPort_HCU01_Shift.HCU01_Shift, ecu-extract-reference=CPT_MCU_FlatView.CPT_ASW_COM.RPort_HCU01_Shift.HCU01_Shift
      HCU01_SpeedCmd: sw-refresh-timing={cse-code=4, cse-code-factor=1}, upstream-reference=RootSwCompositionPrototype.CPT_ASW_COM.RPort_HCU01_SpeedCmd.HCU01_SpeedCmd, ecu-extract-reference=CPT_MCU_FlatView.CPT_ASW_COM.RPort_HCU01_SpeedCmd.HCU01_SpeedCmd
      HCU01_TqCmd: sw-refresh-timing={cse-code=4, cse-code-factor=1}, upstream-reference=RootSwCompositionPrototype.CPT_ASW_COM.RPort_HCU01_TqCmd.HCU01_TqCmd, ecu-extract-reference=CPT_MCU_FlatView.CPT_ASW_COM.RPort_HCU01_TqCmd.HCU01_TqCmd
      HCU02_Poweroff: sw-refresh-timing={cse-code=4, cse-code-factor=1}, upstream-reference=RootSwCompositionPrototype.CPT_ASW_COM.RPort_HCU02_Poweroff.HCU02_Poweroff, ecu-extract-reference=CPT_MCU_FlatView.CPT_ASW_COM.RPort_HCU02_Poweroff.HCU02_Poweroff
      MCU01_ActDischStatus: sw-refresh-timing={cse-code=4, cse-code-factor=1}, upstream-reference=RootSwCompositionPrototype.CPT_ASW_COM.PPort_MCU01_ActDischStatus.MCU01_ActDischStatus, ecu-extract-reference=CPT_MCU_FlatView.CPT_ASW_COM.PPort_MCU01_ActDischStatus.MCU01_ActDischStatus
      MCU01_CheckSum: sw-refresh-timing={cse-code=4, cse-code-factor=1}, upstream-reference=RootSwCompositionPrototype.CPT_ASW_COM.PPort_MCU01_CheckSum.MCU01_CheckSum, ecu-extract-reference=CPT_MCU_FlatView.CPT_ASW_COM.PPort_MCU01_CheckSum.MCU01_CheckSum
      MCU01_Counter: sw-refresh-timing={cse-code=4, cse-code-factor=1}, upstream-reference=RootSwCompositionPrototype.CPT_ASW_COM.PPort_MCU01_Counter.MCU01_Counter, ecu-extract-reference=CPT_MCU_FlatView.CPT_ASW_COM.PPort_MCU01_Counter.MCU01_Counter
      MCU01_CurCntTor: sw-refresh-timing={cse-code=4, cse-code-factor=1}, upstream-reference=RootSwCompositionPrototype.CPT_ASW_COM.PPort_MCU01_CurCntTor.MCU01_CurCntTor, ecu-extract-reference=CPT_MCU_FlatView.CPT_ASW_COM.PPort_MCU01_CurCntTor.MCU01_CurCntTor
      MCU01_EmergShutDown: sw-refresh-timing={cse-code=4, cse-code-factor=1}, upstream-reference=RootSwCompositionPrototype.CPT_ASW_COM.PPort_MCU01_EmergShutDown.MCU01_EmergShutDown, ecu-extract-reference=CPT_MCU_FlatView.CPT_ASW_COM.PPort_MCU01_EmergShutDown.MCU01_EmergShutDown
      MCU01_HighVolAllowed: sw-refresh-timing={cse-code=4, cse-code-factor=1}, upstream-reference=RootSwCompositionPrototype.CPT_ASW_COM.PPort_MCU01_HighVolAllowed.MCU01_HighVolAllowed, ecu-extract-reference=CPT_MCU_FlatView.CPT_ASW_COM.PPort_MCU01_HighVolAllowed.MCU01_HighVolAllowed
      MCU01_Motorspd: sw-refresh-timing={cse-code=4, cse-code-factor=1}, upstream-reference=RootSwCompositionPrototype.CPT_ASW_COM.PPort_MCU01_Motorspd.MCU01_Motorspd, ecu-extract-reference=CPT_MCU_FlatView.CPT_ASW_COM.PPort_MCU01_Motorspd.MCU01_Motorspd
      MCU01_Ready: sw-refresh-timing={cse-code=4, cse-code-factor=1}, upstream-reference=RootSwCompositionPrototype.CPT_ASW_COM.PPort_MCU01_Ready.MCU01_Ready, ecu-extract-reference=CPT_MCU_FlatView.CPT_ASW_COM.PPort_MCU01_Ready.MCU01_Ready
      MCU01_SelfCheck: sw-refresh-timing={cse-code=4, cse-code-factor=1}, upstream-reference=RootSwCompositionPrototype.CPT_ASW_COM.PPort_MCU01_SelfCheck.MCU01_SelfCheck, ecu-extract-reference=CPT_MCU_FlatView.CPT_ASW_COM.PPort_MCU01_SelfCheck.MCU01_SelfCheck
      MCU01_ShutDownAllowed: sw-refresh-timing={cse-code=4, cse-code-factor=1}, upstream-reference=RootSwCompositionPrototype.CPT_ASW_COM.PPort_MCU01_ShutDownAllowed.MCU01_ShutDownAllowed, ecu-extract-reference=CPT_MCU_FlatView.CPT_ASW_COM.PPort_MCU01_ShutDownAllowed.MCU01_ShutDownAllowed
      MCU01_Status: sw-refresh-timing={cse-code=4, cse-code-factor=1}, upstream-reference=RootSwCompositionPrototype.CPT_ASW_COM.PPort_MCU01_Status.MCU01_Status, ecu-extract-reference=CPT_MCU_FlatView.CPT_ASW_COM.PPort_MCU01_Status.MCU01_Status
      MCU02_IGBTTmp: sw-refresh-timing={cse-code=4, cse-code-factor=1}, upstream-reference=RootSwCompositionPrototype.CPT_ASW_COM.PPort_MCU02_IGBTTmp.MCU02_IGBTTmp, ecu-extract-reference=CPT_MCU_FlatView.CPT_ASW_COM.PPort_MCU02_IGBTTmp.MCU02_IGBTTmp
      MCU02_Idc: sw-refresh-timing={cse-code=4, cse-code-factor=1}, upstream-reference=RootSwCompositionPrototype.CPT_ASW_COM.PPort_MCU02_Idc.MCU02_Idc, ecu-extract-reference=CPT_MCU_FlatView.CPT_ASW_COM.PPort_MCU02_Idc.MCU02_Idc
      MCU02_MaxTor: sw-refresh-timing={cse-code=4, cse-code-factor=1}, upstream-reference=RootSwCompositionPrototype.CPT_ASW_COM.PPort_MCU02_MaxTor.MCU02_MaxTor, ecu-extract-reference=CPT_MCU_FlatView.CPT_ASW_COM.PPort_MCU02_MaxTor.MCU02_MaxTor
      MCU02_MinTor: sw-refresh-timing={cse-code=4, cse-code-factor=1}, upstream-reference=RootSwCompositionPrototype.CPT_ASW_COM.PPort_MCU02_MinTor.MCU02_MinTor, ecu-extract-reference=CPT_MCU_FlatView.CPT_ASW_COM.PPort_MCU02_MinTor.MCU02_MinTor
      MCU02_MotorTmp: sw-refresh-timing={cse-code=4, cse-code-factor=1}, upstream-reference=RootSwCompositionPrototype.CPT_ASW_COM.PPort_MCU02_MotorTmp.MCU02_MotorTmp, ecu-extract-reference=CPT_MCU_FlatView.CPT_ASW_COM.PPort_MCU02_MotorTmp.MCU02_MotorTmp
      MCU02_Vdc: sw-refresh-timing={cse-code=4, cse-code-factor=1}, upstream-reference=RootSwCompositionPrototype.CPT_ASW_COM.PPort_MCU02_Vdc.MCU02_Vdc, ecu-extract-reference=CPT_MCU_FlatView.CPT_ASW_COM.PPort_MCU02_Vdc.MCU02_Vdc
      MCU03_12VSupply: sw-refresh-timing={cse-code=4, cse-code-factor=1}, upstream-reference=RootSwCompositionPrototype.CPT_ASW_COM.PPort_MCU03_12VSupply.MCU03_12VSupply, ecu-extract-reference=CPT_MCU_FlatView.CPT_ASW_COM.PPort_MCU03_12VSupply.MCU03_12VSupply
      MCU03_LI_OverSpeed: sw-refresh-timing={cse-code=4, cse-code-factor=1}, upstream-reference=RootSwCompositionPrototype.CPT_ASW_COM.PPort_MCU03_LI_OverSpeed.MCU03_LI_OverSpeed, ecu-extract-reference=CPT_MCU_FlatView.CPT_ASW_COM.PPort_MCU03_LI_OverSpeed.MCU03_LI_OverSpeed
      MCU03_LI_OverTempEM: sw-refresh-timing={cse-code=4, cse-code-factor=1}, upstream-reference=RootSwCompositionPrototype.CPT_ASW_COM.PPort_MCU03_LI_OverTempEM.MCU03_LI_OverTempEM, ecu-extract-reference=CPT_MCU_FlatView.CPT_ASW_COM.PPort_MCU03_LI_OverTempEM.MCU03_LI_OverTempEM
      MCU03_LI_OverTempINV: sw-refresh-timing={cse-code=4, cse-code-factor=1}, upstream-reference=RootSwCompositionPrototype.CPT_ASW_COM.PPort_MCU03_LI_OverTempINV.MCU03_LI_OverTempINV, ecu-extract-reference=CPT_MCU_FlatView.CPT_ASW_COM.PPort_MCU03_LI_OverTempINV.MCU03_LI_OverTempINV
      MCU03_LI_UdcOver: sw-refresh-timing={cse-code=4, cse-code-factor=1}, upstream-reference=RootSwCompositionPrototype.CPT_ASW_COM.PPort_MCU03_LI_UdcOver.MCU03_LI_UdcOver, ecu-extract-reference=CPT_MCU_FlatView.CPT_ASW_COM.PPort_MCU03_LI_UdcOver.MCU03_LI_UdcOver
      MCU03_LI_UdcUnder: sw-refresh-timing={cse-code=4, cse-code-factor=1}, upstream-reference=RootSwCompositionPrototype.CPT_ASW_COM.PPort_MCU03_LI_UdcUnder.MCU03_LI_UdcUnder, ecu-extract-reference=CPT_MCU_FlatView.CPT_ASW_COM.PPort_MCU03_LI_UdcUnder.MCU03_LI_UdcUnder
      MCU03_NRF_5VSupply: sw-refresh-timing={cse-code=4, cse-code-factor=1}, upstream-reference=RootSwCompositionPrototype.CPT_ASW_COM.PPort_MCU03_NRF_5VSupply.MCU03_NRF_5VSupply, ecu-extract-reference=CPT_MCU_FlatView.CPT_ASW_COM.PPort_MCU03_NRF_5VSupply.MCU03_NRF_5VSupply
      MCU03_NRF_COMError: sw-refresh-timing={cse-code=4, cse-code-factor=1}, upstream-reference=RootSwCompositionPrototype.CPT_ASW_COM.PPort_MCU03_NRF_COMError.MCU03_NRF_COMError, ecu-extract-reference=CPT_MCU_FlatView.CPT_ASW_COM.PPort_MCU03_NRF_COMError.MCU03_NRF_COMError
      MCU03_NRF_DESAT: sw-refresh-timing={cse-code=4, cse-code-factor=1}, upstream-reference=RootSwCompositionPrototype.CPT_ASW_COM.PPort_MCU03_NRF_DESAT.MCU03_NRF_DESAT, ecu-extract-reference=CPT_MCU_FlatView.CPT_ASW_COM.PPort_MCU03_NRF_DESAT.MCU03_NRF_DESAT
      MCU03_NRF_EMTempSamp: sw-refresh-timing={cse-code=4, cse-code-factor=1}, upstream-reference=RootSwCompositionPrototype.CPT_ASW_COM.PPort_MCU03_NRF_EMTempSamp.MCU03_NRF_EMTempSamp, ecu-extract-reference=CPT_MCU_FlatView.CPT_ASW_COM.PPort_MCU03_NRF_EMTempSamp.MCU03_NRF_EMTempSamp
      MCU03_NRF_IdcSamp: sw-refresh-timing={cse-code=4, cse-code-factor=1}, upstream-reference=RootSwCompositionPrototype.CPT_ASW_COM.PPort_MCU03_NRF_IdcSamp.MCU03_NRF_IdcSamp, ecu-extract-reference=CPT_MCU_FlatView.CPT_ASW_COM.PPort_MCU03_NRF_IdcSamp.MCU03_NRF_IdcSamp
      MCU03_NRF_InvTempSamp: sw-refresh-timing={cse-code=4, cse-code-factor=1}, upstream-reference=RootSwCompositionPrototype.CPT_ASW_COM.PPort_MCU03_NRF_InvTempSamp.MCU03_NRF_InvTempSamp, ecu-extract-reference=CPT_MCU_FlatView.CPT_ASW_COM.PPort_MCU03_NRF_InvTempSamp.MCU03_NRF_InvTempSamp
      MCU03_NRF_PhASamp: sw-refresh-timing={cse-code=4, cse-code-factor=1}, upstream-reference=RootSwCompositionPrototype.CPT_ASW_COM.PPort_MCU03_NRF_PhASamp.MCU03_NRF_PhASamp, ecu-extract-reference=CPT_MCU_FlatView.CPT_ASW_COM.PPort_MCU03_NRF_PhASamp.MCU03_NRF_PhASamp
      MCU03_NRF_PhBSamp: sw-refresh-timing={cse-code=4, cse-code-factor=1}, upstream-reference=RootSwCompositionPrototype.CPT_ASW_COM.PPort_MCU03_NRF_PhBSamp.MCU03_NRF_PhBSamp, ecu-extract-reference=CPT_MCU_FlatView.CPT_ASW_COM.PPort_MCU03_NRF_PhBSamp.MCU03_NRF_PhBSamp
      MCU03_NRF_PhCSamp: sw-refresh-timing={cse-code=4, cse-code-factor=1}, upstream-reference=RootSwCompositionPrototype.CPT_ASW_COM.PPort_MCU03_NRF_PhCSamp.MCU03_NRF_PhCSamp, ecu-extract-reference=CPT_MCU_FlatView.CPT_ASW_COM.PPort_MCU03_NRF_PhCSamp.MCU03_NRF_PhCSamp
      MCU03_NRF_Resolver: sw-refresh-timing={cse-code=4, cse-code-factor=1}, upstream-reference=RootSwCompositionPrototype.CPT_ASW_COM.PPort_MCU03_NRF_Resolver.MCU03_NRF_Resolver, ecu-extract-reference=CPT_MCU_FlatView.CPT_ASW_COM.PPort_MCU03_NRF_Resolver.MCU03_NRF_Resolver
      MCU03_NRF_SysFailure: sw-refresh-timing={cse-code=4, cse-code-factor=1}, upstream-reference=RootSwCompositionPrototype.CPT_ASW_COM.PPort_MCU03_NRF_SysFailure.MCU03_NRF_SysFailure, ecu-extract-reference=CPT_MCU_FlatView.CPT_ASW_COM.PPort_MCU03_NRF_SysFailure.MCU03_NRF_SysFailure
      MCU03_NRF_UdcSamp: sw-refresh-timing={cse-code=4, cse-code-factor=1}, upstream-reference=RootSwCompositionPrototype.CPT_ASW_COM.PPort_MCU03_NRF_UdcSamp.MCU03_NRF_UdcSamp, ecu-extract-reference=CPT_MCU_FlatView.CPT_ASW_COM.PPort_MCU03_NRF_UdcSamp.MCU03_NRF_UdcSamp
      MCU03_RF_BusOff: sw-refresh-timing={cse-code=4, cse-code-factor=1}, upstream-reference=RootSwCompositionPrototype.CPT_ASW_COM.PPort_MCU03_RF_BusOff.MCU03_RF_BusOff, ecu-extract-reference=CPT_MCU_FlatView.CPT_ASW_COM.PPort_MCU03_RF_BusOff.MCU03_RF_BusOff
      MCU03_RF_HWOverCur: sw-refresh-timing={cse-code=4, cse-code-factor=1}, upstream-reference=RootSwCompositionPrototype.CPT_ASW_COM.PPort_MCU03_RF_HWOverCur.MCU03_RF_HWOverCur, ecu-extract-reference=CPT_MCU_FlatView.CPT_ASW_COM.PPort_MCU03_RF_HWOverCur.MCU03_RF_HWOverCur
      MCU03_RF_IdcOver: sw-refresh-timing={cse-code=4, cse-code-factor=1}, upstream-reference=RootSwCompositionPrototype.CPT_ASW_COM.PPort_MCU03_RF_IdcOver.MCU03_RF_IdcOver, ecu-extract-reference=CPT_MCU_FlatView.CPT_ASW_COM.PPort_MCU03_RF_IdcOver.MCU03_RF_IdcOver
      MCU03_RF_IntError: sw-refresh-timing={cse-code=4, cse-code-factor=1}, upstream-reference=RootSwCompositionPrototype.CPT_ASW_COM.PPort_MCU03_RF_IntError.MCU03_RF_IntError, ecu-extract-reference=CPT_MCU_FlatView.CPT_ASW_COM.PPort_MCU03_RF_IntError.MCU03_RF_IntError
      MCU03_RF_MsgTO: sw-refresh-timing={cse-code=4, cse-code-factor=1}, upstream-reference=RootSwCompositionPrototype.CPT_ASW_COM.PPort_MCU03_RF_MsgTO.MCU03_RF_MsgTO, ecu-extract-reference=CPT_MCU_FlatView.CPT_ASW_COM.PPort_MCU03_RF_MsgTO.MCU03_RF_MsgTO
      MCU03_RF_OverSpeed: sw-refresh-timing={cse-code=4, cse-code-factor=1}, upstream-reference=RootSwCompositionPrototype.CPT_ASW_COM.PPort_MCU03_RF_OverSpeed.MCU03_RF_OverSpeed, ecu-extract-reference=CPT_MCU_FlatView.CPT_ASW_COM.PPort_MCU03_RF_OverSpeed.MCU03_RF_OverSpeed
      MCU03_RF_OverTempEM: sw-refresh-timing={cse-code=4, cse-code-factor=1}, upstream-reference=RootSwCompositionPrototype.CPT_ASW_COM.PPort_MCU03_RF_OverTempEM.MCU03_RF_OverTempEM, ecu-extract-reference=CPT_MCU_FlatView.CPT_ASW_COM.PPort_MCU03_RF_OverTempEM.MCU03_RF_OverTempEM
      MCU03_RF_OverTempINV: sw-refresh-timing={cse-code=4, cse-code-factor=1}, upstream-reference=RootSwCompositionPrototype.CPT_ASW_COM.PPort_MCU03_RF_OverTempINV.MCU03_RF_OverTempINV, ecu-extract-reference=CPT_MCU_FlatView.CPT_ASW_COM.PPort_MCU03_RF_OverTempINV.MCU03_RF_OverTempINV
      MCU03_RF_PhAOver: sw-refresh-timing={cse-code=4, cse-code-factor=1}, upstream-reference=RootSwCompositionPrototype.CPT_ASW_COM.PPort_MCU03_RF_PhAOver.MCU03_RF_PhAOver, ecu-extract-reference=CPT_MCU_FlatView.CPT_ASW_COM.PPort_MCU03_RF_PhAOver.MCU03_RF_PhAOver
      MCU03_RF_PhBOver: sw-refresh-timing={cse-code=4, cse-code-factor=1}, upstream-reference=RootSwCompositionPrototype.CPT_ASW_COM.PPort_MCU03_RF_PhBOver.MCU03_RF_PhBOver, ecu-extract-reference=CPT_MCU_FlatView.CPT_ASW_COM.PPort_MCU03_RF_PhBOver.MCU03_RF_PhBOver
      MCU03_RF_PhCOver: sw-refresh-timing={cse-code=4, cse-code-factor=1}, upstream-reference=RootSwCompositionPrototype.CPT_ASW_COM.PPort_MCU03_RF_PhCOver.MCU03_RF_PhCOver, ecu-extract-reference=CPT_MCU_FlatView.CPT_ASW_COM.PPort_MCU03_RF_PhCOver.MCU03_RF_PhCOver
      MCU03_RF_PhaseImp: sw-refresh-timing={cse-code=4, cse-code-factor=1}, upstream-reference=RootSwCompositionPrototype.CPT_ASW_COM.PPort_MCU03_RF_PhaseImp.MCU03_RF_PhaseImp, ecu-extract-reference=CPT_MCU_FlatView.CPT_ASW_COM.PPort_MCU03_RF_PhaseImp.MCU03_RF_PhaseImp
      MCU03_RF_ToqError: sw-refresh-timing={cse-code=4, cse-code-factor=1}, upstream-reference=RootSwCompositionPrototype.CPT_ASW_COM.PPort_MCU03_RF_ToqError.MCU03_RF_ToqError, ecu-extract-reference=CPT_MCU_FlatView.CPT_ASW_COM.PPort_MCU03_RF_ToqError.MCU03_RF_ToqError
      MCU03_RF_UDCUnder: sw-refresh-timing={cse-code=4, cse-code-factor=1}, upstream-reference=RootSwCompositionPrototype.CPT_ASW_COM.PPort_MCU03_RF_UDCUnder.MCU03_RF_UDCUnder, ecu-extract-reference=CPT_MCU_FlatView.CPT_ASW_COM.PPort_MCU03_RF_UDCUnder.MCU03_RF_UDCUnder
      MCU03_RF_UdcOver: sw-refresh-timing={cse-code=4, cse-code-factor=1}, upstream-reference=RootSwCompositionPrototype.CPT_ASW_COM.PPort_MCU03_RF_UdcOver.MCU03_RF_UdcOver, ecu-extract-reference=CPT_MCU_FlatView.CPT_ASW_COM.PPort_MCU03_RF_UdcOver.MCU03_RF_UdcOver
      MDGP_DcmCommunicationControl_ComMChannel_Can_Network_Channel: role=CURRENT_MODE, upstream-reference=RootSwCompositionPrototype.CPT_Dcm.Pp_DcmCommunicationControl_ComMChannel_Can_Network_Channel.MDGP_DcmCommunicationControl_ComMChannel_Can_Network_Channel, ecu-extract-reference=CPT_MCU_FlatView.CPT_Dcm.Pp_DcmCommunicationControl_ComMChannel_Can_Network_Channel.MDGP_DcmCommunicationControl_ComMChannel_Can_Network_Channel
      MDGP_DcmCommunicationControl_Eth_Network_Channel_EthernetCluster: role=CURRENT_MODE, upstream-reference=RootSwCompositionPrototype.CPT_Dcm.Pp_DcmCommunicationControl_Eth_Network_Channel_EthernetCluster.MDGP_DcmCommunicationControl_Eth_Network_Channel_EthernetCluster, ecu-extract-reference=CPT_MCU_FlatView.CPT_Dcm.Pp_DcmCommunicationControl_Eth_Network_Channel_EthernetCluster.MDGP_DcmCommunicationControl_Eth_Network_Channel_EthernetCluster
      MDGP_DcmControlDTCSetting: role=CURRENT_MODE, upstream-reference=RootSwCompositionPrototype.CPT_Dcm.Pp_DcmControlDTCSetting.MDGP_DcmControlDTCSetting, ecu-extract-reference=CPT_MCU_FlatView.CPT_Dcm.Pp_DcmControlDTCSetting.MDGP_DcmControlDTCSetting
      MDGP_DcmDiagnosticSessionControl: role=CURRENT_MODE, upstream-reference=RootSwCompositionPrototype.CPT_Dcm.Pp_DcmDiagnosticSessionControl.MDGP_DcmDiagnosticSessionControl, ecu-extract-reference=CPT_MCU_FlatView.CPT_Dcm.Pp_DcmDiagnosticSessionControl.MDGP_DcmDiagnosticSessionControl
      MDGP_DcmEcuReset: role=CURRENT_MODE, upstream-reference=RootSwCompositionPrototype.CPT_Dcm.Pp_DcmEcuReset.MDGP_DcmEcuReset, ecu-extract-reference=CPT_MCU_FlatView.CPT_Dcm.Pp_DcmEcuReset.MDGP_DcmEcuReset
      MDGP_ModeDeclarationGroup_NRC22: role=CURRENT_MODE, upstream-reference=RootSwCompositionPrototype.CPT_ASW_DCM.PPortPrototype_NRC22.MDGP_ModeDeclarationGroup_NRC22, ecu-extract-reference=CPT_MCU_FlatView.CPT_ASW_DCM.PPortPrototype_NRC22.MDGP_ModeDeclarationGroup_NRC22
      MDGP_ModeDeclarationGroup_NRC72: role=CURRENT_MODE, upstream-reference=RootSwCompositionPrototype.CPT_ASW_DCM.PPortPrototype_NRC72.MDGP_ModeDeclarationGroup_NRC72, ecu-extract-reference=CPT_MCU_FlatView.CPT_ASW_DCM.PPortPrototype_NRC72.MDGP_ModeDeclarationGroup_NRC72
      PPort_SystemSignal_TCP_TX: sw-refresh-timing={cse-code=4, cse-code-factor=1}, upstream-reference=RootSwCompositionPrototype.CPT_ASW_ETH.PPort_SystemSignal_TCP_TX.PPort_SystemSignal_TCP_TX, ecu-extract-reference=CPT_MCU_FlatView.CPT_ASW_ETH.PPort_SystemSignal_TCP_TX.PPort_SystemSignal_TCP_TX
      PPort_SystemSignal_UDP_TX: sw-refresh-timing={cse-code=4, cse-code-factor=1}, upstream-reference=RootSwCompositionPrototype.CPT_ASW_ETH.PPort_SystemSignal_UDP_TX.PPort_SystemSignal_UDP_TX, ecu-extract-reference=CPT_MCU_FlatView.CPT_ASW_ETH.PPort_SystemSignal_UDP_TX.PPort_SystemSignal_UDP_TX
      RPort_SystemSignal_TCP_RX: sw-refresh-timing={cse-code=4, cse-code-factor=1}, upstream-reference=RootSwCompositionPrototype.CPT_ASW_ETH.RPort_SystemSignal_TCP_RX.RPort_SystemSignal_TCP_RX, ecu-extract-reference=CPT_MCU_FlatView.CPT_ASW_ETH.RPort_SystemSignal_TCP_RX.RPort_SystemSignal_TCP_RX
      RPort_SystemSignal_UDP_RX: sw-refresh-timing={cse-code=4, cse-code-factor=1}, upstream-reference=RootSwCompositionPrototype.CPT_ASW_ETH.RPort_SystemSignal_UDP_RX.RPort_SystemSignal_UDP_RX, ecu-extract-reference=CPT_MCU_FlatView.CPT_ASW_ETH.RPort_SystemSignal_UDP_RX.RPort_SystemSignal_UDP_RX
      Unconnected_eventNotification: upstream-reference=RootSwCompositionPrototype.CPT_StbM.GlobalTime_StatusEvent_StbMSynchronizedTimeBase_Eth.eventNotification, ecu-extract-reference=CPT_MCU_FlatView.CPT_StbM.GlobalTime_StatusEvent_StbMSynchronizedTimeBase_Eth.eventNotification
      currentDoIPActivationLineStatus: role=CURRENT_MODE, upstream-reference=RootSwCompositionPrototype.CPT_ASW_ETH.PPort_DoIPActivationLineSwitchNotification.currentDoIPActivationLineStatus, ecu-extract-reference=CPT_MCU_FlatView.CPT_ASW_ETH.PPort_DoIPActivationLineSwitchNotification.currentDoIPActivationLineStatus
      currentMode: role=CURRENT_MODE, upstream-reference=RootSwCompositionPrototype.CPT_ComM.UM_ComMUser_Can_Network_Channel.currentMode, ecu-extract-reference=CPT_MCU_FlatView.CPT_ComM.UM_ComMUser_Can_Network_Channel.currentMode
      currentMode_0: role=CURRENT_MODE, upstream-reference=RootSwCompositionPrototype.CPT_ComM.UM_ComMUser_Can_Network_XCP_Channel.currentMode, ecu-extract-reference=CPT_MCU_FlatView.CPT_ComM.UM_ComMUser_Can_Network_XCP_Channel.currentMode
      currentMode_1: role=CURRENT_MODE, upstream-reference=RootSwCompositionPrototype.CPT_ComM.UM_ComMUser_Eth_Network_Channel.currentMode, ecu-extract-reference=CPT_MCU_FlatView.CPT_ComM.UM_ComMUser_Eth_Network_Channel.currentMode
      currentMode_2: role=CURRENT_MODE, upstream-reference=RootSwCompositionPrototype.CPT_WdgM.globalMode.currentMode, ecu-extract-reference=CPT_MCU_FlatView.CPT_WdgM.globalMode.currentMode
      currentMode_3: role=CURRENT_MODE, upstream-reference=RootSwCompositionPrototype.CPT_WdgM.mode_WdgMSupervisedEntity_Alive_Supervision_Entity1.currentMode, ecu-extract-reference=CPT_MCU_FlatView.CPT_WdgM.mode_WdgMSupervisedEntity_Alive_Supervision_Entity1.currentMode
      currentMode_4: role=CURRENT_MODE, upstream-reference=RootSwCompositionPrototype.CPT_WdgM.mode_WdgMSupervisedEntity_Deadline_Supervision_Entity1.currentMode, ecu-extract-reference=CPT_MCU_FlatView.CPT_WdgM.mode_WdgMSupervisedEntity_Deadline_Supervision_Entity1.currentMode
      uint8: sw-refresh-timing={cse-code=1000, cse-code-factor=1}, upstream-reference=RootSwCompositionPrototype.CPT_BswM.RP_BswMArbitration_BswM_MRP_SWC_Network.uint8, ecu-extract-reference=CPT_MCU_FlatView.CPT_BswM.RP_BswMArbitration_BswM_MRP_SWC_Network.uint8
