AUTOSAR XML (schema 4-2-2)
package /System_EcuExtract
  system EXTR_MCU: category=ECU_EXTRACT, ecu-extract-version=1.0.0, system-version=1.0.0
    system mapping SYSMPG_MCU
      data-mappings:
        data-element=CPT_MCU_FlatView.PPort_MCU01_ActDischStatus.MCU01_ActDischStatus, system-signal=MCU01_ActDischStatus
        data-element=CPT_MCU_FlatView.PPort_MCU01_CheckSum.MCU01_CheckSum, system-signal=MCU01_CheckSum
        data-element=CPT_MCU_FlatView.PPort_MCU01_Counter.MCU01_Counter, system-signal=MCU01_Counter
        data-element=CPT_MCU_FlatView.PPort_MCU01_CurCntTor.MCU01_CurCntTor, system-signal=MCU01_CurCntTor
        data-element=CPT_MCU_FlatView.PPort_MCU01_EmergShutDown.MCU01_EmergShutDown, system-signal=MCU01_EmergShutDown
        data-element=CPT_MCU_FlatView.PPort_MCU01_HighVolAllowed.MCU01_HighVolAllowed, system-signal=MCU01_HighVolAllowed
        data-element=CPT_MCU_FlatView.PPort_MCU01_Motorspd.MCU01_Motorspd, system-signal=MCU01_Motorspd
        data-element=CPT_MCU_FlatView.PPort_MCU01_Ready.MCU01_Ready, system-signal=MCU01_Ready
        data-element=CPT_MCU_FlatView.PPort_MCU01_SelfCheck.MCU01_SelfCheck, system-signal=MCU01_SelfCheck
        data-element=CPT_MCU_FlatView.PPort_MCU01_ShutDownAllowed.MCU01_ShutDownAllowed, system-signal=MCU01_ShutDownAllowed
        data-element=CPT_MCU_FlatView.PPort_MCU01_Status.MCU01_Status, system-signal=MCU01_Status
        data-element=CPT_MCU_FlatView.PPort_MCU02_IGBTTmp.MCU02_IGBTTmp, system-signal=MCU02_IGBTTmp
        data-element=CPT_MCU_FlatView.PPort_MCU02_Idc.MCU02_Idc, system-signal=MCU02_Idc
        data-element=CPT_MCU_FlatView.PPort_MCU02_MaxTor.MCU02_MaxTor, system-signal=MCU02_MaxTor
        data-element=CPT_MCU_FlatView.PPort_MCU02_MinTor.MCU02_MinTor, system-signal=MCU02_MinTor
        data-element=CPT_MCU_FlatView.PPort_MCU02_MotorTmp.MCU02_MotorTmp, system-signal=MCU02_MotorTmp
        data-element=CPT_MCU_FlatView.PPort_MCU02_Vdc.MCU02_Vdc, system-signal=MCU02_Vdc
        data-element=CPT_MCU_FlatView.PPort_MCU03_12VSupply.MCU03_12VSupply, system-signal=MCU03_12VSupply
        data-element=CPT_MCU_FlatView.PPort_MCU03_LI_OverSpeed.MCU03_LI_OverSpeed, system-signal=MCU03_LI_OverSpeed
        data-element=CPT_MCU_FlatView.PPort_MCU03_LI_OverTempEM.MCU03_LI_OverTempEM, system-signal=MCU03_LI_OverTempEM
        data-element=CPT_MCU_FlatView.PPort_MCU03_LI_OverTempINV.MCU03_LI_OverTempINV, system-signal=MCU03_LI_OverTempINV
        data-element=CPT_MCU_FlatView.PPort_MCU03_LI_UdcOver.MCU03_LI_UdcOver, system-signal=MCU03_LI_UdcOver
        data-element=CPT_MCU_FlatView.PPort_MCU03_LI_UdcUnder.MCU03_LI_UdcUnder, system-signal=MCU03_LI_UdcUnder
        data-element=CPT_MCU_FlatView.PPort_MCU03_NRF_5VSupply.MCU03_NRF_5VSupply, system-signal=MCU03_NRF_5VSupply
        data-element=CPT_MCU_FlatView.PPort_MCU03_NRF_COMError.MCU03_NRF_COMError, system-signal=MCU03_NRF_COMError
        data-element=CPT_MCU_FlatView.PPort_MCU03_NRF_DESAT.MCU03_NRF_DESAT, system-signal=MCU03_NRF_DESAT
        data-element=CPT_MCU_FlatView.PPort_MCU03_NRF_EMTempSamp.MCU03_NRF_EMTempSamp, system-signal=MCU03_NRF_EMTempSamp
        data-element=CPT_MCU_FlatView.PPort_MCU03_NRF_IdcSamp.MCU03_NRF_IdcSamp, system-signal=MCU03_NRF_IdcSamp
        data-element=CPT_MCU_FlatView.PPort_MCU03_NRF_InvTempSamp.MCU03_NRF_InvTempSamp, system-signal=MCU03_NRF_InvTempSamp
        data-element=CPT_MCU_FlatView.PPort_MCU03_NRF_PhASamp.MCU03_NRF_PhASamp, system-signal=MCU03_NRF_PhASamp
        data-element=CPT_MCU_FlatView.PPort_MCU03_NRF_PhBSamp.MCU03_NRF_PhBSamp, system-signal=MCU03_NRF_PhBSamp
        data-element=CPT_MCU_FlatView.PPort_MCU03_NRF_PhCSamp.MCU03_NRF_PhCSamp, system-signal=MCU03_NRF_PhCSamp
        data-element=CPT_MCU_FlatView.PPort_MCU03_NRF_Resolver.MCU03_NRF_Resolver, system-signal=MCU03_NRF_Resolver
        data-element=CPT_MCU_FlatView.PPort_MCU03_NRF_SysFailure.MCU03_NRF_SysFailure, system-signal=MCU03_NRF_SysFailure
        data-element=CPT_MCU_FlatView.PPort_MCU03_NRF_UdcSamp.MCU03_NRF_UdcSamp, system-signal=MCU03_NRF_UdcSamp
        data-element=CPT_MCU_FlatView.PPort_MCU03_RF_BusOff.MCU03_RF_BusOff, system-signal=MCU03_RF_BusOff
        data-element=CPT_MCU_FlatView.PPort_MCU03_RF_HWOverCur.MCU03_RF_HWOverCur, system-signal=MCU03_RF_HWOverCur
        data-element=CPT_MCU_FlatView.PPort_MCU03_RF_IdcOver.MCU03_RF_IdcOver, system-signal=MCU03_RF_IdcOver
        data-element=CPT_MCU_FlatView.PPort_MCU03_RF_IntError.MCU03_RF_IntError, system-signal=MCU03_RF_IntError
        data-element=CPT_MCU_FlatView.PPort_MCU03_RF_MsgTO.MCU03_RF_MsgTO, system-signal=MCU03_RF_MsgTO
        data-element=CPT_MCU_FlatView.PPort_MCU03_RF_OverSpeed.MCU03_RF_OverSpeed, system-signal=MCU03_RF_OverSpeed
        data-element=CPT_MCU_FlatView.PPort_MCU03_RF_OverTempEM.MCU03_RF_OverTempEM, system-signal=MCU03_RF_OverTempEM
        data-element=CPT_MCU_FlatView.PPort_MCU03_RF_OverTempINV.MCU03_RF_OverTempINV, system-signal=MCU03_RF_OverTempINV
        data-element=CPT_MCU_FlatView.PPort_MCU03_RF_PhAOver.MCU03_RF_PhAOver, system-signal=MCU03_RF_PhAOver
        data-element=CPT_MCU_FlatView.PPort_MCU03_RF_PhBOver.MCU03_RF_PhBOver, system-signal=MCU03_RF_PhBOver
        data-element=CPT_MCU_FlatView.PPort_MCU03_RF_PhCOver.MCU03_RF_PhCOver, system-signal=MCU03_RF_PhCOver
        data-element=CPT_MCU_FlatView.PPort_MCU03_RF_PhaseImp.MCU03_RF_PhaseImp, system-signal=MCU03_RF_PhaseImp
        data-element=CPT_MCU_FlatView.PPort_MCU03_RF_ToqError.MCU03_RF_ToqError, system-signal=MCU03_RF_ToqError
        data-element=CPT_MCU_FlatView.PPort_MCU03_RF_UDCUnder.MCU03_RF_UDCUnder, system-signal=MCU03_RF_UDCUnder
        data-element=CPT_MCU_FlatView.PPort_MCU03_RF_UdcOver.MCU03_RF_UdcOver, system-signal=MCU03_RF_UdcOver
        data-element=CPT_MCU_FlatView.RPort_HCU01_ActiveDischarge.HCU01_ActiveDischarge, system-signal=HCU01_ActiveDischarge
        data-element=CPT_MCU_FlatView.RPort_HCU01_CheckSum.HCU01_CheckSum, system-signal=HCU01_CheckSum
        data-element=CPT_MCU_FlatView.RPort_HCU01_Counter.HCU01_Counter, system-signal=HCU01_Counter
        data-element=CPT_MCU_FlatView.RPort_HCU01_EmergShutDown.HCU01_EmergShutDown, system-signal=HCU01_EmergShutDown
        data-element=CPT_MCU_FlatView.RPort_HCU01_EnaMCU.HCU01_EnaMCU, system-signal=HCU01_EnaMCU
        data-element=CPT_MCU_FlatView.RPort_HCU01_McuModeCmd.HCU01_McuModeCmd, system-signal=HCU01_McuModeCmd
        data-element=CPT_MCU_FlatView.RPort_HCU01_Shift.HCU01_Shift, system-signal=HCU01_Shift
        data-element=CPT_MCU_FlatView.RPort_HCU01_SpeedCmd.HCU01_SpeedCmd, system-signal=HCU01_SpeedCmd
        data-element=CPT_MCU_FlatView.RPort_HCU01_TqCmd.HCU01_TqCmd, system-signal=HCU01_TqCmd
        data-element=CPT_MCU_FlatView.RPort_HCU02_Poweroff.HCU02_Poweroff, system-signal=HCU02_Poweroff
        data-element=CPT_MCU_FlatView.PPort_SystemSignal_TCP_TX.PPort_SystemSignal_TCP_TX, system-signal=SystemSignal_TCP_TX
        data-element=CPT_MCU_FlatView.PPort_SystemSignal_UDP_TX.PPort_SystemSignal_UDP_TX, system-signal=SystemSignal_UDP_TX
        data-element=CPT_MCU_FlatView.RPort_SystemSignal_TCP_RX.RPort_SystemSignal_TCP_RX, system-signal=SystemSignal_TCP_RX
        data-element=CPT_MCU_FlatView.RPort_SystemSignal_UDP_RX.RPort_SystemSignal_UDP_RX, system-signal=SystemSignal_UDP_RX
      sw-mappings:
        swc to ecu mapping SwcToEcuMapping_0: ecu-instance=MCU
          component:
            CPT_MCU_FlatView.CPT_ASW_COM
            CPT_MCU_FlatView.CPT_ASW_CORE{0..5}
            CPT_MCU_FlatView.CPT_ASW_DCM
            CPT_MCU_FlatView.CPT_ASW_DEM
            CPT_MCU_FlatView.CPT_ASW_ETH
            CPT_MCU_FlatView.CPT_ASW_NM
            CPT_MCU_FlatView.CPT_ASW_NVM
            CPT_MCU_FlatView.CPT_ASW_StbM
            CPT_MCU_FlatView.CPT_ASW_WDG
            CPT_MCU_FlatView.CPT_BswM
            CPT_MCU_FlatView.CPT_CDD_CORE{0..5}
            CPT_MCU_FlatView.CPT_ComM
            CPT_MCU_FlatView.CPT_Dcm
            CPT_MCU_FlatView.CPT_Dem
            CPT_MCU_FlatView.CPT_Det
            CPT_MCU_FlatView.CPT_DoIP
            CPT_MCU_FlatView.CPT_EcuM
            CPT_MCU_FlatView.CPT_IoHwAb_ADC
            CPT_MCU_FlatView.CPT_IoHwAb_DIO
            CPT_MCU_FlatView.CPT_IoHwAb_DIO_Test
            CPT_MCU_FlatView.CPT_IoHwAb_ICU
            CPT_MCU_FlatView.CPT_IoHwAb_PWM
            CPT_MCU_FlatView.CPT_NvM
            CPT_MCU_FlatView.CPT_SensorActuator_ADC
            CPT_MCU_FlatView.CPT_SensorActuator_DIO
            CPT_MCU_FlatView.CPT_SensorActuator_DIO_Test
            CPT_MCU_FlatView.CPT_SensorActuator_ICU
            CPT_MCU_FlatView.CPT_SensorActuator_PWM
            CPT_MCU_FlatView.CPT_StbM
            CPT_MCU_FlatView.CPT_WdgM
            CPT_MCU_FlatView.CPT_XCP
            CPT_MCU_FlatView.CPT_rba_DiagLib
    root-software-compositions:
      root sw composition prototype CPT_MCU_FlatView: flat-map=MCU_FlatMap, software-composition=MCU_FlatView
