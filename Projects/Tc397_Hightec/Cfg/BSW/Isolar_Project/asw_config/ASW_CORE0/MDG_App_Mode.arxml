AUTOSAR XML (schema 4-2-2)
package /MDG_App_Mode
  mode declaration group MDG_App_Mode: category=EXPLICIT_ORDER, initial-mode=NONE
    7 x mode:
      NONE: value=0
      SWC_REQUEST_SHUTDOWN: value=16
      ECUM_WAKEUP: value=17
      ECUM_NOWAKEUP: value=18
      LIN_SCHEDULE_TABLE_0_RUN: value=20
      LIN_SCHEDULE_TABLE_1_RUN: value=21
      LIN_SCHEDULE_TABLE_2_RUN: value=22
package /ModeRequestInterface
  sender receiver interface ModeRequestInterface
    data AppMode: type=Enum_AppMode
package /ModeRequestInterface/ARPackage_0
  sender receiver interface SR_ComM_Mode_If
    data ComM_Mode: type=ComM_ModeType
package /Enum_AppMode
  app type Enum_AppMode: category=VALUE, sw-calibration-access=READ-WRITE, compu {16=SWC_REQUEST_SHUTDOWN (CompuScale), 17=ECUM_WAKEUP (CompuScale_0), 18=ECUM_NOWAKEUP (CompuScale_1), 20=LIN_SCHEDULE_TABLE_0_RUN (CompuScale_2), 21=LIN_SCHEDULE_TABLE_1_RUN (CompuScale_3), 22=LIN_SCHEDULE_TABLE_2_RUN (CompuScale_4)}
package /AppMode_Mapping
  data type mapping set AppMode_Mapping: data-type-map{application-data-type=Enum_AppMode, implementation-data-type=uint8}, mode-request-type-map{implementation-data-type=uint8, mode-group=MDG_App_Mode}
