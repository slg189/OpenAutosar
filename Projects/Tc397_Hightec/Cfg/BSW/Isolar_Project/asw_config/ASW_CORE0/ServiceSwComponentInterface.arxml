AUTOSAR XML (schema 4-2-2)
package /ServiceSwComponentInterface
  4 x client server interface, all with is-service=true:
    CPU_Utilization
      operation CPU_Utilization
        arg Duration_u32: type=uint32, direction=IN
        arg CPU_PercentUtilization: type=float64, direction=OUT
        arg Status: type=uint8, direction=OUT
      error E_OK: error-code=0
      error ON_PROGRESS: error-code=63
      error E_NOT_OK: error-code=1
    GetMaxStack
      operation GetMaxStack
        arg ID: type=uint8, direction=IN
        arg SP: type=uint16, direction=OUT, server-argument-impl-policy=USE-ARGUMENT-TYPE
        arg CTX: type=uint16, direction=OUT, server-argument-impl-policy=USE-ARGUMENT-TYPE
      error E_OK: error-code=0
      error E_NOT_OK: error-code=1
    GetMaxUserStackUtilization
      operation GetMaxUserStackUtilization: possible-error=[GetMaxUserStackUtilization/E_OK, GetMaxUserStackUtilization/E_NOT_OK]
        arg MaxUserStackUtilization: type=float64, direction=OUT, server-argument-impl-policy=USE-ARGUMENT-TYPE
      error E_OK: error-code=0
      error E_NOT_OK: error-code=1
    Core_ClientServer_Interface
      operation Core_ClientServer
        arg CoreStatus: type=uint16, direction=OUT
        arg Data2Core: type=uint16, direction=IN
        arg DataOfCore: type=uint16, direction=OUT
