AUTOSAR XML (schema 4-2-2)
package /IoHwAb_ADC_Interface
  client server interface IoHwAb_ADC_Interface
    operation IoHwAb_ADC_Get
      arg RawVoltage: type=uint16, direction=OUT
