AUTOSAR XML (schema 4-2-2)
package /IoHwAb_ICU_Interface
  client server interface IoHwAb_ICU_Interface
    operation IoHwAb_ICU_Get
      arg Duty: type=uint16, direction=OUT
