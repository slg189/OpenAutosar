AUTOSAR XML (schema 4-2-2)
package /IoHwAb_IO_Interface
  client server interface IoHwAb_IO_Interface
    operation IoHwAb_IO_Get
      arg dio_status: type=boolean, direction=OUT
    operation IoHwAb_IO_Set
      arg dio_status: type=boolean, direction=IN
