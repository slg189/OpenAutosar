AUTOSAR XML (schema 4-2-2)
package /IoHwAb_PWM_Interface
  client server interface IoHwAb_PWM_Interface
    operation IoHwAb_PWM_Set
      arg pwm_duty: type=uint16, direction=IN
