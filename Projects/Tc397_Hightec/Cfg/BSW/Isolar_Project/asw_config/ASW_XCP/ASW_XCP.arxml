AUTOSAR XML (schema 4-2-2)
package /XCP_SWC
  application sw component type ASW_XCP
    behavior SwcInternalBehavior_XCP
      constant-memorys:
        parameter data prototype Entry_Const_Var: type=uint8
      static-memorys:
        data Entry_Static_Var: type=uint8
      timing event TimingEvent_0: start-on-event=RE_XCP_SWC, period=0.1
      runnable RE_XCP_SWC: symbol=RE_XCP_SWC_func
