AUTOSAR XML (schema 4-2-2)
package /ETAS_Project/EcucModuleConfigurationValuess
  module config CanIf: implementation-config-variant=VARIANT-PRE-COMPILE
    CanIfInitCfg: CanIfInitCfgSet=0
      CanIfInitHohCfg
        5 x CanIfHrhCfg, all with CanIfHrhCanCtrlIdRef=Can_Network_CANNODE_0:
          Can_Network_CANNODE_0_Rx_Std_MailBox_{1..5}: CanIfHrhIdSymRef=Can_Network_CANNODE_0_Rx_Std_MailBox_{1..5}
        5 x CanIfHthCfg, all with CanIfHthCanCtrlIdRef=Can_Network_CANNODE_0:
          Can_Network_CANNODE_0_Tx_Std_MailBox_{1..5}: CanIfHthIdSymRef=Can_Network_CANNODE_0_Tx_Std_MailBox_{1..5}
        Can_Network_CANNODE_1_Rx_Std_MailBox_2 (CanIfHrhCfg): CanIfHrhIdSymRef=Can_Network_CANNODE_1_Rx_Std_MailBox_2, CanIfHrhCanCtrlIdRef=Can_Network_CANNODE_1
        Can_Network_CANNODE_1_Rx_Std_MailBox_1 (CanIfHrhCfg): CanIfHrhIdSymRef=Can_Network_CANNODE_1_Rx_Std_MailBox_1, CanIfHrhCanCtrlIdRef=Can_Network_CANNODE_1
        4 x CanIfHthCfg, all with CanIfHthCanCtrlIdRef=Can_Network_CANNODE_1:
          Can_Network_CANNODE_1_Tx_Std_MailBox_4: CanIfHthIdSymRef=Can_Network_CANNODE_1_Tx_Std_MailBox_4
          Can_Network_CANNODE_1_Tx_Std_MailBox_3: CanIfHthIdSymRef=Can_Network_CANNODE_1_Tx_Std_MailBox_3
          Can_Network_CANNODE_1_Tx_Std_MailBox_2: CanIfHthIdSymRef=Can_Network_CANNODE_1_Tx_Std_MailBox_2
          Can_Network_CANNODE_1_Tx_Std_MailBox_1: CanIfHthIdSymRef=Can_Network_CANNODE_1_Tx_Std_MailBox_1
      5 x CanIfRxPduCfg, all with CanIfRxPduReadData=false, CanIfRxPduReadNotifyStatus=true, CanIfRxPduCanIdType=STANDARD_CAN:
        HCU_01_Can_Network_CANNODE_0: CanIfRxPduCanId=129, CanIfRxPduDlc=8, CanIfRxPduUserRxIndicationName=PduR_CanIfRxIndication, CanIfRxPduUserRxIndicationUL=PDUR, CanIfRxPduHrhIdRef=Can_Network_CANNODE_0_Rx_Std_MailBox_1, CanIfRxPduRef=HCU_01_Can_Network_CANNODE_0_CanIf2PduR
        Diag_Functional_request_Can_Network_CANNODE_0: CanIfRxPduCanId=2015, CanIfRxPduDlc=1, CanIfRxPduUserRxIndicationUL=CAN_TP, CanIfRxPduHrhIdRef=Can_Network_CANNODE_0_Rx_Std_MailBox_2, CanIfRxPduRef=Diag_Functional_request_Can_Network_CANNODE_0_CanIf2CanTp
        HCU_02_Can_Network_CANNODE_0: CanIfRxPduCanId=609, CanIfRxPduDlc=1, CanIfRxPduUserRxIndicationName=PduR_CanIfRxIndication, CanIfRxPduUserRxIndicationUL=PDUR, CanIfRxPduHrhIdRef=Can_Network_CANNODE_0_Rx_Std_MailBox_3, CanIfRxPduRef=HCU_02_Can_Network_CANNODE_0_CanIf2PduR
        NM_VCU_Rx_ETAS_Can_Network_CANNODE_0: CanIfRxPduDlc=8, CanIfRxPduUserRxIndicationUL=CAN_NM, CanIfRxPduHrhIdRef=Can_Network_CANNODE_0_Rx_Std_MailBox_4, CanIfRxPduRef=NM_VCU_Rx_ETAS_Can_Network_CANNODE_0_CanIf2CanNm
        Diag_Physical_request_Can_Network_CANNODE_0: CanIfRxPduCanId=1856, CanIfRxPduDlc=1, CanIfRxPduUserRxIndicationUL=CAN_TP, CanIfRxPduHrhIdRef=Can_Network_CANNODE_0_Rx_Std_MailBox_5, CanIfRxPduRef=Diag_Physical_request_Can_Network_CANNODE_0_CanIf2CanTp
      Buffer_Can_Network_CANNODE_0_Tx_Std_MailBox_1 (CanIfBufferCfg): CanIfBufferSize=0, CanIfBufferHthRef=Can_Network_CANNODE_0_Tx_Std_MailBox_1
      MCU_03_Can_Network_CANNODE_0 (CanIfTxPduCfg):
        CanIfTxPduReadNotifyStatus = false
        CanIfTxPduType = STATIC
        CanIfTxPduTruncation = true
        CanIfTxPduCanIdType = STANDARD_CAN
        CanIfTxPduCanId = 262
        CanIfTxPduUserTxConfirmationUL = PDUR
        CanIfTxPduBufferRef = Buffer_Can_Network_CANNODE_0_Tx_Std_MailBox_1
        CanIfTxPduRef = MCU_03_Can_Network_CANNODE_0_PduR2CanIf
      Buffer_Can_Network_CANNODE_0_Tx_Std_MailBox_2 (CanIfBufferCfg): CanIfBufferSize=0, CanIfBufferHthRef=Can_Network_CANNODE_0_Tx_Std_MailBox_2
      MCU_01_Can_Network_CANNODE_0 (CanIfTxPduCfg):
        CanIfTxPduReadNotifyStatus = false
        CanIfTxPduType = STATIC
        CanIfTxPduTruncation = true
        CanIfTxPduCanIdType = STANDARD_CAN
        CanIfTxPduCanId = 85
        CanIfTxPduUserTxConfirmationUL = PDUR
        CanIfTxPduBufferRef = Buffer_Can_Network_CANNODE_0_Tx_Std_MailBox_2
        CanIfTxPduRef = MCU_01_Can_Network_CANNODE_0_PduR2CanIf
      Buffer_Can_Network_CANNODE_0_Tx_Std_MailBox_3 (CanIfBufferCfg): CanIfBufferSize=0, CanIfBufferHthRef=Can_Network_CANNODE_0_Tx_Std_MailBox_3
      NM_VCU_Can_Network_CANNODE_0 (CanIfTxPduCfg):
        CanIfTxPduReadNotifyStatus = false
        CanIfTxPduType = STATIC
        CanIfTxPduTruncation = true
        CanIfTxPduCanIdType = STANDARD_CAN
        CanIfTxPduCanId = 1655
        CanIfTxPduUserTxConfirmationUL = CAN_NM
        CanIfTxPduBufferRef = Buffer_Can_Network_CANNODE_0_Tx_Std_MailBox_3
        CanIfTxPduRef = NM_VCU_Can_Network_CANNODE_0_CanNm2CanIf
      Buffer_Can_Network_CANNODE_0_Tx_Std_MailBox_4 (CanIfBufferCfg): CanIfBufferSize=0, CanIfBufferHthRef=Can_Network_CANNODE_0_Tx_Std_MailBox_4
      MCU_02_Can_Network_CANNODE_0 (CanIfTxPduCfg):
        CanIfTxPduReadNotifyStatus = false
        CanIfTxPduType = STATIC
        CanIfTxPduTruncation = true
        CanIfTxPduCanIdType = STANDARD_CAN
        CanIfTxPduCanId = 151
        CanIfTxPduUserTxConfirmationUL = PDUR
        CanIfTxPduBufferRef = Buffer_Can_Network_CANNODE_0_Tx_Std_MailBox_4
        CanIfTxPduRef = MCU_02_Can_Network_CANNODE_0_PduR2CanIf
      Buffer_Can_Network_CANNODE_0_Tx_Std_MailBox_5 (CanIfBufferCfg): CanIfBufferSize=0, CanIfBufferHthRef=Can_Network_CANNODE_0_Tx_Std_MailBox_5
      Diag_Physical_response_Can_Network_CANNODE_0 (CanIfTxPduCfg):
        CanIfTxPduReadNotifyStatus = false
        CanIfTxPduType = STATIC
        CanIfTxPduTruncation = true
        CanIfTxPduCanIdType = STANDARD_CAN
        CanIfTxPduCanId = 1864
        CanIfTxPduUserTxConfirmationUL = CAN_TP
        CanIfTxPduBufferRef = Buffer_Can_Network_CANNODE_0_Tx_Std_MailBox_5
        CanIfTxPduRef = Diag_Physical_response_Can_Network_CANNODE_0_Phys_CanTp2CanIf
      XCP_RX_Broadcast_Can_Network_CANNODE_1 (CanIfRxPduCfg):
        CanIfRxPduReadData = false
        CanIfRxPduReadNotifyStatus = true
        CanIfRxPduCanId = 818
        CanIfRxPduCanIdType = STANDARD_NO_FD_CAN
        CanIfRxPduDlc = 1
        CanIfRxPduUserRxIndicationUL = XCP
        CanIfRxPduHrhIdRef = Can_Network_CANNODE_1_Rx_Std_MailBox_2
        CanIfRxPduRef = XCP_RX_Broadcast_Can_Network_CANNODE_1_CanIf2Xcp
      XCP_RX_CMD_Can_Network_CANNODE_1 (CanIfRxPduCfg):
        CanIfRxPduReadData = false
        CanIfRxPduReadNotifyStatus = true
        CanIfRxPduCanId = 819
        CanIfRxPduCanIdType = STANDARD_NO_FD_CAN
        CanIfRxPduDlc = 1
        CanIfRxPduUserRxIndicationUL = XCP
        CanIfRxPduHrhIdRef = Can_Network_CANNODE_1_Rx_Std_MailBox_1
        CanIfRxPduRef = XCP_RX_CMD_Can_Network_CANNODE_1_CanIf2Xcp
      Buffer_Can_Network_CANNODE_1_Tx_Std_MailBox_4 (CanIfBufferCfg): CanIfBufferSize=0, CanIfBufferHthRef=Can_Network_CANNODE_1_Tx_Std_MailBox_4
      XCP_TX_DAQ0_Can_Network_CANNODE_1 (CanIfTxPduCfg):
        CanIfTxPduReadNotifyStatus = false
        CanIfTxPduType = STATIC
        CanIfTxPduTruncation = true
        CanIfTxPduCanIdType = STANDARD_CAN
        CanIfTxPduCanId = 1912
        CanIfTxPduUserTxConfirmationUL = XCP
        CanIfTxPduBufferRef = Buffer_Can_Network_CANNODE_1_Tx_Std_MailBox_4
        CanIfTxPduRef = XCP_TX_DAQ0_Can_Network_CANNODE_1_Xcp2CanIf
      Buffer_Can_Network_CANNODE_1_Tx_Std_MailBox_3 (CanIfBufferCfg): CanIfBufferSize=0, CanIfBufferHthRef=Can_Network_CANNODE_1_Tx_Std_MailBox_3
      XCP_TX_DAQ1_Can_Network_CANNODE_1 (CanIfTxPduCfg):
        CanIfTxPduReadNotifyStatus = false
        CanIfTxPduType = STATIC
        CanIfTxPduTruncation = true
        CanIfTxPduCanIdType = STANDARD_CAN
        CanIfTxPduCanId = 1913
        CanIfTxPduUserTxConfirmationUL = XCP
        CanIfTxPduBufferRef = Buffer_Can_Network_CANNODE_1_Tx_Std_MailBox_3
        CanIfTxPduRef = XCP_TX_DAQ1_Can_Network_CANNODE_1_Xcp2CanIf
      Buffer_Can_Network_CANNODE_1_Tx_Std_MailBox_2 (CanIfBufferCfg): CanIfBufferSize=0, CanIfBufferHthRef=Can_Network_CANNODE_1_Tx_Std_MailBox_2
      XCP_TX_DAQ2_Can_Network_CANNODE_1 (CanIfTxPduCfg):
        CanIfTxPduReadNotifyStatus = false
        CanIfTxPduType = STATIC
        CanIfTxPduTruncation = true
        CanIfTxPduCanIdType = STANDARD_CAN
        CanIfTxPduCanId = 1914
        CanIfTxPduUserTxConfirmationUL = XCP
        CanIfTxPduBufferRef = Buffer_Can_Network_CANNODE_1_Tx_Std_MailBox_2
        CanIfTxPduRef = XCP_TX_DAQ2_Can_Network_CANNODE_1_Xcp2CanIf
      Buffer_Can_Network_CANNODE_1_Tx_Std_MailBox_1 (CanIfBufferCfg): CanIfBufferSize=0, CanIfBufferHthRef=Can_Network_CANNODE_1_Tx_Std_MailBox_1
      XCP_TX_RES_Can_Network_CANNODE_1 (CanIfTxPduCfg):
        CanIfTxPduReadNotifyStatus = false
        CanIfTxPduType = STATIC
        CanIfTxPduTruncation = true
        CanIfTxPduCanIdType = STANDARD_CAN
        CanIfTxPduCanId = 1911
        CanIfTxPduUserTxConfirmationUL = XCP
        CanIfTxPduBufferRef = Buffer_Can_Network_CANNODE_1_Tx_Std_MailBox_1
        CanIfTxPduRef = XCP_TX_RES_Can_Network_CANNODE_1_Xcp2CanIf
    CanIfCtrlDrvCfg: CanIfRbCtrlDrvPrefix=Can_17_McmCanConf_CanHardwareObject, CanIfCtrlDrvNameRef=CanGeneral, CanIfCtrlDrvInitHohConfigRef=CanIfInitHohCfg
      Can_Network_CANNODE_0 (CanIfCtrlCfg): CanIfCtrlWakeupSupport=false, CanIfCtrlCanCtrlRef=Can_Network_CANNODE_0
      Can_Network_CANNODE_1 (CanIfCtrlCfg): CanIfCtrlWakeupSupport=false, CanIfCtrlCanCtrlRef=Can_Network_CANNODE_1
    CanIfDispatchCfg:
      CanIfDispatchUserCtrlBusOffUL = CAN_SM
      CanIfDispatchUserCtrlModeIndicationUL = CAN_SM
      CanIfDispatchUserTrcvModeIndicationName = CAN_SM
      CanIfDispatchUserTrcvModeIndicationUL = CAN_SM
    CanIfPrivateCfg
    CanIfPublicCfg:
      CanIfPublicReadRxPduDataApi = false
      CanIfPublicReadRxPduNotifyStatusApi = true
      CanIfPublicReadTxPduNotifyStatusApi = true
      CanIfPublicSetDynamicTxIdApi = false
      CanIfPublicTxBuffering = false
      CanIfPublicTxConfirmPollingSupport = false
      CanIfPublicVersionInfoApi = false
      CanIfPublicCancelTransmitSupport = false
      CanIfPublicErrorPassiveSupport = false
      CanIfPublicCanIfLiteConfiguration = false
      CanIfPublicUserTpTxInOfflineMode = false
      CanIfPublicWakeupCheckValidSupport = false
      CanIfPublicPnSupport = false
      CanIfPublicHandleTypeEnum = UINT16
      CanIfPublicBusoffRecoveryfromRxIndication = false
      CanIfReadMsgIdApi = true
      CanIfTxOfflineActiveSupport = false
      CanIfWakeupSupport = false
      CanIfPublicMultipleDrvSupport = false
      CanIfPublicDevErrorDetect = true
      CanIfRbCalibrationSupport: CanIfRbCalibration=false
