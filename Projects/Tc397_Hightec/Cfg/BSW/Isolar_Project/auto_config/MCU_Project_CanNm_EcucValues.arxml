AUTOSAR XML (schema 4-2-2)
package /ETAS_Project/EcucModuleConfigurationValuess
  module config CanNm: implementation-config-variant=VARIANT-PRE-COMPILE
    CanNmGlobalConfig:
      CanNmComUserDataSupport = false
      CanNmImmediateRestartEnabled = false
      CanNmImmediateTxconfEnabled = false
      CanNmBusLoadReductionEnabled = false
      CanNmBusSynchronizationEnabled = false
      CanNmCoordinatorSyncSupport = false
      CanNmMainFunctionPeriod = 0.01
      CanNmPassiveModeEnabled = false
      CanNmRemoteSleepIndEnabled = false
      CanNmChannelConfig_NmConfig_CanNmCluster_0 (CanNmChannelConfig):
        CanNmBusLoadReductionActive = false
        CanNmCarWakeUpRxEnabled = false
        CanNmImmediateNmCycleTime = 0.01
        CanNmImmediateNmTransmissions = 0
        CanNmMsgCycleOffset = 0.0
        CanNmPduCbvPosition = CANNM_PDU_BYTE_1
        CanNmPduNidPosition = CANNM_PDU_BYTE_0
        CanNmRemoteSleepIndTime = 0.01
        CanNmComMNetworkHandleRef = ComMChannel_Can_Network_Channel
        CanNmRxPdu_NM_VCU_Rx_ETAS_Can_Network_CANNODE_0_CanIf2CanNm (CanNmRxPdu): CanNmRxPduRef=NM_VCU_Rx_ETAS_Can_Network_CANNODE_0_CanIf2CanNm
        CanNmTxPdu_NM_VCU_Can_Network_CANNODE_0_CanNm2CanIf (CanNmTxPdu): CanNmTxPduRef=NM_VCU_Can_Network_CANNODE_0_CanNm2CanIf
