AUTOSAR XML (schema 4-2-2)
package /ETAS_Project/EcucModuleConfigurationValuess
  module config CanSM: implementation-config-variant=VARIANT-PRE-COMPILE
    CanSMConfiguration: CanSMModeRequestRepetitionMax=5, CanSMModeRequestRepetitionTime=0.07
      CanSMManagerNetwork_Can_Network (CanSMManagerNetwork): CanSMBorTxConfirmationPolling=false, CanSMComMNetworkHandleRef=ComMChannel_Can_Network_Channel
        CanSMDemEventParameterRefs
        CanSMController_Can_Network_CANNODE_0 (CanSMController): CanSMControllerId=Can_Network_CANNODE_0
      CanSMManagerNetwork_Can_Network_XCP (CanSMManagerNetwork): CanSMBorTxConfirmationPolling=false, CanSMComMNetworkHandleRef=ComMChannel_Can_Network_XCP_Channel
        CanSMDemEventParameterRefs
        CanSMController_Can_Network_CANNODE_1 (CanSMController): CanSMControllerId=Can_Network_CANNODE_1
    CanSMGeneral: CanSMMainFunctionTimePeriod=0.001, CanSMVersionInfoApi=false, CanSMDevErrorDetect=true
