AUTOSAR XML (schema 4-2-2)
package /ETAS_Project/EcucModuleConfigurationValuess
  module config Can: implementation-config-variant=VARIANT-PRE-COMPILE
    CanGeneral:
      CanMainFunctionBusoffPeriod = 0.0010
      CanMainFunctionModePeriod = 0.0010
      CanMultiplexedTransmission = false
      CanVersionInfoApi = false
      CanIndex = 0
      CanPublicIcomSupport = false
      CanTimeoutDuration = 1
      CanDevErrorDetection = false
    CanConfigSet
      Can_Network_CANNODE_0 (CanController):
        CanBusoffProcessing = INTERRUPT
        CanControllerActivation = true
        CanControllerBaseAddress = 0
        CanTxProcessing = INTERRUPT
        CanWakeupFunctionalityAPI = false
        CanWakeupProcessing = INTERRUPT
        CanWakeupSupport = false
        CanControllerId = 0
        CanControllerDefaultBaudrate = Can_Network_CANNODE_0/Can_Network_CANNODE_0
        Can_Network_CANNODE_0 (CanControllerBaudrateConfig):
          CanControllerBaudRate = 500
          CanControllerBaudRateConfigID = 1
          CanControllerPropSeg = 0
          CanControllerSeg1 = 10
          CanControllerSeg2 = 0
          CanControllerSyncJumpWidth = 0
      Can_Network_CANNODE_1 (CanController):
        CanBusoffProcessing = INTERRUPT
        CanControllerActivation = true
        CanControllerBaseAddress = 0
        CanTxProcessing = INTERRUPT
        CanWakeupFunctionalityAPI = false
        CanWakeupProcessing = INTERRUPT
        CanWakeupSupport = false
        CanControllerId = 1
        CanControllerDefaultBaudrate = Can_Network_CANNODE_1/Can_Network_CANNODE_1
        Can_Network_CANNODE_1 (CanControllerBaudrateConfig):
          CanControllerBaudRate = 500
          CanControllerBaudRateConfigID = 1
          CanControllerPropSeg = 1
          CanControllerSeg1 = 3
          CanControllerSeg2 = 3
          CanControllerSyncJumpWidth = 1
      16 x CanHardwareObject, all with CanIdType=STANDARD:
        Can_Network_CANNODE_0_Rx_Std_MailBox_1: CanHwObjectCount=1, CanHandleType=FULL, CanObjectType=RECEIVE, CanObjectId=0, CanControllerRef=CanConfigSet/Can_Network_CANNODE_0
          CanHwFilter: CanHwFilterCode=129, CanHwFilterMask=2047
        Can_Network_CANNODE_0_Rx_Std_MailBox_2: CanHwObjectCount=1, CanHandleType=FULL, CanObjectType=RECEIVE, CanObjectId=1, CanControllerRef=CanConfigSet/Can_Network_CANNODE_0
          CanHwFilter: CanHwFilterCode=2015, CanHwFilterMask=2047
        Can_Network_CANNODE_0_Rx_Std_MailBox_3: CanHwObjectCount=1, CanHandleType=FULL, CanObjectType=RECEIVE, CanObjectId=2, CanControllerRef=CanConfigSet/Can_Network_CANNODE_0
          CanHwFilter: CanHwFilterCode=609, CanHwFilterMask=2047
        Can_Network_CANNODE_0_Rx_Std_MailBox_4: CanObjectType=RECEIVE, CanObjectId=3, CanControllerRef=CanConfigSet/Can_Network_CANNODE_0
          CanHwFilter: CanHwFilterCode=1536
        Can_Network_CANNODE_0_Rx_Std_MailBox_5: CanHwObjectCount=1, CanHandleType=FULL, CanObjectType=RECEIVE, CanObjectId=4, CanControllerRef=CanConfigSet/Can_Network_CANNODE_0
          CanHwFilter: CanHwFilterCode=1856, CanHwFilterMask=2047
        Can_Network_CANNODE_1_Rx_Std_MailBox_1: CanHwObjectCount=1, CanHandleType=FULL, CanObjectType=RECEIVE, CanObjectId=5, CanControllerRef=CanConfigSet/Can_Network_CANNODE_1
          CanHwFilter: CanHwFilterCode=819, CanHwFilterMask=2047
        Can_Network_CANNODE_1_Rx_Std_MailBox_2: CanHwObjectCount=1, CanHandleType=FULL, CanObjectType=RECEIVE, CanObjectId=6, CanControllerRef=CanConfigSet/Can_Network_CANNODE_1
          CanHwFilter: CanHwFilterCode=818, CanHwFilterMask=2047
        Can_Network_CANNODE_0_Tx_Std_MailBox_1: CanHwObjectCount=1, CanHandleType=FULL, CanObjectType=TRANSMIT, CanObjectId=7, CanControllerRef=CanConfigSet/Can_Network_CANNODE_0
        Can_Network_CANNODE_0_Tx_Std_MailBox_2: CanHwObjectCount=1, CanHandleType=FULL, CanObjectType=TRANSMIT, CanObjectId=8, CanControllerRef=CanConfigSet/Can_Network_CANNODE_0
        Can_Network_CANNODE_0_Tx_Std_MailBox_3: CanHwObjectCount=1, CanHandleType=FULL, CanObjectType=TRANSMIT, CanObjectId=9, CanControllerRef=CanConfigSet/Can_Network_CANNODE_0
        Can_Network_CANNODE_0_Tx_Std_MailBox_4: CanHwObjectCount=1, CanHandleType=FULL, CanObjectType=TRANSMIT, CanObjectId=10, CanControllerRef=CanConfigSet/Can_Network_CANNODE_0
        Can_Network_CANNODE_0_Tx_Std_MailBox_5: CanHwObjectCount=1, CanHandleType=FULL, CanObjectType=TRANSMIT, CanObjectId=11, CanControllerRef=CanConfigSet/Can_Network_CANNODE_0
        Can_Network_CANNODE_1_Tx_Std_MailBox_1: CanHwObjectCount=1, CanHandleType=FULL, CanObjectType=TRANSMIT, CanObjectId=12, CanControllerRef=CanConfigSet/Can_Network_CANNODE_1
        Can_Network_CANNODE_1_Tx_Std_MailBox_2: CanHwObjectCount=1, CanHandleType=FULL, CanObjectType=TRANSMIT, CanObjectId=13, CanControllerRef=CanConfigSet/Can_Network_CANNODE_1
        Can_Network_CANNODE_1_Tx_Std_MailBox_3: CanHwObjectCount=1, CanHandleType=FULL, CanObjectType=TRANSMIT, CanObjectId=14, CanControllerRef=CanConfigSet/Can_Network_CANNODE_1
        Can_Network_CANNODE_1_Tx_Std_MailBox_4: CanHwObjectCount=1, CanHandleType=FULL, CanObjectType=TRANSMIT, CanObjectId=15, CanControllerRef=CanConfigSet/Can_Network_CANNODE_1
