AUTOSAR XML (schema 4-2-2)
package /ETAS_Project/EcucModuleConfigurationValuess
  module config ComM: implementation-config-variant=VARIANT-PRE-COMPILE
    ComMGeneral:
      ComMEcuGroupClassification = 0
      ComMTMinFullComModeDuration = 0.01
      ComMVersionInfoApi = false
      ComMWakeupInhibitionEnabled = false
      ComMPncGatewayEnabled = false
      ComMPncSupport = false
      ComMResetAfterForcingNoComm = false
      ComMSynchronousWakeUp = false
    ComMConfigSet
      ComMUser_Eth_Network_Channel (ComMUser)
      Eth_Network_Channel_EthernetCluster (ComMChannel)
        ComMNetworkManagement
        ComMUserPerChannel_Eth_Network_Channel (ComMUserPerChannel): ComMUserChannel=ComMUser_Eth_Network_Channel
      ComMUser_Can_Network_Channel (ComMUser)
      ComMChannel_Can_Network_Channel (ComMChannel): ComMMainFunctionPeriod=0.01, ComMFullCommRequestNotificationEnabled=false, ComMNoWakeUpInhibitionNvmStorage=false, ComMBusType=COMM_BUS_TYPE_CAN
        ComMNetworkManagement: ComMPncNmRequest=false
        ComMUserPerChannel_Can_Network_Channel (ComMUserPerChannel): ComMUserChannel=ComMUser_Can_Network_Channel
      ComMUser_Can_Network_XCP_Channel (ComMUser)
      ComMChannel_Can_Network_XCP_Channel (ComMChannel):
        ComMMainFunctionPeriod = 0.01
        ComMFullCommRequestNotificationEnabled = false
        ComMNoCom = true
        ComMNoWakeUpInhibitionNvmStorage = false
        ComMNoWakeup = true
        ComMBusType = COMM_BUS_TYPE_CAN
        ComMNetworkManagement: ComMNmLightTimeout=2.0, ComMNmVariant=LIGHT, ComMPncNmRequest=false
        ComMUserPerChannel_Can_Network_XCP_Channel (ComMUserPerChannel): ComMUserChannel=ComMUser_Can_Network_XCP_Channel
