AUTOSAR XML (schema 4-2-2)
package /ETAS_Project/EcucModuleConfigurationValuess
  module config EcuC: implementation-config-variant=VARIANT-PRE-COMPILE
    EcucConfigSet
      PduCollection (EcucPduCollection)
        31 x Pdu:
          HCU_01_Can_Network_CANNODE_0_CanIf2PduR: PduLength=8
          HCU_01_Can_Network_CANNODE_0_PduR2Com: PduLength=8
          Diag_Functional_request_Can_Network_CANNODE_0_CanIf2CanTp: PduLength=8
          Diag_Functional_request_Can_Network_CANNODE_0_CanTp2PduR: PduLength=8
          Diag_Functional_request_Can_Network_CANNODE_0_PduR2Dcm: PduLength=8
          HCU_02_Can_Network_CANNODE_0_CanIf2PduR: PduLength=1
          HCU_02_Can_Network_CANNODE_0_PduR2Com: PduLength=1
          NM_VCU_Rx_ETAS_Can_Network_CANNODE_0_CanIf2CanNm
          Diag_Physical_request_Can_Network_CANNODE_0_CanIf2CanTp: PduLength=8
          Diag_Physical_request_Can_Network_CANNODE_0_CanTp2PduR: PduLength=8
          Diag_Physical_request_Can_Network_CANNODE_0_PduR2Dcm: PduLength=8
          MCU_03_Can_Network_CANNODE_0_Com2PduR: PduLength=8
          MCU_03_Can_Network_CANNODE_0_PduR2CanIf: PduLength=8
          MCU_01_Can_Network_CANNODE_0_Com2PduR: PduLength=8
          MCU_01_Can_Network_CANNODE_0_PduR2CanIf: PduLength=8
          NM_VCU_Can_Network_CANNODE_0_CanNm2CanIf
          MCU_02_Can_Network_CANNODE_0_Com2PduR: PduLength=7
          MCU_02_Can_Network_CANNODE_0_PduR2CanIf: PduLength=7
          Diag_Physical_response_Can_Network_CANNODE_0_Phys_Dcm2PduR: PduLength=8
          Diag_Physical_response_Can_Network_CANNODE_0_Phys_PduR2CanTp: PduLength=8
          Diag_Physical_response_Can_Network_CANNODE_0_Phys_CanTp2CanIf: PduLength=8
          XCP_RX_Broadcast_Can_Network_CANNODE_1_CanIf2Xcp: PduLength=8
          XCP_RX_CMD_Can_Network_CANNODE_1_CanIf2Xcp: PduLength=8
          XCP_TX_DAQ{0..2}_Can_Network_CANNODE_1_Xcp2CanIf: PduLength=8
          XCP_TX_RES_Can_Network_CANNODE_1_Xcp2CanIf: PduLength=8
          Tester_LIN_1_LinIf2PduR: PduLength=8
          Tester_LIN_1_PduR2Com: PduLength=8
          MCU_LIN_1_Com2PduR: PduLength=8
          MCU_LIN_1_PduR2LinIf: PduLength=8
    EcuCRbSettings: EcuCRbArRelease=AR42_Rev2, EcuCRbRteInUse=true
