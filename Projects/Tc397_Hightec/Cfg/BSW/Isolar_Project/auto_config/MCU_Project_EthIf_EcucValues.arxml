AUTOSAR XML (schema 4-2-2)
package /ETAS_Project/EcucModuleConfigurationValuess
  module config EthIf: implementation-config-variant=PRECONFIGURED-CONFIGURATION
    EthIfConfigSet
      EthIfRxIndicationConfig_0 (EthIfRxIndicationConfig): EthIfRxIndicationFunction=TcpIp_RxIndication
      EthIfFrameOwnerConfig_0 (EthIfFrameOwnerConfig): EthIfRxIndicationRef=EthIfRxIndicationConfig_0
      EthIfPhysController_1 (EthIfPhysController)
        EthIfPhysCtrlRxMainFunctionPriorityProcessing: EthIfPhysCtrlRxMainFunctionPeriod=0.01, EthIfPhysCtrlRxIngressFifoRef=EthCtrlConfigIngressFifo
      EthernetCommunicationConnector (EthIfController)
    EthIfGeneral:
      EthIfEnableSignalQualityApi = false
      EthIfGetAndResetMeasurementDataApi = false
      EthIfGetVlanIdSupport = true
      EthIfGlobalTimeSupport = true
      EthIfMainFunctionPeriod = 0.001
      EthIfTrcvLinkStateChgMainReload = 10
      EthIfSwitchGlobalTimeSupport = false
