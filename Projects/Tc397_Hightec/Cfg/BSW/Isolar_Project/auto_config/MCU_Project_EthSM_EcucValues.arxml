AUTOSAR XML (schema 4-2-2)
package /ETAS_Project/EcucModuleConfigurationValuess
  module config EthSM: implementation-config-variant=PRECONFIGURED-CONFIGURATION
    EthSMGeneral: EthSMDummyMode=false, EthSMVersionInfoApi=false
    EthSMNetworkUserConfig: EthSMNetworkUserType=TCPIP
    Eth_Network_Channel (EthSMNetwork):
      EthSMComMNetworkHandleRef = Eth_Network_Channel_EthernetCluster
      EthSMNetworkUserRef = EthSMNetworkUserConfig
      EthSMEthIfControllerRef = EthernetCommunicationConnector
