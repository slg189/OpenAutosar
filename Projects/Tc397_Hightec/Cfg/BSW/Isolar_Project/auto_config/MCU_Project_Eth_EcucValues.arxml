AUTOSAR XML (schema 4-2-2)
package /ETAS_Project/EcucModuleConfigurationValuess
  module config Eth: implementation-config-variant=PRECONFIGURED-CONFIGURATION
    EthGeneral:
      EthIndex = 0
      EthCfgHclkWait = 20
      EthDemEventsEnabled = false
      EthExtendedSwStatisticCounters = false
      EthGetDropCountApi = false
      EthGetEtherStatsApi = false
      EthGlobalTimeSupport = true
      EthHardwareControllerPortNumber = 0
      EthMainFunctionPeriod = 0.001
      EthMaxCtrlsSupported = 1
      EthMdioClkPeriodWaitCpuCycles = 20
      EthSwSupportRxChecksum = false
      EthSwSupportTxChecksum = false
      EthVersionInfoApi = false
      EthCtrlOffloading:
        EthCtrlEnableOffloadChecksumICMP = false
        EthCtrlEnableOffloadChecksumIPv4 = false
        EthCtrlEnableOffloadChecksumTCP = false
        EthCtrlEnableOffloadChecksumUDP = false
    EthConfigSet
      EthernetCommunicationController (EthCtrlConfig): EthCtrlEnableMii=true, EthCtrlMacLayerSpeed=ETH_MAC_LAYER_SPEED_100M, EthCtrlIdx=0, EthCtrlPhyAddress=00:03:19:00:00:01
        EthCtrlConfigIngress
          EthCtrlConfigIngressFifo: EthCtrlConfigIngressFifoIdx=0
