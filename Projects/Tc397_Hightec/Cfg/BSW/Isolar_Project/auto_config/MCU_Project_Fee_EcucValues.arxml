AUTOSAR XML (schema 4-2-2)
package /ETAS_Project/EcucModuleConfigurationValuess
  module config Fee: implementation-config-variant=VARIANT-PRE-COMPILE
    FeeGeneral:
      FeeIndex = 0
      FeeRbFsSelect = FS1
      FeePollingMode = true
      FeeRbConfirmSingleStorageBlockloss = true
      FeeRbMachineType = MCU_RB_MANUAL_CFG
      FeeSetModeSupported = false
      FeeVersionInfoApi = false
      FeeVirtualPageSize = 8
      FeeDevErrorDetect = true
      FeeRbSectorTable: FlsRbPageSize=8, FeeRbFastCacheInitActive=true, FeeRbHeaderRecheckActive=false
        FeeRbSector_0 (FeeRbSector)
        FeeRbSector_1 (FeeRbSector)
    FeePublishedInformation
