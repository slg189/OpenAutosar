AUTOSAR XML (schema 4-2-2)
package /ETAS_Project/EcucModuleConfigurationValuess
  module config MemIf: implementation-config-variant=VARIANT-PRE-COMPILE
    MemIfGeneral: MemIfVersionInfoApi=false, MemIfNumberOfDevices=1, MemIfRbFeeUsed=true, MemIfRbNumberOfEADevices=0, MemIfDevErrorDetect=true
