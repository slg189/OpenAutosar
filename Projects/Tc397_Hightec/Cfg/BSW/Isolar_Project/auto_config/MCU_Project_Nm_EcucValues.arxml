AUTOSAR XML (schema 4-2-2)
package /ETAS_Project/EcucModuleConfigurationValuess
  module config Nm: implementation-config-variant=VARIANT-PRE-COMPILE
    NmGlobalConfig
      NmGlobalConstants: NmNumberOfChannels=1, NmRemoteSleepCancelCallback=TestNm_RemoteSleepCancellation, NmRemoteSleepIndCallback=TestNm_RemoteSleepIndication
      NmGlobalProperties: NmVersionInfoApi=true, NmCycletimeMainFunction=0.01
      NmGlobalFeatures:
        NmCarWakeUpRxEnabled = false
        NmComUserDataSupport = false
        NmCoordinatorSupportEnabled = false
        NmBusSynchronizationEnabled = false
        NmCoordinatorSyncSupport = false
        NmPassiveModeEnabled = false
        NmRemoteSleepIndEnabled = false
    NmChannelConfig_Can_Network_Channel (NmChannelConfig):
      NmChannelSleepMaster = false
      NmStateReportEnabled = false
      NmSynchronizingNetwork = false
      NmShutdownDelayTimer = 0.0
      NmComMChannelRef = ComMChannel_Can_Network_Channel
      NmBusType
        NmStandardBusNmConfig: NmStandardBusType=NM_BUSNM_CANNM
