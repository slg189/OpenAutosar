AUTOSAR XML (schema 4-2-2)
package /ETAS_Project/EcucModuleConfigurationValuess
  module config NvM: implementation-config-variant=VARIANT-PRE-COMPILE
    NvMCommon:
      NvMApiConfigClass = NVM_API_CONFIG_CLASS_3
      NvMBswMMultiBlockJobStatusInformation = true
      NvMCompiledConfigId = 0
      NvMCrcNumOfBytes = 1
      NvMDrvModeSwitch = false
      NvMDynamicConfiguration = false
      NvMJobPrioritization = false
      NvMMultiBlockCallback = NULL_PTR
      NvMPollingMode = true
      NvMSetRamBlockStatusApi = true
      NvMRbSetWriteAllTriggerApi = true
      NvMVersionInfoApi = false
      NvMDevErrorDetect = true
    4 x NvMBlockDescriptor:
      NvM_MultiBlock: NvMBlockJobPriority=1, NvMBlockWriteProt=false, NvMNvBlockLength=1, NvMWriteBlockOnce=false, NvMWriteVerification=false, NvMResistantToChangedSw=false, NvMBlockCrcType=NVM_CRC16, NvMBlockManagementType=NVM_BLOCK_NATIVE, NvMBlockUseCrc=true, NvMBlockUseSyncMechanism=false, NvMMaxNumOfReadRetries=0, NvMMaxNumOfWriteRetries=0, NvMNvBlockNum=1, NvMNvramDeviceId=0, NvMRomBlockNum=0, NvMStaticBlockIDCheck=false, NvMWriteVerificationDataSize=0, NvMCalcRamBlockCrc=false, NvMInitBlockCallback=NULL_PTR
      NvM_ConfigId: NvMBlockJobPriority=1, NvMBlockWriteProt=false, NvMWriteBlockOnce=false, NvMWriteVerification=false, NvMResistantToChangedSw=false, NvMRamBlockDataAddress=NvM_Prv_idConfigStored_u16, NvMSelectBlockForReadAll=true, NvMSelectBlockForWriteAll=true, NvMBlockCrcType=NVM_CRC16, NvMBlockManagementType=NVM_BLOCK_NATIVE, NvMBlockUseCrc=true, NvMBlockUseSyncMechanism=false, NvMMaxNumOfReadRetries=0, NvMMaxNumOfWriteRetries=0, NvMNvBlockNum=1, NvMNvramDeviceId=0, NvMRomBlockNum=0, NvMStaticBlockIDCheck=false, NvMWriteVerificationDataSize=0, NvMCalcRamBlockCrc=false, NvMInitBlockCallback=NULL_PTR
      NvM_NativeBlock_2
      NvM_NativeBlock_3
