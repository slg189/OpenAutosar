AUTOSAR XML (schema 4-2-2)
package /ETAS_Project/EcucModuleConfigurationValuess
  module config PduR: implementation-config-variant=VARIANT-PRE-COMPILE
    PduRGeneral:
      PduRVersionInfoApi = false
      PduRZeroCostOperation = false
      PduRIFGatewayOperation = false
      PduRTPGatewayOperation = false
      PduRMulticastFromTpSupport = false
      PduRMulticastToIfSupport = false
      PduRMulticastToTpSupport = false
      PduRQueueingSupport = false
      PduRGwTpWithLimitedBuffer = false
    PduRRoutingTables: PduRConfigurationId=0
      PduRRoutingTable
        8 x PduRRoutingPath:
          HCU_01_Can_Network_CANNODE_0_CanIf2Com
            HCU_01_Can_Network_CANNODE_0_CanIf2PduR (PduRSrcPdu): PduRSrcPduRef=HCU_01_Can_Network_CANNODE_0_CanIf2PduR
            HCU_01_Can_Network_CANNODE_0_PduR2Com (PduRDestPdu): PduRTransmissionConfirmation=false, PduRDestPduRef=HCU_01_Can_Network_CANNODE_0_PduR2Com
          Diag_Functional_request_Can_Network_CANNODE_0_CanTp2Dcm
            Diag_Functional_request_Can_Network_CANNODE_0_CanTp2PduR (PduRSrcPdu): PduRSrcPduRef=Diag_Functional_request_Can_Network_CANNODE_0_CanTp2PduR
            Diag_Functional_request_Can_Network_CANNODE_0_PduR2Dcm (PduRDestPdu): PduRTransmissionConfirmation=false, PduRDestPduRef=Diag_Functional_request_Can_Network_CANNODE_0_PduR2Dcm
          HCU_02_Can_Network_CANNODE_0_CanIf2Com
            HCU_02_Can_Network_CANNODE_0_CanIf2PduR (PduRSrcPdu): PduRSrcPduRef=HCU_02_Can_Network_CANNODE_0_CanIf2PduR
            HCU_02_Can_Network_CANNODE_0_PduR2Com (PduRDestPdu): PduRTransmissionConfirmation=false, PduRDestPduRef=HCU_02_Can_Network_CANNODE_0_PduR2Com
          Diag_Physical_request_Can_Network_CANNODE_0_CanTp2Dcm
            Diag_Physical_request_Can_Network_CANNODE_0_CanTp2PduR (PduRSrcPdu): PduRSrcPduRef=Diag_Physical_request_Can_Network_CANNODE_0_CanTp2PduR
            Diag_Physical_request_Can_Network_CANNODE_0_PduR2Dcm (PduRDestPdu): PduRTransmissionConfirmation=false, PduRDestPduRef=Diag_Physical_request_Can_Network_CANNODE_0_PduR2Dcm
          MCU_03_Can_Network_CANNODE_0_Com2CanIf
            MCU_03_Can_Network_CANNODE_0_Com2PduR (PduRSrcPdu): PduRSrcPduRef=MCU_03_Can_Network_CANNODE_0_Com2PduR
            MCU_03_Can_Network_CANNODE_0_PduR2CanIf (PduRDestPdu): PduRTransmissionConfirmation=false, PduRDestPduRef=MCU_03_Can_Network_CANNODE_0_PduR2CanIf
          MCU_01_Can_Network_CANNODE_0_Com2CanIf
            MCU_01_Can_Network_CANNODE_0_Com2PduR (PduRSrcPdu): PduRSrcPduRef=MCU_01_Can_Network_CANNODE_0_Com2PduR
            MCU_01_Can_Network_CANNODE_0_PduR2CanIf (PduRDestPdu): PduRTransmissionConfirmation=false, PduRDestPduRef=MCU_01_Can_Network_CANNODE_0_PduR2CanIf
          MCU_02_Can_Network_CANNODE_0_Com2CanIf
            MCU_02_Can_Network_CANNODE_0_Com2PduR (PduRSrcPdu): PduRSrcPduRef=MCU_02_Can_Network_CANNODE_0_Com2PduR
            MCU_02_Can_Network_CANNODE_0_PduR2CanIf (PduRDestPdu): PduRTransmissionConfirmation=false, PduRDestPduRef=MCU_02_Can_Network_CANNODE_0_PduR2CanIf
          Diag_Physical_response_Can_Network_CANNODE_0_Dcm2CanTp
            Diag_Physical_response_Can_Network_CANNODE_0_Phys_Dcm2PduR (PduRSrcPdu): PduRSrcPduRef=Diag_Physical_response_Can_Network_CANNODE_0_Phys_Dcm2PduR
            Diag_Physical_response_Can_Network_CANNODE_0_Phys_PduR2CanTp (PduRDestPdu): PduRTransmissionConfirmation=false, PduRDestPduRef=Diag_Physical_response_Can_Network_CANNODE_0_Phys_PduR2CanTp
    6 x PduRBswModules:
      CanNm: PduRCancelReceive=0, PduRCancelTransmit=0, PduRChangeParameterApi=0, PduRCommunicationInterface=1, PduRLowerModule=1, PduRRetransmission=0, PduRTransportProtocol=0, PduRTriggertransmit=1, PduRTxConfirmation=1, PduRUpperModule=0, PduRUseTag=0, PduRBswModuleRef=CanNm
      CanIf: PduRCancelReceive=0, PduRCancelTransmit=0, PduRChangeParameterApi=0, PduRCommunicationInterface=1, PduRLowerModule=1, PduRRetransmission=0, PduRTransportProtocol=0, PduRTriggertransmit=0, PduRTxConfirmation=1, PduRUpperModule=0, PduRUseTag=0, PduRBswModuleRef=CanIf
      Com: PduRCancelReceive=0, PduRCancelTransmit=0, PduRChangeParameterApi=0, PduRCommunicationInterface=1, PduRLowerModule=0, PduRRetransmission=0, PduRTransportProtocol=1, PduRTriggertransmit=1, PduRTxConfirmation=0, PduRUpperModule=1, PduRUseTag=0, PduRBswModuleRef=Com
      SoAdIf
      CanTp: PduRCancelReceive=0, PduRCancelTransmit=1, PduRChangeParameterApi=0, PduRCommunicationInterface=0, PduRLowerModule=1, PduRRetransmission=0, PduRTransportProtocol=1, PduRTriggertransmit=0, PduRTxConfirmation=1, PduRUpperModule=0, PduRUseTag=0
        PduRInvalidHandlers: PduRIHCancelReceive=false, PduRIHCancelTransmit=false
      Dcm: PduRCancelReceive=0, PduRCancelTransmit=1, PduRChangeParameterApi=0, PduRCommunicationInterface=0, PduRLowerModule=0, PduRRetransmission=0, PduRTransportProtocol=1, PduRTriggertransmit=0, PduRTxConfirmation=1, PduRUpperModule=1, PduRUseTag=0
