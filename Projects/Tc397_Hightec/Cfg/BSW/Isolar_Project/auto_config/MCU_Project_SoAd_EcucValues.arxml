AUTOSAR XML (schema 4-2-2)
package /ETAS_Project/EcucModuleConfigurationValuess
  module config SoAd: implementation-config-variant=PRECONFIGURED-CONFIGURATION
    SoAdConfig
    SoAdGeneral
