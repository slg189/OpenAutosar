AUTOSAR XML (schema 4-2-2)
package /ETAS_Project/EcucModuleConfigurationValuess
  module config TcpIp: implementation-config-variant=PRECONFIGURED-CONFIGURATION
    TcpIpConfig
      TcpIpSocketOwnerConfig
        TcpIpSocketOwner
    TcpIpGeneral
