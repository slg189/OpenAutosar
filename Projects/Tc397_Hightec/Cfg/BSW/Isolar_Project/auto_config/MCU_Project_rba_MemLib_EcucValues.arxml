AUTOSAR XML (schema 4-2-2)
package /ETAS_Project/EcucModuleConfigurationValuess
  module config rba_MemLib: implementation-config-variant=PRECONFIGURED-CONFIGURATION
    rba_MemLibCentral: rba_MemLibCentralEnablePrototype=false, rba_MemLibVersionInfoApi=false
