AUTOSAR XML (schema 4-2-2)
package /ETAS_Project/EcucModuleConfigurationValuess
  module config CanIf
    CanIfInitCfg
      CanIfInitHohCfg
        Can_Network_CANNODE_0_Rx_Std_MailBox_4 (CanIfHrhCfg)
          CanIfHrhRangeCfg: CanIfHrhRangeRxPduLowerCanId=1536, CanIfHrhRangeRxPduRangeCanIdType=STANDARD, CanIfHrhRangeRxPduUpperCanId=1545
      NM_VCU_Rx_ETAS_Can_Network_CANNODE_0 (CanIfRxPduCfg)
        CanIfRxPduCanIdRange: CanIfRxPduCanIdRangeUpperCanId=1545, CanIfRxPduCanIdRangeLowerCanId=1536
    CanIfPrivateCfg: CanIfPrivateDlcCheck=true
    CanIfPublicCfg: CanIfTriggerTransmitSupport=false
  module config Can
    CanConfigSet
      Can_Network_CANNODE_0 (CanController): CanRxProcessing=INTERRUPT
      Can_Network_CANNODE_0_Rx_Std_MailBox_4 (CanHardwareObject): CanHandleType=BASIC, CanHwObjectCount=10
        CanHwFilter: CanHwFilterMask=2032
      Can_Network_CANNODE_1 (CanController): CanRxProcessing=INTERRUPT
  module config ComM
    ComMConfigSet
      Eth_Network_Channel_EthernetCluster (ComMChannel):
        ComMMainFunctionPeriod = 0.01
        ComMFullCommRequestNotificationEnabled = false
        ComMNoCom = false
        ComMNoWakeUpInhibitionNvmStorage = false
        ComMNoWakeup = false
        ComMBusType = COMM_BUS_TYPE_ETH
        ComMNetworkManagement: ComMNmLightTimeout=2.0, ComMNmVariant=LIGHT, ComMPncNmRequest=false
      ComMUser_Eth_Network_Channel (ComMUser): ComMUserIdentifier=2
      ComMChannel_Can_Network_Channel (ComMChannel): ComMNoCom=false, ComMNoWakeup=false
        ComMNetworkManagement: ComMNmLightTimeout=2.0, ComMNmVariant=FULL
      ComMUser_Can_Network_Channel (ComMUser): ComMUserIdentifier=0
      ComMUser_Can_Network_XCP_Channel (ComMUser): ComMUserIdentifier=1
    ComMGeneral: ComMModeLimitationEnabled=true, ComMRteEnabled=true, ComMDevErrorDetect=true
  module config PduR
    PduRGeneral: PduRDevErrorDetect=true
    PduRRoutingTables
      PduRRoutingTable
    CanTp (PduRBswModules): PduRBswModuleRef=CanTp
    Dcm (PduRBswModules): PduRBswModuleRef=Dcm
  module config CanSM
    CanSMConfiguration
      CanSMManagerNetwork_Can_Network (CanSMManagerNetwork): CanSMBorCounterL1ToL2=5, CanSMBorTimeL1=0.1, CanSMBorTimeL2=1.0, CanSMBorTimeTxEnsured=5.0, CanSMNetworkIndex=0
        CanSMDemEventParameterRefs: CanSMRbDynCreate_CANSM_E_BUS_OFF=Disabled, CANSM_E_BUS_OFF=DemEventParameter_0D04_Busoff0
      CanSMManagerNetwork_Can_Network_XCP (CanSMManagerNetwork): CanSMBorCounterL1ToL2=5, CanSMBorTimeL1=0.1, CanSMBorTimeL2=1, CanSMBorTimeTxEnsured=5, CanSMNetworkIndex=1
        CanSMDemEventParameterRefs: CanSMRbDynCreate_CANSM_E_BUS_OFF=Disabled, CANSM_E_BUS_OFF=DemEventParameter_0D05_Busoff1
  module config EcuC
    EcucConfigSet
      PduCollection (EcucPduCollection): PduLengthTypeEnum=uint16, PduIdTypeEnum=uint16
        11 x Pdu, all with PduLength=8:
          NM_VCU_Rx_ETAS_Can_Network_CANNODE_0_CanIf2CanNm
          NM_VCU_Can_Network_CANNODE_0_CanNm2CanIf
          OBD_Physical_request_Can_Network_CANNODE_0_CanIf2CanTp
          OBD_Physical_request_Can_Network_CANNODE_0_CanTp2PduR
          OBD_Physical_request_Can_Network_CANNODE_0_PduR2Dcm
          OBD_Functional_request_Can_Network_CANNODE_0_CanIf2CanTp
          OBD_Functional_request_Can_Network_CANNODE_0_CanTp2PduR
          OBD_Functional_request_Can_Network_CANNODE_0_PduR2Dcm
          OBD_Physical_response_Can_Network_CANNODE_0_Phys_Dcm2PduR
          OBD_Physical_response_Can_Network_CANNODE_0_Phys_PduR2CanTp
          OBD_Physical_response_Can_Network_CANNODE_0_Phys_CanTp2CanIf
  module config Nm
    NmGlobalConfig
      NmGlobalConstants: NmStateChangeIndCallback=Nm_StateChangeIndication, NmRxIndicationCallback=Nm_RxIndicationCallback
      NmGlobalProperties: NmDevErrorDetect=true
      NmGlobalFeatures:
        NmComControlEnabled = true
        NmNodeDetectionEnabled = true
        NmNodeIdEnabled = true
        NmPduRxIndicationEnabled = true
        NmRepeatMsgIndEnabled = true
        NmUserDataEnabled = true
        NmStateChangeIndEnabled = true
  module config CanNm
    CanNmGlobalConfig:
      CanNmVersionInfoApi = true
      CanNmComControlEnabled = true
      CanNmNodeDetectionEnabled = true
      CanNmNodeIdEnabled = true
      CanNmPduRxIndicationEnabled = true
      CanNmRepeatMsgIndEnabled = true
      CanNmStateChangeIndEnabled = true
      CanNmUserDataEnabled = true
      CanNmDevErrorDetect = true
      CanNmChannelConfig_NmConfig_CanNmCluster_0 (CanNmChannelConfig):
        CanNmMsgCycleTime = 0.1
        CanNmMsgReducedTime = 0.1
        CanNmMsgTimeoutTime = 0.3
        CanNmNodeId = 90
        CanNmRepeatMessageTime = 0.5
        CanNmTimeoutTime = 1.0
        CanNmWaitBusSleepTime = 5.0
        CanNmNodeDetectionEnabled = true
        CanNmRepeatMsgIndEnabled = true
        CanNmNodeIdEnabled = true
        CanNmRetryFirstMessageRequest = true
  module config NvM
    NvM_NativeBlock_2 (NvMBlockDescriptor):
      NvMBlockCrcType = NVM_CRC16
      NvMBlockManagementType = NVM_BLOCK_NATIVE
      NvMBlockUseCrc = true
      NvMBlockUseSyncMechanism = false
      NvMMaxNumOfReadRetries = 0
      NvMMaxNumOfWriteRetries = 0
      NvMNvBlockNum = 1
      NvMNvramDeviceId = 0
      NvMRomBlockNum = 1
      NvMStaticBlockIDCheck = false
      NvMWriteVerificationDataSize = 0
      NvMCalcRamBlockCrc = false
      NvMInitBlockCallback = NULL_PTR
      NvMNvBlockLength = 1024
      NvMRamBlockDataAddress = Rte_CPim_ASW_NVM_ASW_NVM_BlockNative_1024_1
      NvMBlockJobPriority = 1
      NvMBlockWriteProt = false
      NvMSelectBlockForWriteAll = true
      NvMSelectBlockForReadAll = true
      NvMWriteBlockOnce = false
      NvMResistantToChangedSw = false
      NvMWriteVerification = false
      NvMRomBlockDataAddress = Rte_ROM_ASW_NVM_ASW_NVM_BlockNative_1024_1
      NvMReadRamBlockFromNvCallback = NULL_PTR
      NvMWriteRamBlockToNvCallback = NULL_PTR
    NvM_NativeBlock_3 (NvMBlockDescriptor):
      NvMBlockCrcType = NVM_CRC16
      NvMBlockManagementType = NVM_BLOCK_NATIVE
      NvMBlockUseCrc = true
      NvMBlockUseSyncMechanism = false
      NvMMaxNumOfReadRetries = 0
      NvMMaxNumOfWriteRetries = 0
      NvMNvBlockNum = 1
      NvMNvramDeviceId = 0
      NvMRomBlockNum = 1
      NvMStaticBlockIDCheck = false
      NvMWriteVerificationDataSize = 0
      NvMCalcRamBlockCrc = false
      NvMInitBlockCallback = NULL_PTR
      NvMNvBlockLength = 1024
      NvMRamBlockDataAddress = Rte_CPim_ASW_NVM_ASW_NVM_BlockNative_1024_2
      NvMBlockJobPriority = 1
      NvMBlockWriteProt = false
      NvMSelectBlockForWriteAll = true
      NvMSelectBlockForReadAll = true
      NvMWriteBlockOnce = false
      NvMResistantToChangedSw = false
      NvMWriteVerification = false
      NvMRomBlockDataAddress = Rte_ROM_ASW_NVM_ASW_NVM_BlockNative_1024_2
      NvMReadRamBlockFromNvCallback = NULL_PTR
      NvMWriteRamBlockToNvCallback = NULL_PTR
    NvMCommon:
      NvMSizeStandardJobQueue = 5
      NvMMainFunctionPeriod = 0.01
      NvMSizeImmediateJobQueue = 5
      NvMRbAuxInterface = false
      NvMRbGenArxmlVersion = NVM_GEN_ARXML_VERSION_402
      NvMRepeatMirrorOperations = 0
      NvMRbRamInitCheck = NVM_RB_RAM_INIT_CHECK_NONE
      NvMRbInitAtLayoutChange = false
      NvMRbRuntimeRamBlockConfiguration = false
      NvMRbReqMonitor = NVM_RB_REQ_MON_DISABLED
    NvM_MultiBlock (NvMBlockDescriptor):
      NvMRamBlockDataAddress = NULL_PTR
      NvMReadRamBlockFromNvCallback = NULL_PTR
      NvMWriteRamBlockToNvCallback = NULL_PTR
      NvMSingleBlockCallback = NULL_PTR
      NvMRomBlockDataAddress = NULL_PTR
    NvM_ConfigId (NvMBlockDescriptor): NvMNvBlockLength=1, NvMWriteRamBlockToNvCallback=NULL_PTR, NvMRomBlockDataAddress=NULL_PTR, NvMReadRamBlockFromNvCallback=NULL_PTR
  module config Fee
    FeeGeneral: FeeNvmJobEndNotification=Fee_NvmJobEndNotification, FeeNvmJobErrorNotification=Fee_NvmJobErrorNotification
      FeeRbSectorTable: FlsRbErasedValue=0
        FeeRbSector_0 (FeeRbSector): FlsRbSectorSize=16384
        FeeRbSector_1 (FeeRbSector): FlsRbSectorSize=16384
  module config Eth
    EthConfigSet
      EthernetCommunicationController (EthCtrlConfig): EthCtrlEnableRxInterrupt=false, EthCtrlEnableTxInterrupt=false, EthTxBufTotal=4, EthRxBufTotal=4, EthCtrlRxBufLenByte=1536, EthCtrlTxBufLenByte=1536
        EthDemEventParameterRefs
        EthCtrlConfigIngress
          EthCtrlConfigIngressFifo: EthCtrlConfigIngressFifoBufLenByte=1522, EthCtrlConfigIngressFifoBufTotal=4
    EthGeneral: EthDevErrorDetect=true, EthMainFunctionPTPPeriod=0.001, EthUpdatePhysAddrFilter=true, EthDSMReInitEnabled=false
  module config EthIf
    EthIfConfigSet
      EthernetCommunicationConnector (EthIfController): EthIfCtrlMtu=1500, EthIfPhysControllerRef=EthIfPhysController_1
      EthIfFrameOwnerConfig_RX (EthIfFrameOwnerConfig): EthIfFrameType=2048, EthIfRxIndicationRef=EthIfRxIndicationConfig_0
      EthIfPhysController_1 (EthIfPhysController): EthIfEthDriverPrefix=17_GEthMac, EthIfEthCtrlRef=EthernetCommunicationController
      EthIfFrameOwnerConfig_0 (EthIfFrameOwnerConfig): EthIfFrameType=2054
    EthIfGeneral:
      EthIfDevErrorDetect = true
      EthIfMainFunctionStatePeriod = 0.005
      EthIfVersionInfoApi = true
      EthIfVirtualAddressFilterSize = 255
      EthIfPublicCddHeaderFile = TcpIp_Cbk.h
  module config EthSM
    EthSMGeneral: EthSMDevErrorDetect=true, EthSMMainFunctionPeriod=0.01
  module config Com
    ComConfig_0 (ComConfig)
      HCU_01_Can_Network_CANNODE_0 (ComIPdu)
      9 x ComSignal:
        HCU01_EmergShutDown
        HCU01_CheckSum: ComSignalInitValue=255.0, ComRxDataTimeoutAction=NONE
        HCU01_Counter: ComSignalInitValue=15.0, ComRxDataTimeoutAction=NONE
        HCU01_ActiveDischarge: ComSignalInitValue=1.0, ComRxDataTimeoutAction=NONE
        HCU01_McuModeCmd: ComSignalInitValue=3.0, ComRxDataTimeoutAction=NONE
        HCU01_EnaMCU: ComSignalInitValue=1.0, ComRxDataTimeoutAction=NONE
        HCU01_SpeedCmd: ComSignalInitValue=16383.0, ComRxDataTimeoutAction=NONE
        HCU01_Shift: ComSignalInitValue=3.0, ComRxDataTimeoutAction=NONE
        HCU01_TqCmd: ComSignalInitValue=2047.0, ComRxDataTimeoutAction=NONE
      HCU_02_Can_Network_CANNODE_0 (ComIPdu)
      HCU02_Poweroff (ComSignal): ComSignalInitValue=1.0, ComRxDataTimeoutAction=NONE
