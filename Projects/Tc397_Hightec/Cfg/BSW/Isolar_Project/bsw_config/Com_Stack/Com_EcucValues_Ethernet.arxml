AUTOSAR XML (schema 4-2-2)
package /ETAS_Project/EcucModuleConfigurationValuess
  module config Com: implementation-config-variant=VARIANT-PRE-COMPILE
    ComConfig_0 (ComConfig)
      ComIPdu_UDP_RX (ComIPdu):
        ComIPduDirection = RECEIVE
        ComIPduSignalProcessing = IMMEDIATE
        ComIPduType = NORMAL
        ComIPduSignalRef = ComSignal_UDP_RX
        ComPduIdRef = RXFrame_EthernetUDP_PduR2Com
        ComIPduGroupRef = ComIPduGroup_Rx
      ComIPdu_UDP_TX (ComIPdu):
        ComIPduDirection = SEND
        ComIPduSignalProcessing = IMMEDIATE
        ComIPduType = NORMAL
        ComIPduSignalRef = ComSignal_UDP_TX
        ComPduIdRef = TXFrame_EthernetUDP_Com2PduR
        ComIPduGroupRef = ComIPduGroup_Tx
        ComTxIPdu: ComTxIPduUnusedAreasDefault=0
          ComTxModeTrue
            ComTxMode: ComTxModeMode=DIRECT, ComTxModeNumberOfRepetitions=0
      4 x ComSignal, all with ComBitPosition=0, ComSignalEndianness=LITTLE_ENDIAN, ComSignalType=UINT32, ComTransferProperty=TRIGGERED, ComUpdateBitPosition=-1, ComBitSize=32:
        ComSignal_UDP_TX: ComSignalLength=4, ComSystemTemplateSystemSignalRef=ISignalToIPduMappingUDP_TX
        ComSignal_UDP_RX: ComTimeoutNotification=Rte_COMCbkTOut_ComSignal_UDP_RX, ComSignalLength=4, ComNotification=Rte_COMCbk_ComSignal_UDP_RX, ComSystemTemplateSystemSignalRef=ISignalToIPduMappingUDP_RX
        ComSignal_TCP_TX: ComSystemTemplateSystemSignalRef=ISignalToIPduMappingTCP_TX
        ComSignal_TCP_RX: ComNotification=Rte_COMCbk_ComSignal_TCP_RX, ComTimeoutNotification=Rte_COMCbkTOut_ComSignal_TCP_RX, ComSystemTemplateSystemSignalRef=ISignalToIPduMappingTCP_RX
      ComIPdu_TCP_RX (ComIPdu):
        ComIPduDirection = RECEIVE
        ComIPduSignalProcessing = IMMEDIATE
        ComIPduType = NORMAL
        ComPduIdRef = RXFrame_EthernetTCP_PduR2Com
        ComIPduSignalRef = ComSignal_TCP_RX
        ComIPduGroupRef = ComIPduGroup_Rx
      ComIPdu_TCP_TX (ComIPdu):
        ComIPduDirection = SEND
        ComIPduSignalProcessing = IMMEDIATE
        ComIPduType = NORMAL
        ComPduIdRef = TXFrame_EthernetTCP_Com2PduR
        ComIPduSignalRef = ComSignal_TCP_TX
        ComIPduGroupRef = ComIPduGroup_Tx
        ComTxIPdu: ComTxIPduUnusedAreasDefault=0
          ComTxModeTrue
            ComTxMode: ComTxModeMode=DIRECT, ComTxModeNumberOfRepetitions=0
