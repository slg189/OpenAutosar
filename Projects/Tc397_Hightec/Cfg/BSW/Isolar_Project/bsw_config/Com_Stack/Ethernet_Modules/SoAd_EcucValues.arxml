AUTOSAR XML (schema 4-2-2)
package /ETAS_Project/EcucModuleConfigurationValuess
  module config SoAd: implementation-config-variant=VARIANT-PRE-COMPILE
    PduR (SoAdBswModules): SoAdIf=true, SoAdIfTriggerTransmit=false, SoAdIfTxConfirmation=true, SoAdTp=false, SoAdUseCallerInfix=true, SoAdUseTypeInfix=true, SoAdBswModuleRef=PduR
    SoAdConfig
      SoAdPduRoute_UDP_TX (SoAdPduRoute): SoAdTxUpperLayerType=IF, SoAdTxUser=PduR, SoAdTxPduCollectionSemantics=SOAD_COLLECT_QUEUED, SoAdTxPduRef=TXFrame_EthernetUDP_PduR2SoAd
        SoAdPduRouteDest:
          SoAdTxUdpTriggerMode = TRIGGER_ALWAYS
          SoAdTxPduHeaderId = 4676
          SoAdTxRoutingGroupRef = SoAdRoutingGroup_TX
          SoAdTxSocketConnOrSocketConnBundleRef = SoAdSocketConnection_UDP
      SoAdRoutingGroup_RX (SoAdRoutingGroup): SoAdRoutingGroupIsEnabledAtInit=true, SoAdRoutingGroupTxTriggerable=false
      SoAdRoutingGroup_TX (SoAdRoutingGroup): SoAdRoutingGroupIsEnabledAtInit=true, SoAdRoutingGroupTxTriggerable=false
      SoAdSocketConnectionGroup_UDP (SoAdSocketConnectionGroup):
        SoAdPduHeaderEnable = true
        SoAdResourceManagementEnable = false
        SoAdSocketAutomaticSoConSetup = true
        SoAdSocketFramePriority = 0
        SoAdSocketIpAddrAssignmentChgNotification = false
        SoAdSocketLocalPort = 13401
        SoAdSocketMsgAcceptanceFilterEnabled = true
        SoAdSocketSoConModeChgNotification = false
        SoAdSocketLocalAddressRef = TcpIpLocalAddr_Uni_10_184_133_253
        SoAdSocketConnection_UDP (SoAdSocketConnection)
          SoAdSocketRemoteAddress: SoAdSocketRemoteIpAddress=10.184.133.27, SoAdSocketRemotePort=13402
        SoAdSocketProtocol
          SoAdSocketUdp: SoAdSocketUdpListenOnly=false
      SoAdSocketConnectionGroup_TCP (SoAdSocketConnectionGroup):
        SoAdPduHeaderEnable = 0
        SoAdResourceManagementEnable = 0
        SoAdSocketAutomaticSoConSetup = true
        SoAdSocketFramePriority = 0
        SoAdSocketIpAddrAssignmentChgNotification = false
        SoAdSocketLocalPort = 13402
        SoAdSocketMsgAcceptanceFilterEnabled = 1
        SoAdSocketSoConModeChgNotification = false
        SoAdSocketLocalAddressRef = TcpIpLocalAddr_Uni_10_184_133_253
        SoAdSocketConnection_TCP (SoAdSocketConnection)
          SoAdSocketRemoteAddress: SoAdSocketRemoteIpAddress=10.184.133.27, SoAdSocketRemotePort=0
        SoAdSocketProtocol
          SoAdSocketTcp: SoAdSocketTcpImmediateTpTxConfirmation=false, SoAdSocketTcpInitiate=false, SoAdSocketTcpNoDelay=true, SoAdSocketTcpTxQuota=0
      SoAdSocketRoute_UDP (SoAdSocketRoute): SoAdRxPduHeaderId=4693, SoAdRxSocketConnOrSocketConnBundleRef=SoAdSocketConnection_UDP
        SoAdSocketRouteDest: SoAdRxUpperLayerType=IF, SoAdRxUser=PduR, SoAdRxPduRef=RXFrame_EthernetUDP_SoAd2PduR, SoAdRxRoutingGroupRef=SoAdRoutingGroup_RX
      SoAdSocketRoute_TCP (SoAdSocketRoute): SoAdRxSocketConnOrSocketConnBundleRef=SoAdSocketConnection_TCP
        SoAdSocketRouteDest: SoAdRxUser=PduR, SoAdRxUpperLayerType=IF, SoAdRxPduRef=RXFrame_EthernetTCP_SoAd2PduR, SoAdRxRoutingGroupRef=SoAdRoutingGroup_RX
      SoAdPduRoute_TCP_TX (SoAdPduRoute): SoAdTxPduCollectionSemantics=SOAD_COLLECT_LAST_IS_BEST, SoAdTxUpperLayerType=IF, SoAdTxUser=PduR, SoAdTxPduRef=TXFrame_EthernetTCP_PduR2SoAd
        SoAdPduRouteDest: SoAdTxUdpTriggerMode=TRIGGER_ALWAYS, SoAdTxSocketConnOrSocketConnBundleRef=SoAdSocketConnection_TCP, SoAdTxRoutingGroupRef=SoAdRoutingGroup_TX
      SoAdSocketRoute_DoIP_UDP_TEST_EQUIPMENT (SoAdSocketRoute): SoAdRxSocketConnOrSocketConnBundleRef=SoAdSocketConnection_DoIP_UDP_TEST_EQUIPMENT
        SoAdSocketRouteDest: SoAdRxUser=DoIP, SoAdRxUpperLayerType=IF, SoAdRxPduRef=RXFrame_EthernetUDP_SoAd2DoIP, SoAdRxRoutingGroupRef=SoAdRoutingGroup_DoIP_UDP
      SoAdSocketConnectionGroup_DoIP_UDP (SoAdSocketConnectionGroup):
        SoAdPduHeaderEnable = false
        SoAdResourceManagementEnable = false
        SoAdSocketAutomaticSoConSetup = false
        SoAdSocketFramePriority = 0
        SoAdSocketIpAddrAssignmentChgNotification = true
        SoAdSocketLocalPort = 13400
        SoAdSocketMsgAcceptanceFilterEnabled = true
        SoAdSocketSoConModeChgNotification = true
        SoAdSocketLocalAddressRef = TcpIpLocalAddr_Uni_10_184_133_253
        SoAdSocketConnection_DoIP_UDP_DISCOVERY (SoAdSocketConnection): UL_LocalIpAddrAssignmentChg=DoIP_LocalIpAddrAssignmentChg, UL_SoConModeChg=DoIP_SoConModeChg
          SoAdSocketRemoteAddress: SoAdSocketRemoteIpAddress=255.255.255.255, SoAdSocketRemotePort=13400
        SoAdSocketConnection_DoIP_UDP_TEST_EQUIPMENT (SoAdSocketConnection): UL_LocalIpAddrAssignmentChg=DoIP_LocalIpAddrAssignmentChg, UL_SoConModeChg=DoIP_SoConModeChg
          SoAdSocketRemoteAddress: SoAdSocketRemoteIpAddress=ANY, SoAdSocketRemotePort=0
        SoAdSocketProtocol
          SoAdSocketUdp: SoAdSocketUdpListenOnly=false
      SoAdSocketConnectionGroup_DoIP_TCP (SoAdSocketConnectionGroup):
        SoAdPduHeaderEnable = false
        SoAdResourceManagementEnable = false
        SoAdSocketAutomaticSoConSetup = false
        SoAdSocketFramePriority = 0
        SoAdSocketIpAddrAssignmentChgNotification = false
        SoAdSocketLocalPort = 13400
        SoAdSocketMsgAcceptanceFilterEnabled = true
        SoAdSocketSoConModeChgNotification = true
        SoAdSocketLocalAddressRef = TcpIpLocalAddr_Uni_10_184_133_253
        SoAdSocketConnection_DoIP_TCP (SoAdSocketConnection): UL_SoConModeChg=DoIP_SoConModeChg
          SoAdSocketRemoteAddress: SoAdSocketRemoteIpAddress=ANY, SoAdSocketRemotePort=0
        SoAdSocketProtocol
          SoAdSocketTcp: SoAdSocketTcpImmediateTpTxConfirmation=false, SoAdSocketTcpInitiate=false, SoAdSocketTcpNoDelay=true
      SoAdRoutingGroup_DoIP_UDP (SoAdRoutingGroup): SoAdRoutingGroupIsEnabledAtInit=true, SoAdRoutingGroupTxTriggerable=false
      SoAdRoutingGroup_DoIP_TCP (SoAdRoutingGroup): SoAdRoutingGroupIsEnabledAtInit=true, SoAdRoutingGroupTxTriggerable=false
      SoAdSocketRoute_DoIP_UDP_DISCOVERY (SoAdSocketRoute): SoAdRxSocketConnOrSocketConnBundleRef=SoAdSocketConnection_DoIP_UDP_DISCOVERY
        SoAdSocketRouteDest: SoAdRxUser=DoIP, SoAdRxUpperLayerType=IF, SoAdRxPduRef=RXFrame_EthernetUDP_Discovery, SoAdRxRoutingGroupRef=SoAdRoutingGroup_DoIP_UDP
      SoAdSocketRoute_DoIP_TCP (SoAdSocketRoute): SoAdRxSocketConnOrSocketConnBundleRef=SoAdSocketConnection_DoIP_TCP
        SoAdSocketRouteDest: SoAdRxUser=DoIP, SoAdRxUpperLayerType=TP, SoAdRxPduRef=RXFrame_EthernetTCP_SoAd2DoIP, SoAdRxRoutingGroupRef=SoAdRoutingGroup_DoIP_TCP
      4 x SoAdPduRoute, all with SoAdTxPduCollectionSemantics=SOAD_COLLECT_QUEUED:
        SoAdPduRoute_DoIP_UDP_TEST_EQUIPMENT: SoAdTxUpperLayerType=IF, SoAdTxUser=DoIP, SoAdTxPduRef=TXFrame_EthernetUDP_DoIP2SoAd
          SoAdPduRouteDest:
            SoAdTxUdpTriggerMode = TRIGGER_ALWAYS
            SoAdTxSocketConnOrSocketConnBundleRef = SoAdSocketConnection_DoIP_UDP_TEST_EQUIPMENT
            SoAdTxRoutingGroupRef = SoAdRoutingGroup_DoIP_UDP
        SoAdPduRoute_DoIP_UDP_DISCOVERY: SoAdTxUpperLayerType=IF, SoAdTxUser=DoIP, SoAdTxPduRef=TXFrame_EthernetUDP_Discovery
          SoAdPduRouteDest:
            SoAdTxUdpTriggerMode = TRIGGER_ALWAYS
            SoAdTxSocketConnOrSocketConnBundleRef = SoAdSocketConnection_DoIP_UDP_DISCOVERY
            SoAdTxRoutingGroupRef = SoAdRoutingGroup_DoIP_UDP
        SoAdPduRoute_DoIP_TCP: SoAdTxUpperLayerType=TP, SoAdTxUser=DoIP, SoAdTxPduRef=TXFrame_EthernetTCP_DoIP2SoAd
          SoAdPduRouteDest:
            SoAdTxUdpTriggerMode = TRIGGER_ALWAYS
            SoAdTxSocketConnOrSocketConnBundleRef = SoAdSocketConnection_DoIP_TCP
            SoAdTxRoutingGroupRef = SoAdRoutingGroup_DoIP_TCP
        SoAdPduRoute_XCP_UDP_TX: SoAdTxUpperLayerType=IF, SoAdTxUser=Xcp, SoAdTxPduRef=TXFrame_EthernetUDP_Xcp2SoAd
          SoAdPduRouteDest:
            SoAdTxUdpTriggerMode = TRIGGER_ALWAYS
            SoAdTxSocketConnOrSocketConnBundleRef = SoAdSocketConnection_UDP_XCP
            SoAdTxRoutingGroupRef = SoAdRoutingGroup_XCP_UDP
      SoAdSocketRoute_XCP_UDP_RX (SoAdSocketRoute): SoAdRxSocketConnOrSocketConnBundleRef=SoAdSocketConnection_UDP_XCP
        SoAdSocketRouteDest: SoAdRxUpperLayerType=IF, SoAdRxUser=Xcp, SoAdRxPduRef=RXFrame_EthernetUDP_SoAd2Xcp, SoAdRxRoutingGroupRef=SoAdRoutingGroup_XCP_UDP
      SoAdSocketConnectionGroup_XCP_UDP (SoAdSocketConnectionGroup):
        SoAdPduHeaderEnable = false
        SoAdResourceManagementEnable = false
        SoAdSocketAutomaticSoConSetup = false
        SoAdSocketFramePriority = 0
        SoAdSocketIpAddrAssignmentChgNotification = false
        SoAdSocketLocalPort = 13406
        SoAdSocketMsgAcceptanceFilterEnabled = true
        SoAdSocketSoConModeChgNotification = false
        SoAdSocketLocalAddressRef = TcpIpLocalAddr_Uni_10_184_133_253
        SoAdSocketProtocol
          SoAdSocketUdp: SoAdSocketUdpListenOnly=false
        SoAdSocketConnection_UDP_XCP (SoAdSocketConnection)
          SoAdSocketRemoteAddress: SoAdSocketRemoteIpAddress=10.184.133.27, SoAdSocketRemotePort=0
      SoAdRoutingGroup_XCP_UDP (SoAdRoutingGroup): SoAdRoutingGroupIsEnabledAtInit=true, SoAdRoutingGroupTxTriggerable=false
      SoAdPduRoute_XCP_TCP_TX (SoAdPduRoute): SoAdTxUpperLayerType=IF, SoAdTxUser=Xcp, SoAdTxPduCollectionSemantics=SOAD_COLLECT_QUEUED, SoAdTxPduRef=TXFrame_EthernetTCP_Xcp2SoAd
        SoAdPduRouteDest:
          SoAdTxUdpTriggerMode = TRIGGER_ALWAYS
          SoAdTxSocketConnOrSocketConnBundleRef = SoAdSocketConnection_TCP_XCP
          SoAdTxRoutingGroupRef = SoAdRoutingGroup_XCP_TCP
      SoAdSocketConnectionGroup_XCP_TCP (SoAdSocketConnectionGroup):
        SoAdPduHeaderEnable = false
        SoAdResourceManagementEnable = false
        SoAdSocketAutomaticSoConSetup = false
        SoAdSocketFramePriority = 0
        SoAdSocketIpAddrAssignmentChgNotification = false
        SoAdSocketLocalPort = 13406
        SoAdSocketMsgAcceptanceFilterEnabled = true
        SoAdSocketSoConModeChgNotification = false
        SoAdSocketLocalAddressRef = TcpIpLocalAddr_Uni_10_184_133_253
        SoAdSocketProtocol
          SoAdSocketTcp: SoAdSocketTcpImmediateTpTxConfirmation=0, SoAdSocketTcpInitiate=false, SoAdSocketTcpNoDelay=true
        SoAdSocketConnection_TCP_XCP (SoAdSocketConnection)
          SoAdSocketRemoteAddress: SoAdSocketRemoteIpAddress=10.184.133.27, SoAdSocketRemotePort=0
      SoAdRoutingGroup_XCP_TCP (SoAdRoutingGroup): SoAdRoutingGroupIsEnabledAtInit=true, SoAdRoutingGroupTxTriggerable=false
      SoAdSocketRoute_XCP_TCP_RX (SoAdSocketRoute): SoAdRxSocketConnOrSocketConnBundleRef=SoAdSocketConnection_TCP_XCP
        SoAdSocketRouteDest: SoAdRxUpperLayerType=IF, SoAdRxUser=Xcp, SoAdRxPduRef=RXFrame_EthernetTCP_SoAd2Xcp, SoAdRxRoutingGroupRef=SoAdRoutingGroup_XCP_TCP
    SoAdGeneral:
      SoAdDevErrorDetect = true
      SoAdIPv6AddressEnabled = 0
      SoAdChangeParameterEnabled = 0
      SoAdIPAddrAssignmentEnabled = 1
      SoAdTpCancelComEnabled = 0
      SoAdMainFunctionPeriod = 0.001
      SoAdRoutingGroupMax = 200
      SoAdSoConMax = 200
      SoAdVersionInfoApi = 1
      SoAdTpTcpTransmitRetryCount = 10000
      SoAdDHCPFQDNEnabled = false
      SoAdGetAndResetMeasurementDataApi = false
    DoIP (SoAdBswModules): SoAdIf=true, SoAdIfTriggerTransmit=false, SoAdIfTxConfirmation=true, SoAdTp=true, SoAdUseCallerInfix=true, SoAdUseTypeInfix=true, SoAdBswModuleRef=DoIP
    Xcp (SoAdBswModules): SoAdIf=true, SoAdIfTriggerTransmit=false, SoAdIfTxConfirmation=true, SoAdTp=false, SoAdUseCallerInfix=true, SoAdUseTypeInfix=true, SoAdBswModuleRef=Xcp
