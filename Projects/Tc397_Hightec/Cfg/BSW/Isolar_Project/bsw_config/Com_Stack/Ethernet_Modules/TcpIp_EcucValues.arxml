AUTOSAR XML (schema 4-2-2)
package /ETAS_Project/EcucModuleConfigurationValuess
  module config TcpIp: implementation-config-variant=VARIANT-PRE-COMPILE
    TcpIpConfig
      TcpIpCtrl_0 (TcpIpCtrl): TcpIpIpTtlConfigurationEnabled=false, TcpIpEthIfCtrlRef=EthernetCommunicationConnector
        TcpIpIpVXCtrl
          TcpIpIpV4Ctrl: TcpIpArpTblAgeingDisabled=false, TcpIpIcmpEchoBroadcastEnabled=true
      TcpIpIpConfig
        TcpIpIpV4Config
          TcpIpArpConfig: TcpIpArpMaxRequests=5, TcpIpArpNumGratuitousARPonStartup=1, TcpIpArpTableEntryTimeout=151, TcpIpArpTableSizeMax=10, TcpIpArpTblPendingEntryTimeout=2
          TcpIpIcmpConfig: TcpIpIcmpTtl=1
            TcpIpIcmpMsgHandler: TcpIpIcmpMsgHandlerHeaderFileName=rba_EthIcmp_Stubs.h, TcpIpIcmpMsgHandlerName=CDD_ULIcmpRxIndication
          TcpIpAutoIpConfig: TcpIpAutoIpInitTimeout=0.3
      TcpIpLocalAddr_Uni_10_184_133_253 (TcpIpLocalAddr): TcpIpAddressType=TCPIP_UNICAST, TcpIpDomainType=TCPIP_AF_INET, TcpIpCtrlRef=TcpIpCtrl_0
        TcpIpAddrAssignment_Static (TcpIpAddrAssignment): TcpIpAssignmentMethod=TCPIP_STATIC, TcpIpAssignmentPriority=3, TcpIpAssignmentTrigger=TCPIP_MANUAL
        TcpIpStaticIpAddressConfig: TcpIpNetmask=23, TcpIpStaticIpAddress=10.184.133.253, TcpIpDefaultRouter=10.184.132.1
        TcpIpAddrAssignment_LinkLocal (TcpIpAddrAssignment): TcpIpAssignmentMethod=TCPIP_LINKLOCAL_DOIP, TcpIpAssignmentPriority=2, TcpIpAssignmentTrigger=TCPIP_MANUAL
        TcpIpAddrAssignment_Dynamic (TcpIpAddrAssignment): TcpIpAssignmentMethod=TCPIP_DHCP, TcpIpAssignmentPriority=1, TcpIpAssignmentTrigger=TCPIP_MANUAL
      TcpIpTcpConfig:
        TcpIpTcpCongestionAvoidanceEnabled = false
        TcpIpTcpDlyAckEnabled = false
        TcpIpTcpDynReTxTimerEnabled = true
        TcpIpTcpDynReTxTimerUprBound = 60
        TcpIpTcpFastRecoveryEnabled = false
        TcpIpTcpFastRetransmitEnabled = false
        TcpIpTcpFinWait2Timeout = 3
        TcpIpTcpHalfDuplxCloseEnabled = false
        TcpIpTcpIsnGenerationMethod = PSEUDO_RANDOM
        TcpIpTcpKeepAliveEnabled = false
        TcpIpTcpKeepAliveInterval = 30
        TcpIpTcpKeepAliveProbesMax = 5
        TcpIpTcpKeepAliveTime = 7200
        TcpIpTcpMaxRtx = 3
        TcpIpTcpMaxTxBuffPerSock = 1500
        TcpIpTcpMsl = 2.0
        TcpIpTcpMSSEnabled = false
        TcpIpTcpNagleEnabled = false
        TcpIpTcpReceiveWindowMax = 1500
        TcpIpTcpRetransmissionTimeout = 1
        TcpIpTcpReTxEnabled = true
        TcpIpTcpSlowStartEnabled = false
        TcpIpTcpSynMaxRtx = 5
        TcpIpTcpSynReceivedTimeout = 1
        TcpIpTcpTtl = 5
        TcpIpTcpUserTimeout = 15
        TcpIpTcpUserTimeoutEnabled = false
        TcpIpTcpZWPEnabled = true
        TcpIpTcpZWPMaxRetries = 100
      TcpIpUdpConfig: TcpIpUdpTtl=3
      TcpIpSocketOwnerConfig
        TcpIpSocketOwner: TcpIpSocketOwnerUpperLayerType=SOAD
    TcpIpGeneral:
      TcpIpDevErrorDetect = true
      TcpIpMainFunctionPeriod = 0.001
      TcpIpScalabilityClass = SC1
      TcpIpTcpSocketMax = 10
      TcpIpUdpSocketMax = 10
      TcpIpVersionInfoApi = true
      TcpIpGetAndResetMeasurementDataApi = false
      TcpIpIpV4General: TcpIpIcmpEnabled=true
        TcpIpDHCPGeneral
          TcpIpDHCPClientGeneral: TcpIpDHCPTimeToWaitBeforeReTx=1.0
