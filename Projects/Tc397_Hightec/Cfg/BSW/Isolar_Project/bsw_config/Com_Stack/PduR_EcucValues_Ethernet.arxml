AUTOSAR XML (schema 4-2-2)
package /ETAS_Project/EcucModuleConfigurationValuess
  module config PduR: implementation-config-variant=VARIANT-PRE-COMPILE
    SoAdIf (PduRBswModules):
      PduRCancelReceive = false
      PduRCancelTransmit = false
      PduRChangeParameterApi = false
      PduRCommunicationInterface = true
      PduRLowerModule = true
      PduRRetransmission = false
      PduRTransportProtocol = false
      PduRTriggertransmit = true
      PduRTxConfirmation = true
      PduRUpperModule = false
      PduRUseTag = false
      PduRBswModuleRef = SoAd
      PduRInvalidHandlers: PduRIHCancelReceive=false, PduRIHCancelTransmit=true
    PduRRoutingTables
      PduRRoutingTable
        6 x PduRRoutingPath:
          PduRRoutingPath_UDP_ComTX
            TXFrame_EthernetUDP_PduR2SoAd_Dest (PduRDestPdu): PduRDestPduDataProvision=PDUR_DIRECT, PduRDestPduRef=TXFrame_EthernetUDP_PduR2SoAd
            TXFrame_EthernetUDP_Com2PduR_Src (PduRSrcPdu): PduRSrcPduUpTxConf=1, PduRSrcPduRef=TXFrame_EthernetUDP_Com2PduR
          PduRRoutingPath_UDP_ComRX
            RXFrame_EthernetUDP_PduR2Com_Dest (PduRDestPdu): PduRDestPduRef=RXFrame_EthernetUDP_PduR2Com
            RXFrame_EthernetUDP_SoAd2PduR_Src (PduRSrcPdu): PduRSrcPduUpTxConf=1, PduRSrcPduRef=RXFrame_EthernetUDP_SoAd2PduR
          PduRRoutingPath_TCP_ComTX
            TXFrame_EthernetTCP_PduR2SoAd_Dest (PduRDestPdu): PduRDestPduDataProvision=PDUR_DIRECT, PduRDestPduRef=TXFrame_EthernetTCP_PduR2SoAd
            TXFrame_EthernetTCP_Com2PduR_Src (PduRSrcPdu): PduRSrcPduUpTxConf=1, PduRSrcPduRef=TXFrame_EthernetTCP_Com2PduR
          PduRRoutingPath_TCP_ComRX
            RXFrame_EthernetTCP_SoAd2PduR_Src (PduRSrcPdu): PduRSrcPduUpTxConf=1, PduRSrcPduRef=RXFrame_EthernetTCP_SoAd2PduR
            RXFrame_EthernetTCP_PduR2Com_Dest (PduRDestPdu): PduRDestPduRef=RXFrame_EthernetTCP_PduR2Com
          PduRRoutingPath_DoIP_Dcm2DoIP
            PduRSrcPdu_DoIP_Dcm2PduR (PduRSrcPdu): PduRSrcPduRef=TXFrame_Ethernet_Dcm2PduR
            PduRDestPdu_DoIP_PduR2DoIP (PduRDestPdu): PduRDestPduRef=TXFrame_Ethernet_PduR2DoIP
          PduRRoutingPath_DoIP_DoIP2Dcm
            PduRSrcPdu_DoIP_DoIP2PduR (PduRSrcPdu): PduRSrcPduRef=RXFrame_Ethernet_DoIP2PduR
            PduRDestPdu_DoIP_PduR2Dcm (PduRDestPdu): PduRDestPduRef=RXFrame_Ethernet_PduR2Dcm
    DoIP (PduRBswModules):
      PduRCancelReceive = true
      PduRCancelTransmit = true
      PduRChangeParameterApi = false
      PduRCommunicationInterface = false
      PduRLowerModule = true
      PduRRetransmission = false
      PduRTransportProtocol = true
      PduRTriggertransmit = false
      PduRTxConfirmation = true
      PduRUpperModule = false
      PduRUseTag = false
      PduRBswModuleRef = DoIP
      PduRInvalidHandlers: PduRIHCancelReceive=true, PduRIHCancelTransmit=true
