AUTOSAR XML (schema 4-2-2)
package /ETAS_Project/EcucModuleConfigurationValuess
  module config Xcp
    XcpConfig
      XcpTransportLayer_CAN (XcpTransportLayer):
        XcpDaqOverloadIndication = OVERLOAD_INDICATION_EVENT
        XcpIdentificationFieldType = ABSOLUTE
        XcpTimestampType = TWO_BYTE
        XcpTransportLayerName = CAN_0_PL0
        XcpTransportLayerType = CAN
        XcpMaxCto = 8
        XcpMaxDto = 8
        XcpRxPdu_RX_CMD (XcpRxPdu): XcpRxPacketType=CMD, XcpRxPduRef=XCP_RX_CMD_Can_Network_CANNODE_1_CanIf2Xcp
        XcpTxPdu_RES (XcpTxPdu): XcpTxPacketType=RES_ERR_EV_SERV, XcpTxPduRef=XCP_TX_RES_Can_Network_CANNODE_1_Xcp2CanIf
        XcpRxPdu_RX_Broadcast (XcpRxPdu): XcpRxPacketType=STIM, XcpRxPduRef=XCP_RX_Broadcast_Can_Network_CANNODE_1_CanIf2Xcp
        3 x XcpTxPdu, all with XcpTxPacketType=DAQ:
          XcpTxPdu_DAQ0: XcpTxPduRef=XCP_TX_DAQ0_Can_Network_CANNODE_1_Xcp2CanIf, XcpEventChannelRef=Event_10ms_Raster
          XcpTxPdu_DAQ1: XcpTxPduRef=XCP_TX_DAQ1_Can_Network_CANNODE_1_Xcp2CanIf, XcpEventChannelRef=Event_50ms_Raster
          XcpTxPdu_DAQ2: XcpTxPduRef=XCP_TX_DAQ2_Can_Network_CANNODE_1_Xcp2CanIf, XcpEventChannelRef=Event_100ms_Raster
      3 x XcpEventChannel, all with XcpEventChannelType=DAQ:
        Event_10ms_Raster: XcpEventChannelName=10msRStr, XcpEventChannelShortName=10ms, XcpEventChannelPriority=8, XcpEventChannelTimeCycle=1, XcpEventChannelTimeUnit=TIMESTAMP_UNIT_10MS
        Event_100ms_Raster: XcpEventChannelName=100msRStr, XcpEventChannelShortName=100ms, XcpEventChannelPriority=10, XcpEventChannelTimeCycle=1, XcpEventChannelTimeUnit=TIMESTAMP_UNIT_100MS
        Event_50ms_Raster: XcpEventChannelName=50msRStr, XcpEventChannelShortName=50ms, XcpEventChannelPriority=9, XcpEventChannelTimeCycle=5, XcpEventChannelTimeUnit=TIMESTAMP_UNIT_10MS
      XcpTransportLayer_ETH_UDP (XcpTransportLayer):
        XcpDaqOverloadIndication = OVERLOAD_INDICATION_EVENT
        XcpIdentificationFieldType = ABSOLUTE
        XcpTimestampType = TWO_BYTE
        XcpTransportLayerType = ETHERNET_UDP
        XcpMaxCto = 255
        XcpMaxDto = 255
        XcpFrameConcatenation = true
        XcpTransportLayerName = UDP_0_PL0
        XcpRxPdu_UDP_RX (XcpRxPdu): XcpRxPacketType=CMD_STIM, XcpRxPduRef=RXFrame_EthernetUDP_SoAd2Xcp
        XcpTxPdu_UDP_TX (XcpTxPdu): XcpTxPacketType=RES_ERR_EV_SERV_DAQ, XcpTxPduRef=TXFrame_EthernetUDP_Xcp2SoAd
      XcpTransportLayer_ETH_TCP (XcpTransportLayer):
        XcpDaqOverloadIndication = OVERLOAD_INDICATION_EVENT
        XcpIdentificationFieldType = ABSOLUTE
        XcpTimestampType = TWO_BYTE
        XcpTransportLayerType = ETHERNET_TCP
        XcpMaxCto = 255
        XcpMaxDto = 255
        XcpFrameConcatenation = true
        XcpTransportLayerName = TCP_0_PL0
        XcpRxPdu_TCP_RX (XcpRxPdu): XcpRxPacketType=CMD_STIM, XcpRxPduRef=RXFrame_EthernetTCP_SoAd2Xcp
        XcpTxPdu_TCP_TX (XcpTxPdu): XcpTxPacketType=RES_ERR_EV_SERV_DAQ, XcpTxPduRef=TXFrame_EthernetTCP_Xcp2SoAd
    XcpGeneral:
      XcpCalibrationCal = true
      XcpSynchronousDataAcquisitionDaq = true
      XcpBlockTransferUpload = true
      XcpBlockTransferDownload = true
      XcpSeedAndKey = true
      XcpCommandChecksum = true
      XcpUploadDownloadMemoryAccessByAppl = true
      XcpCommandReadDaq = true
      XcpCommandsGetDaqInfo = true
      XcpEventChannelScheduling = true
      XcpVersion = VERSION_1_2
      XcpProductLine = CSMOSAR
      XcpDaqMemoryLimit = 1024
      XcpDevErrorDetect = true
      XcpMainFunctionPeriod = 0.01
      XcpSeedAndKeyExternalFunction = XcpSeedNKey.dll
      XcpVersionInfoApi = false
      XcpPageSwitchingPag = true
      XcpTimestampUnit = TIMESTAMP_UNIT_1MS
      XcpTimestampTicks = 1
      XcpEthMainFunctionPeriod = 0.001
    XcpA2LFile: XcpTimeoutT1=2000, XcpTimeoutT2=2000, XcpTimeoutT7=2000
