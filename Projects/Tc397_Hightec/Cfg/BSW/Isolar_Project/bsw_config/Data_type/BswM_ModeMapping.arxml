AUTOSAR XML (schema 4-2-2)
package /AUTOSAR_BswM/ModeDeclarationGroups
  mode declaration group MDG_ECUM_STATE: category=ALPHABETIC_ORDER, initial-mode=ECUM_STATE_STARTUP_ONE
    7 x mode:
      ECUM_STATE_STARTUP_ONE: value=1
      ECUM_STATE_STARTUP_TWO: value=2
      ECUM_STATE_RUN: value=3
      ECUM_STATE_SHUTDOWN: value=7
      ECUM_STATE_POST_RUN: value=5
      ECUM_STATE_PREP_SHUTDOWN: value=6
      ECUM_STATE_APP_RUN: value=4
  data type mapping set ECUM_STATE_Mapping: mode-request-type-map{implementation-data-type=uint8, mode-group=MDG_ECUM_STATE}
