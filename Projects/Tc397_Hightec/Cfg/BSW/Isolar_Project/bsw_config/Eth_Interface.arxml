AUTOSAR XML (schema 4-2-2)
package /Eth_Interface
  6 x sender receiver interface:
    SR_Interface_SystemSignal_TCP_Tx
      data PPort_SystemSignal_TCP_TX: type=uint32
    SR_Interface_SystemSignal_TCP_Rx
      data RPort_SystemSignal_TCP_RX: type=uint32
    SR_Interface_SystemSignal_UDP_Tx
      data PPort_SystemSignal_UDP_TX: type=Com_impl_u32
    SR_Interface_SystemSignal_UDP_Rx
      data RPort_SystemSignal_UDP_RX: type=Com_impl_u32
    SR_Interface_SerialisedAppRecord_Rx
      data DataElements_SerialisedAppRecord_Rx: type=ApplicationRecordDataType
    SR_Interface_SerialisedAppRecord_Tx
      data DataElements_SerialisedAppRecord_Tx: type=ApplicationRecordDataType
package /Eth_DataTypes
  application record data type ApplicationRecordDataType: category=STRUCTURE
    application record element ApplicationRecordElement_0: category=VALUE, type=uint8_App
    application record element ApplicationRecordElement_1: category=VALUE, type=uint16_App
    application record element ApplicationRecordElement_2: category=VALUE, type=uint32_App
  app type uint16_App: category=VALUE, compu-method=Identical
  app type uint32_App: category=VALUE, compu-method=Identical
  app type uint8_App: category=VALUE, compu-method=Identical
package /Eth_DataTypeMappingSet
  data type mapping set DataTypeMappingSet
    data-type-maps:
      application-data-type=uint8_App, implementation-data-type=Eth_uint8
      application-data-type=uint16_App, implementation-data-type=Eth_uint16
      application-data-type=uint32_App, implementation-data-type=Eth_uint32
      application-data-type=ApplicationRecordDataType, implementation-data-type=Eth_SomeIp_ImpRecordDataType
package /AR_ImpDataType
  4 x impl type:
    Eth_uint16: implementation-data-type=uint16
    Eth_uint8: implementation-data-type=uint8
    Eth_uint32: implementation-data-type=uint32
    Eth_SomeIp_ImpRecordDataType: category=STRUCTURE
      element Eth_SomeIp_uint8: implementation-data-type=Eth_uint8
      element Eth_SomeIp_uint16: implementation-data-type=Eth_uint16
      element Eth_SomeIp_uint32: implementation-data-type=Eth_uint32
