AUTOSAR XML (schema 4-2-2)
package /ETAS_Project/EcucModuleConfigurationValuess
  module config NvM
    7 x NvMBlockDescriptor, all with NvMBlockCrcType=NVM_CRC16, NvMBlockUseSyncMechanism=false, NvMRbFirstReadDataMigration=false, NvMRbGenRteAdminPort=false, NvMRbGenRteServicePort=false, NvMRbInitBlockAtLayoutChange=false, NvMRbResistantToLayoutRemoval=false, NvMRbSelectBlockForFirstInitAll=false, NvMSelectBlockForReadAll=true, NvMSelectBlockForWriteAll=true, NvMBlockJobPriority=1, NvMBlockManagementType=NVM_BLOCK_NATIVE, NvMBlockUseCrc=true, NvMBlockWriteProt=false, NvMInitBlockCallback=NULL_PTR, NvMMaxNumOfReadRetries=0, NvMMaxNumOfWriteRetries=0, NvMNvBlockNum=1, NvMNvramDeviceId=0, NvMResistantToChangedSw=false, NvMRomBlockNum=1, NvMStaticBlockIDCheck=false, NvMWriteBlockOnce=false, NvMWriteVerification=false, NvMWriteVerificationDataSize=0:
      NV_ExternalReprogrammingRequestFlagBlock: NvMRbNoFallback=false, NvMNvBlockLength=1, NvMRamBlockDataAddress=Fbl_DataM_RamMirrorNV_ReprogrammingRequestFlagBlock, NvMRomBlockDataAddress=Fbl_DataM_RomDataNV_ReprogrammingRequestFlagBlock
      NV_ValidityFlagsBlock: NvMRbNoFallback=false, NvMNvBlockLength=1, NvMRamBlockDataAddress=Fbl_DataM_RamMirrorNV_ValidityFlagsBlock, NvMRomBlockDataAddress=Fbl_DataM_RomDataNV_ValidityFlagsBlock
      NV_ResetResponseFlagBlock: NvMRbNoFallback=false, NvMNvBlockLength=1, NvMRamBlockDataAddress=Fbl_DataM_RamMirrorNV_ResetResponseBlock, NvMRomBlockDataAddress=Fbl_DataM_RomDataNV_ResetResponseBlock
      NV_PartNumberBlock: NvMRbNoFallback=true, NvMNvBlockLength=32, NvMRamBlockDataAddress=Fbl_DataM_RamMirrorNV_PartNumberBlock, NvMRomBlockDataAddress=Fbl_DataM_RomDataNV_PartNumberBlock, NvMRbRamInitUnconditional=true
      NV_CrcBlock: NvMBlockUseAutoValidation=false, NvMCalcRamBlockCrc=false, NvMRbNoFallback=false, NvMNvBlockLength=8, NvMRamBlockDataAddress=Fbl_DataM_RamMirrorNV_CrcBlock, NvMRomBlockDataAddress=Fbl_DataM_RomDataNV_CrcBlock
      NV_ProgrammingAttemptCounterBlock: NvMRbNoFallback=false, NvMNvBlockLength=4, NvMRamBlockDataAddress=Fbl_DataM_RamMirrorNV_ProgrammingAttemptCounterBlock, NvMRomBlockDataAddress=Fbl_DataM_RomDataNV_ProgrammingAttemptCounterBlock
      NV_ProgrammingCounterBlock: NvMBlockUseAutoValidation=false, NvMCalcRamBlockCrc=false, NvMRbNoFallback=false, NvMNvBlockLength=4, NvMRamBlockDataAddress=Fbl_DataM_RamMirrorNV_ProgrammingCounterBlock, NvMRomBlockDataAddress=Fbl_DataM_RomDataNV_ProgrammingCounterBlock
