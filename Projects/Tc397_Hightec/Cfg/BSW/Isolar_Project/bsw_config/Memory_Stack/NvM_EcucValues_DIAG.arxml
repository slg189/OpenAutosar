AUTOSAR XML (schema 4-2-2)
package /ETAS_Project/EcucModuleConfigurationValuess
  module config NvM: implementation-config-variant=VARIANT-PRE-COMPILE
    4 x NvMBlockDescriptor, all with NvMBlockUseSyncMechanism=false, NvMSelectBlockForReadAll=true, NvMSelectBlockForWriteAll=true, NvMBlockJobPriority=1, NvMBlockManagementType=NVM_BLOCK_NATIVE, NvMBlockUseCrc=true, NvMBlockWriteProt=false, NvMInitBlockCallback=NULL_PTR, NvMMaxNumOfReadRetries=0, NvMMaxNumOfWriteRetries=0, NvMNvBlockNum=1, NvMNvramDeviceId=0, NvMResistantToChangedSw=false, NvMRomBlockNum=0, NvMStaticBlockIDCheck=false, NvMWriteBlockOnce=false, NvMWriteVerification=false, NvMWriteVerificationDataSize=0, NvMBlockCrcType=NVM_CRC16:
      NvMBlockDescriptor_DID_VehicleSpeed: NvMNvBlockLength=17, NvMRamBlockDataAddress=RamBlock_DID_VehicleSpeed
      NvMBlockDescriptor_DID_SystemFaultRank: NvMNvBlockLength=4, NvMRamBlockDataAddress=RamBlock_DID_SystemFaultRank
      NvMBlockDescriptor_DID_IOControl: NvMNvBlockLength=17, NvMRamBlockDataAddress=RamBlock_DID_IOControl
      NvMBlockDescriptor_ReadWritebyAddress: NvMNvBlockLength=4, NvMRamBlockDataAddress=RamBlock_DID_ReadWritebyAddress
