AUTOSAR XML (schema 4-2-2)
package /ETAS_Project/EcucModuleConfigurationValuess
  module config BswM
    BswMGeneral:
      BswMCanSMEnabled = true
      BswMComMEnabled = 1
      BswMDcmEnabled = true
      BswMDevErrorDetect = true
      BswMEcuMEnabled = true
      BswMEthSMEnabled = true
      BswMFrSMEnabled = false
      BswMGenericRequestEnabled = true
      BswMLinSMEnabled = false
      BswMLinTPEnabled = false
      BswMMainFunctionPeriod = 0.01
      BswMNvMEnabled = true
      BswMSchMEnabled = true
      BswMSdEnabled = false
      BswMVersionInfoApi = true
      BswMRbDebugEnable = false
      BswMRbIntrptQueueMaxSize = 5
      BswMEthIfEnabled = true
      BswMJ1939DcmEnabled = false
      BswMJ1939NmEnabled = false
      BswMNmEnabled = false
      BswMRbMaxNumOfRules = 30
      BswMRbComEnabled = true
      BswMUserIncludeFiles:
        BswMUserIncludeFile = Stubs.h
        BswMUserIncludeFile = Rte_Main.h
        BswMUserIncludeFile = CanSM_ComM.h
        BswMUserIncludeFile = CanIf.h
        BswMUserIncludeFile = Fee.h
        BswMUserIncludeFile = Adc.h
    BswMConfig
      BswMArbitration
        6 x BswMLogicalExpression:
          BswM_LE_StartupOne: BswMArgumentRef=BswM_MC_BswM_StartupOne
          BswM_LE_StartupTwo: BswMLogicalOperator=BSWM_AND, BswMArgumentRef=BswM_MC_BswM_StartupTwo, BswMArgumentRef=BswM_MC_BswModules_ReadAllComplete
          BswM_LE_Run: BswMArgumentRef=BswM_MC_BswM_Run
          BswM_LE_AppRequestShutdown: BswMArgumentRef=BswM_MC_BswM_AppRequestShutdown
          BswM_LE_PrepShutdown: BswMArgumentRef=BswM_MC_BswM_PrepShutdown
          BswM_LE_Shutdown: BswMLogicalOperator=BSWM_AND, BswMArgumentRef=BswM_MC_BswM_Shutdown, BswMArgumentRef=BswM_MC_BswModules_WriteAllComplete
        6 x BswMModeCondition, all with BswMConditionType=BSWM_EQUALS:
          BswM_MC_BswM_StartupOne: BswMConditionMode=BswM_MRP_BswM_MDG
            BswM_MC_Val (BswMConditionValue)
              BswMModeDeclaration: BswMModeValueRef=ECUM_STATE_STARTUP_ONE
          BswM_MC_BswM_StartupTwo: BswMConditionMode=BswM_MRP_BswM_MDG
            BswM_MC_Val (BswMConditionValue)
              BswMModeDeclaration: BswMModeValueRef=ECUM_STATE_STARTUP_TWO
          BswM_MC_BswM_Run: BswMConditionMode=BswM_MRP_BswM_MDG
            BswM_MC_Val (BswMConditionValue)
              BswMModeDeclaration: BswMModeValueRef=ECUM_STATE_RUN
          BswM_MC_BswM_AppRequestShutdown: BswMConditionMode=BswMArbitration/BswMSwcModeRequest
            BswM_MC_Val (BswMConditionValue)
              BswMModeDeclaration: BswMModeValueRef=SWC_REQUEST_SHUTDOWN
          BswM_MC_BswM_PrepShutdown: BswMConditionMode=BswM_MRP_BswM_MDG
            BswM_MC_Val (BswMConditionValue)
              BswMModeDeclaration: BswMModeValueRef=ECUM_STATE_PREP_SHUTDOWN
          BswM_MC_BswM_Shutdown: BswMConditionMode=BswM_MRP_BswM_MDG
            BswM_MC_Val (BswMConditionValue)
              BswMModeDeclaration: BswMModeValueRef=ECUM_STATE_SHUTDOWN
        BswM_MRP_BswM_MDG (BswMModeRequestPort): BswMRequestProcessing=BSWM_IMMEDIATE
          BswMModeRequestSource
            BswMBswModeNotification: BswMRbBswModeDeclarationGroup=/AUTOSAR_BswM/ModeDeclarationGroups/MDG_ECUM_STATE
        6 x BswMRule, all with BswMRuleInitState=BSWM_FALSE:
          BswM_AR_StartupOne: BswMRuleExpressionRef=BswM_LE_StartupOne, BswMRuleTrueActionList=BswM_AL_BswMSwitchStartupTwo
          BswM_AR_StartupTwo: BswMRuleExpressionRef=BswM_LE_StartupTwo, BswMRuleTrueActionList=BswM_AL_BswMSwitchRun
          BswM_AR_Run: BswMRuleExpressionRef=BswM_LE_Run, BswMRuleTrueActionList=BswM_AL_BswMSwitchAppRun
          BswM_AR_AppRequestShutdown: BswMRuleExpressionRef=BswM_LE_AppRequestShutdown, BswMRuleTrueActionList=BswM_AL_BswMSwitchPrepShutdown
          BswM_AR_Shutdown: BswMRuleExpressionRef=BswM_LE_PrepShutdown, BswMRuleTrueActionList=BswM_AL_BswMSwitchShutdown
          BswM_AR_Godown: BswMRuleExpressionRef=BswM_LE_Shutdown, BswMRuleTrueActionList=BswM_AL_BswMSwitchGoDown
        3 x BswMModeRequestPort:
          BswMSwcModeRequest: BswMRequestProcessing=BSWM_DEFERRED
            BswMModeRequestSource
              BswMSwcModeRequest: BswMRbModeRequestQueueSize=0, BswMSwcModeRequestVariableDataPrototypeRef=AppMode
              BswMSwcModeRequest: BswMRbModeRequestQueueSize=0
            BswMModeInitValue
          BswM_MRP_NvMReadAllComplete: BswMRequestProcessing=BSWM_IMMEDIATE
            BswMModeRequestSource_0 (BswMModeRequestSource)
              BswMNvMJobModeIndication: BswMNvmService=NvmReadAll
            BswMModeInitValue: BswMBswModeInitValue=NVM_REQ_PENDING
          BswM_MRP_NvMWriteAllComplete: BswMRequestProcessing=BSWM_IMMEDIATE
            BswMModeRequestSource_0 (BswMModeRequestSource)
              BswMNvMJobModeIndication: BswMNvmService=NvmWriteAll
            BswMModeInitValue: BswMBswModeInitValue=NVM_REQ_PENDING
        BswM_MC_BswModules_ReadAllComplete (BswMModeCondition): BswMConditionType=BSWM_EQUALS_NOT, BswMConditionMode=BswM_MRP_NvMReadAllComplete
          BswMConditionValue
            BswMBswMode: BswMBswRequestedMode=NVM_REQ_PENDING
        BswM_MC_BswModules_WriteAllComplete (BswMModeCondition): BswMConditionType=BSWM_EQUALS_NOT, BswMConditionMode=BswM_MRP_NvMWriteAllComplete
          BswMConditionValue
            BswMBswMode: BswMBswRequestedMode=NVM_REQ_PENDING
        4 x BswMLogicalExpression:
          BswM_LE_DCM_ENABLE_RX_TX_NORM: BswMArgumentRef=BswM_MC_DCM_ENABLE_RX_TX_NORM
          BswM_LE_DCM_DISABLE_RX_TX_NORM: BswMArgumentRef=BswM_MC_DCM_DISABLE_RX_TX_NORM
          BswM_LE_DCM_ENABLE_RX_DISABLE_TX_NORM: BswMArgumentRef=BswM_MC_DCM_ENABLE_RX_DISABLE_TX_NORM
          BswM_LE_DCM_DISABLE_RX_ENABLE_TX_NORM: BswMArgumentRef=BswM_MC_DCM_DISABLE_RX_ENABLE_TX_NORM
        4 x BswMModeCondition, all with BswMConditionType=BSWM_EQUALS, BswMConditionMode=BswM_MRP_DCM_ComModeRequest_ECAN:
          BswM_MC_DCM_ENABLE_RX_TX_NORM
            BswMConditionValue
              BswMBswMode: BswMBswRequestedMode=DCM_ENABLE_RX_TX_NORM
          BswM_MC_DCM_DISABLE_RX_TX_NORM
            BswMConditionValue
              BswMBswMode: BswMBswRequestedMode=DCM_DISABLE_RX_TX_NORMAL
          BswM_MC_DCM_ENABLE_RX_DISABLE_TX_NORM
            BswMConditionValue
              BswMBswMode: BswMBswRequestedMode=DCM_ENABLE_RX_DISABLE_TX_NORM
          BswM_MC_DCM_DISABLE_RX_ENABLE_TX_NORM
            BswMConditionValue
              BswMBswMode: BswMBswRequestedMode=DCM_DISABLE_RX_ENABLE_TX_NORM
        BswM_MRP_DCM_ComModeRequest_ECAN (BswMModeRequestPort): BswMRequestProcessing=BSWM_IMMEDIATE
          BswMModeRequestSource_0 (BswMModeRequestSource)
            BswMDcmComModeRequest: BswMDcmComMChannelRef=ComMChannel_Can_Network_Channel
        4 x BswMRule, all with BswMRuleInitState=BSWM_FALSE:
          BswM_AR_DCM_ENABLE_RX_TX_NORM: BswMRuleExpressionRef=BswM_LE_DCM_ENABLE_RX_TX_NORM, BswMRuleTrueActionList=BswM_AL_DCM_ENABLE_RX_TX_NORM
          BswM_AR_DCM_DISABLE_RX_TX_NORM: BswMRuleExpressionRef=BswM_LE_DCM_DISABLE_RX_TX_NORM, BswMRuleTrueActionList=BswM_AL_DCM_DISABLE_RX_TX_NORM
          BswM_AR_DCM_ENABLE_RX_DISABLE_TX_NORM: BswMRuleExpressionRef=BswM_LE_DCM_ENABLE_RX_DISABLE_TX_NORM, BswMRuleTrueActionList=BswM_AL_DCM_ENABLE_RX_DISABLE_TX_NORM
          BswM_AR_DCM_DISABLE_RX_ENABLE_TX_NORM: BswMRuleExpressionRef=BswM_LE_DCM_DISABLE_RX_ENABLE_TX_NORM, BswMRuleTrueActionList=BswM_AL_DCM_DISABLE_RX_ENABLE_TX_NORM
        BswM_MRP_ControllerStateAlreadyStarted (BswMModeRequestPort): BswMRequestProcessing=BSWM_DEFERRED
          BswMModeRequestSource
            BswMCanSMIndication: BswMCanSMChannelRef=ComMChannel_Can_Network_Channel
        BswM_MC_BswM_ControllerStateAlreadyStarted (BswMModeCondition): BswMConditionType=BSWM_EQUALS, BswMConditionMode=BswM_MRP_ControllerStateAlreadyStarted
          BswMConditionValue
            BswMBswMode: BswMBswRequestedMode=CANIF_CS_STARTED
        BswM_MC_BswM_AppRun (BswMModeCondition): BswMConditionType=BSWM_EQUALS, BswMConditionMode=BswM_MRP_BswM_MDG
          BswMConditionValue
            BswMModeDeclaration: BswMModeValueRef=ECUM_STATE_APP_RUN
        Bsw_AR_AppRun (BswMRule): BswMRuleInitState=BSWM_FALSE, BswMRuleExpressionRef=BswM_LE_AppRun, BswMRuleTrueActionList=BswM_AL_BswMInAppRun
        BswM_AR_DCM_ENABLE_NM (BswMRule): BswMRuleInitState=BSWM_FALSE, BswMRuleExpressionRef=BswM_LE_DCM_ENABLE_NM, BswMRuleTrueActionList=BswM_AL_DCM_ENABLE_TX_RX_NM
        3 x BswMLogicalExpression:
          BswM_LE_DCM_ENABLE_NM: BswMArgumentRef=BswM_MC_DCM_ENABLE_NM
          BswM_LE_AppRun: BswMLogicalOperator=BSWM_AND, BswMArgumentRef=BswM_MC_BswM_AppRun, BswMArgumentRef=BswM_MC_BswM_ControllerStateAlreadyStarted, BswMArgumentRef=BswM_MC_BswM_ControllerStateAlreadyStarted_XCP
          BswM_LE_DCM_DISABLE_NM: BswMArgumentRef=BswM_MC_DCM_DISABLE_NM
        BswM_MC_DCM_ENABLE_NM (BswMModeCondition): BswMConditionType=BSWM_EQUALS, BswMConditionMode=BswM_MRP_DCM_ComModeRequest_ECAN
          BswMConditionValue
            BswMBswMode: BswMBswRequestedMode=DCM_ENABLE_RX_TX_NM
        BswM_MC_DCM_DISABLE_NM (BswMModeCondition): BswMConditionType=BSWM_EQUALS, BswMConditionMode=BswM_MRP_DCM_ComModeRequest_ECAN
          BswMConditionValue
            BswMBswMode: BswMBswRequestedMode=DCM_DISABLE_RX_TX_NM
        BswM_AR_DCM_DISABLE_NM (BswMRule): BswMRuleInitState=BSWM_FALSE, BswMRuleExpressionRef=BswM_LE_DCM_DISABLE_NM, BswMRuleTrueActionList=BswM_AL_DCM_DISABLE_TX_RX_NM
        BswM_MRP_ControllerStateAlreadyStarted_XCP (BswMModeRequestPort): BswMRequestProcessing=BSWM_DEFERRED
          BswMModeRequestSource_0 (BswMModeRequestSource)
            BswMCanSMIndication: BswMCanSMChannelRef=ComMChannel_Can_Network_XCP_Channel
        BswM_MC_BswM_ControllerStateAlreadyStarted_XCP (BswMModeCondition): BswMConditionType=BSWM_EQUALS, BswMConditionMode=BswM_MRP_ControllerStateAlreadyStarted_XCP
          BswMConditionValue
            BswMBswMode: BswMBswRequestedMode=CANIF_CS_STARTED
        BswM_MRP_SWC_Network (BswMModeRequestPort): BswMRequestProcessing=BSWM_DEFERRED
          BswMModeRequestSource_0 (BswMModeRequestSource)
            BswMSwcModeRequest: BswMRbModeRequestQueueSize=0, BswMSwcModeRequestVariableDataPrototypeRef=uint8
            BswMSwcModeRequest: BswMRbModeRequestQueueSize=0
        BswM_MC_NetworkRequest (BswMModeCondition): BswMConditionType=BSWM_EQUALS, BswMConditionMode=BswM_MRP_SWC_Network
          BswMConditionValue
            BswMModeDeclaration: BswMModeValueRef=COMM_FULL_COMMUNICATION
        BswM_MC_NetworkRelease (BswMModeCondition): BswMConditionType=BSWM_EQUALS, BswMConditionMode=BswM_MRP_SWC_Network
          BswMConditionValue
            BswMModeDeclaration: BswMModeValueRef=COMM_NO_COMMUNICATION
        BswM_LE_NetworkRequest (BswMLogicalExpression): BswMArgumentRef=BswM_MC_NetworkRequest
        BswM_LE_NetworkRelease (BswMLogicalExpression): BswMArgumentRef=BswM_MC_NetworkRelease
        BswM_AR_NetworkRequest (BswMRule): BswMRuleInitState=BSWM_FALSE, BswMRuleExpressionRef=BswM_LE_NetworkRequest, BswMRuleTrueActionList=BswM_AL_NetworkRequest
        BswM_AR_NetworkRelease (BswMRule): BswMRuleInitState=BSWM_FALSE, BswMRuleExpressionRef=BswM_LE_NetworkRelease, BswMRuleTrueActionList=BswM_AL_NetworkRelease
        5 x BswMModeRequestPort, all with BswMRequestProcessing=BSWM_IMMEDIATE:
          BswM_MRP_ComMIndication_Can0
            BswMModeRequestSource
              BswMComMIndication: BswMComMChannelRef=ComMChannel_Can_Network_Channel
          BswM_MRP_ComMIndication_Can1
            BswMModeRequestSource
              BswMComMIndication: BswMComMChannelRef=ComMChannel_Can_Network_XCP_Channel
          BswM_MRP_ComMIndication_Eth
            BswMModeRequestSource
              BswMComMIndication: BswMComMChannelRef=Eth_Network_Channel_EthernetCluster
          BswM_MRP_WKSOURCE_KL15
            BswMModeRequestSource
              BswMEcuMWakeupSource: BswMEcuMWakeupSrcRef=ECUM_WKSOURCE_KL15
          BswM_MRP_WKSOURCE_CANMSG
            BswMModeRequestSource
              BswMEcuMWakeupSource: BswMEcuMWakeupSrcRef=ECUM_WKSOURCE_CANMSG
        BswM_MC_WKUP_KL15 (BswMModeCondition): BswMConditionType=BSWM_EQUALS, BswMConditionMode=BswM_MRP_WKSOURCE_KL15
          BswMConditionValue
            BswMBswMode: BswMBswRequestedMode=ECUM_WKSTATUS_VALIDATED
        BswM_MC_WKUP_CANMSG (BswMModeCondition): BswMConditionType=BSWM_EQUALS, BswMConditionMode=BswM_MRP_WKSOURCE_CANMSG
          BswMConditionValue
            BswMBswMode: BswMBswRequestedMode=ECUM_WKSTATUS_VALIDATED
        BswM_LE_Run_Wakeup_KL15 (BswMLogicalExpression): BswMLogicalOperator=BSWM_AND, BswMArgumentRef=BswM_MC_WKUP_KL15, BswMArgumentRef=BswM_MC_BswM_Run
        BswM_LE_Run_Wakeup_CanMsg (BswMLogicalExpression): BswMLogicalOperator=BSWM_AND, BswMArgumentRef=BswM_MC_BswM_Run, BswMArgumentRef=BswM_MC_WKUP_CANMSG
        BswM_AR_Run_KL15 (BswMRule): BswMRuleInitState=BSWM_FALSE, BswMRuleExpressionRef=BswM_LE_Run_Wakeup_KL15, BswMRuleTrueActionList=BswM_AL_BswMSwitchAppRun_WAKEUP
        BswM_AR_Run_CanMsg_WU (BswMRule): BswMRuleInitState=BSWM_FALSE, BswMRuleExpressionRef=BswM_LE_Run_Wakeup_CanMsg, BswMRuleTrueActionList=BswM_AL_BswMSwitchAppRun_WAKEUP
      BswMDataTypeMappingSets:
        BswMDataTypeMappingSetRef = ECUM_STATE_Mapping
        BswMDataTypeMappingSetRef = AppMode_Mapping
        BswMDataTypeMappingSetRef = ComMModeMapping
        BswMDataTypeMappingSetRef = DTS_DcmEcuReset
        BswMDataTypeMappingSetRef = DTS_DcmDiagnosticSessionControl
      BswMModeControl
        8 x BswMAction:
          BswM_AI_BswMSwitchStartupTwo
            BswMAvailableActions
              BswMSchMSwitch: BswMSchMSwitchedMode=ECUM_STATE_STARTUP_TWO
          BswM_AI_BswMSwitchRun
            BswMAvailableActions
              BswMSchMSwitch: BswMSchMSwitchedMode=ECUM_STATE_RUN
          BswM_AI_BswMSwitchAppRun
            BswMAvailableActions
              BswMSchMSwitch: BswMSchMSwitchedMode=ECUM_STATE_APP_RUN
          BswM_AI_BswMSwitchPrepShutdown
            BswMAvailableActions
              BswMSchMSwitch: BswMSchMSwitchedMode=ECUM_STATE_PREP_SHUTDOWN
          BswM_AI_BswMSwitchShutdown
            BswMAvailableActions
              BswMSchMSwitch: BswMSchMSwitchedMode=ECUM_STATE_SHUTDOWN
          BswM_AI_RteTimerStart
            BswMAvailableActions
              BswM_UserCallout (BswMUserCallout): BswMUserCalloutFunction=IC_RteTimerStart()
          BswM_AI_RteStop
            BswMAvailableActions
              BswMUserCallout: BswMUserCalloutFunction=Rte_Stop()
          BswM_AI_GoDown
            BswMAvailableActions
              BswMUserCallout: BswMUserCalloutFunction=EcuM_GoDown(0)
        6 x BswMActionList:
          BswM_AL_BswMSwitchStartupTwo: BswMActionListExecution=BSWM_CONDITION
            5 x BswMActionListItem:
              BswM_ALI_BswMStartupTwo: BswMAbortOnFail=false, BswMActionListItemIndex=0, BswMActionListItemRef=BswM_AI_BswMSwitchStartupTwo
              BswM_ALI_FeeInit: BswMAbortOnFail=0, BswMActionListItemIndex=1, BswMActionListItemRef=BswM_AI_FeeInit
              BswM_ALI_FeeRbEndInit: BswMAbortOnFail=0, BswMActionListItemIndex=2, BswMActionListItemRef=BswMAction_FeeRbEndInit
              BswM_ALI_NvMInit: BswMAbortOnFail=0, BswMActionListItemIndex=3, BswMActionListItemRef=BswM_AI_NvMInit
              BswM_ALI_NvMReadAll: BswMAbortOnFail=0, BswMActionListItemIndex=4, BswMActionListItemRef=BswM_AI_NvMReadAll
          BswM_AL_BswMSwitchRun: BswMActionListExecution=BSWM_TRIGGER
            22 x BswMActionListItem:
              BswM_ALI_CanIfInit: BswMAbortOnFail=0, BswMActionListItemIndex=2, BswMActionListItemRef=BswM_AI_CanIfInit
              BswM_ALI_CanSmInit: BswMAbortOnFail=0, BswMActionListItemIndex=3, BswMActionListItemRef=BswM_AI_CanSmInit
              BswM_ALI_PduRInit: BswMAbortOnFail=0, BswMActionListItemIndex=5, BswMActionListItemRef=BswM_AI_PduRInit
              BswM_ALI_ComInit: BswMAbortOnFail=0, BswMActionListItemIndex=6, BswMActionListItemRef=BswM_AI_ComInit
              BswM_ALI_ComMInit: BswMAbortOnFail=0, BswMActionListItemIndex=7, BswMActionListItemRef=BswM_AI_ComMInit
              BswM_ALI_BswMRun: BswMAbortOnFail=false, BswMActionListItemIndex=8, BswMActionListItemRef=BswM_AI_BswMSwitchRun
              BswMALI_DemInit: BswMAbortOnFail=false, BswMActionListItemIndex=9, BswMActionListItemRef=BswMAction_DemInit
              BswM_ALI_DcmInit: BswMAbortOnFail=0, BswMActionListItemIndex=10, BswMActionListItemRef=BswM_AI_Dcm_Init
              BswM_ALI_CanTpInit: BswMAbortOnFail=0, BswMActionListItemIndex=11, BswMActionListItemRef=BswM_AI_CanTp_Init
              BswM_ALI_WdgMInit: BswMAbortOnFail=false, BswMActionListItemIndex=12, BswMActionListItemRef=BswM_AI_WdgMInit
              BswM_ALI_CheckCondition: BswMAbortOnFail=0, BswMActionListItemIndex=13, BswMActionListItemRef=BswM_AI_CheckCondition
              BswM_ALI_Nm_Init: BswMAbortOnFail=0, BswMActionListItemIndex=14, BswMActionListItemRef=BswM_AI_Nm_Init
              BswM_ALI_CanNm_Init: BswMAbortOnFail=0, BswMActionListItemIndex=15, BswMActionListItemRef=BswM_AI_CanNm_Init
              BswM_ALI_Stbm_Init: BswMAbortOnFail=0, BswMActionListItemIndex=16, BswMActionListItemRef=BswM_AI_StbmInit
              BswM_ALI_EthSM_Init: BswMAbortOnFail=false, BswMActionListItemIndex=19, BswMActionListItemRef=BswM_AI_EthSMInit
              BswM_ALI_EthIf_Init: BswMAbortOnFail=false, BswMActionListItemIndex=20, BswMActionListItemRef=BswM_AI_EthIfInit
              BswM_ALI_Tcp_Init: BswMAbortOnFail=false, BswMActionListItemIndex=21, BswMActionListItemRef=BswM_AI_TcpIpInit
              BswM_ALI_SoAd_Init: BswMAbortOnFail=false, BswMActionListItemIndex=22, BswMActionListItemRef=BswM_AI_SoAdInit
              BswM_ALI_DoIP_Init: BswMAbortOnFail=false, BswMActionListItemIndex=23, BswMActionListItemRef=BswM_AI_DoIPInit
              BswM_ALI_XcpInit: BswMAbortOnFail=false, BswMActionListItemIndex=24, BswMActionListItemRef=BswM_AI_XcpInit
              BswM_ALI_RteTimerStart: BswMAbortOnFail=0, BswMActionListItemIndex=25, BswMActionListItemRef=BswM_AI_RteTimerStart
              BswM_ALI_EthTsyn_Init: BswMAbortOnFail=0, BswMActionListItemIndex=26, BswMActionListItemRef=BswM_Al_EthTsynInit
          BswM_AL_BswMSwitchAppRun: BswMActionListExecution=BSWM_TRIGGER
            5 x BswMActionListItem:
              BswM_ALI_AllowComm_Can0: BswMAbortOnFail=0, BswMActionListItemIndex=0, BswMActionListItemRef=BswM_AI_ComMCommAllowed_Can0
              BswM_ALI_AllowComm_Can1: BswMAbortOnFail=false, BswMActionListItemIndex=1, BswMActionListItemRef=BswM_AI_ComMCommAllowed_Can1
              BswM_ALI_AllowComm_Eth: BswMAbortOnFail=0, BswMActionListItemIndex=3, BswMActionListItemRef=BswM_AI_ComMCommAllowed_Eth
              BswM_ALI_EthTsynTransmitEnable: BswMAbortOnFail=0, BswMActionListItemIndex=4, BswMActionListItemRef=BswM_AI_EthTsynTransmitEnable
              BswM_ALI_ComMReqFullComm_Eth: BswMAbortOnFail=0, BswMActionListItemIndex=2, BswMActionListItemRef=BswM_AI_ComMReqFullComm_Eth
          BswM_AL_BswMSwitchPrepShutdown: BswMActionListExecution=BSWM_TRIGGER
            8 x BswMActionListItem:
              BswM_ALI_BswMPrepShutdown: BswMAbortOnFail=false, BswMActionListItemIndex=0, BswMActionListItemRef=BswM_AI_BswMSwitchPrepShutdown
              BswM_ALI_ComMReqNoComm_User0: BswMAbortOnFail=0, BswMActionListItemIndex=1, BswMActionListItemRef=BswM_AI_ComMReqNoComm_User0
              BswM_ALI_ComMCommNotAllowed_Can0: BswMAbortOnFail=0, BswMActionListItemIndex=2, BswMActionListItemRef=BswM_AI_ComMCommNotAllowed_Can0
              BswM_ALI_StopPduGroup_All: BswMAbortOnFail=0, BswMActionListItemIndex=3, BswMActionListItemRef=BswM_AI_StopPduGroup_All
              BswM_ALI_ComMReqNoComm_User1: BswMAbortOnFail=false, BswMActionListItemIndex=4, BswMActionListItemRef=BswM_AI_ComMReqNoComm_User1
              BswM_ALI_ComMCommNotAllowed_Can1: BswMAbortOnFail=false, BswMActionListItemIndex=5, BswMActionListItemRef=BswM_AI_ComMCommNotAllowed_Can1
              BswM_ALI_ComMReqNoComm_Eth: BswMAbortOnFail=0, BswMActionListItemIndex=6, BswMActionListItemRef=BswM_AI_ComMReqNoComm_Eth
              BswM_ALI_ComMCommNotAllowed_Eth: BswMAbortOnFail=0, BswMActionListItemIndex=7, BswMActionListItemRef=BswM_AI_ComMCommNotAllowed_Eth
          BswM_AL_BswMSwitchShutdown: BswMActionListExecution=BSWM_TRIGGER
            4 x BswMActionListItem:
              BswM_ALI_RteStop: BswMAbortOnFail=0, BswMActionListItemIndex=1, BswMActionListItemRef=BswM_AI_RteStop
              BswM_ALI_WriteAll: BswMAbortOnFail=0, BswMActionListItemIndex=2, BswMActionListItemRef=BswM_AI_NvMWriteAll
              BswM_ALI_EcuM_SelectShutdownTarget_RESET_MCU: BswMAbortOnFail=0, BswMActionListItemIndex=3, BswMActionListItemRef=BswMAction_EcuM_SelectShutdownTarget_RESET_MCU
              BswM_ALI_BswMShutdown: BswMAbortOnFail=false, BswMActionListItemIndex=4, BswMActionListItemRef=BswM_AI_BswMSwitchShutdown
          BswM_AL_BswMSwitchGoDown: BswMActionListExecution=BSWM_TRIGGER
            BswM_ALI_GoDown (BswMActionListItem): BswMAbortOnFail=false, BswMActionListItemIndex=1, BswMActionListItemRef=BswM_AI_GoDown
            BswMActionListItem_EcuM_InfinitLoopMainFunc (BswMActionListItem): BswMAbortOnFail=0, BswMActionListItemIndex=2, BswMActionListItemRef=BswMAction_EcuM_LoopMainFunc
        11 x BswMAction:
          BswM_AI_ComMReqFullComm_User0
            BswMAvailableActions
              BswMComMModeSwitch: BswMComMRequestedMode=BSWM_FULL_COM, BswMComMUserRef=ComMUser_Can_Network_Channel
          BswM_AI_ComMCommAllowed_Can0
            BswMAvailableActions
              BswMComMAllowCom: BswMComAllowed=1, BswMComMAllowChannelRef=ComMChannel_Can_Network_Channel
          BswM_AI_ComMReqNoComm_User0
            BswMAvailableActions
              BswMComMModeSwitch: BswMComMRequestedMode=BSWM_NO_COM, BswMComMUserRef=ComMUser_Can_Network_Channel
          BswM_AI_ComMCommNotAllowed_Can0
            BswMAvailableActions
              BswMComMAllowCom: BswMComAllowed=0, BswMComMAllowChannelRef=ComMChannel_Can_Network_Channel
          BswM_AI_StartPduGroup_All
            BswMAvailableActions
              BswMPduGroupSwitch: BswMPduGroupSwitchReinit=false, BswMEnabledPduGroupRef=ComIPduGroup_Rx, BswMEnabledPduGroupRef=ComIPduGroup_Tx
          BswM_AI_StopPduGroup_All
            BswMAvailableActions
              BswMPduGroupSwitch: BswMPduGroupSwitchReinit=false, BswMDisabledPduGroupRef=ComIPduGroup_Rx, BswMDisabledPduGroupRef=ComIPduGroup_Tx
          BswM_AI_CanIfInit
            BswMAvailableActions
              BswMUserCallout: BswMUserCalloutFunction=CanIf_Init(NULL_PTR)
          BswM_AI_ComMInit
            BswMAvailableActions
              BswMUserCallout: BswMUserCalloutFunction=ComM_Init(NULL_PTR)
          BswM_AI_CanSmInit
            BswMAvailableActions
              BswMUserCallout: BswMUserCalloutFunction=CanSM_Init(NULL_PTR)
          BswM_AI_ComInit
            BswMAvailableActions
              BswMUserCallout: BswMUserCalloutFunction=Com_Init(NULL_PTR)
          BswM_AI_PduRInit
            BswMAvailableActions
              BswMUserCallout: BswMUserCalloutFunction=PduR_Init(&PduR_Config)
        BswM_AL_StartTxPduGroup (BswMActionList): BswMActionListExecution=BSWM_TRIGGER
          BswM_ALI_StartPduGroup_All (BswMActionListItem): BswMAbortOnFail=0, BswMActionListItemIndex=0, BswMActionListItemRef=BswM_AI_StartPduGroup_All
        BswM_AL_RequestFullCom_Can0 (BswMActionList): BswMActionListExecution=BSWM_TRIGGER
          BswM_ALI_ComMRegFullComm_User0 (BswMActionListItem): BswMAbortOnFail=0, BswMActionListItemIndex=1, BswMActionListItemRef=BswM_AI_ComMReqFullComm_User0
          BswM_ALI_ComMCommAllowed_Can0 (BswMActionListItem): BswMAbortOnFail=0, BswMActionListItemIndex=0, BswMActionListItemRef=BswM_AI_ComMCommAllowed_Can0
        14 x BswMAction:
          BswM_AI_FeeInit
            BswMAvailableActions
              BswMUserCallout: BswMUserCalloutFunction=Fee_Init(NULL_PTR)
          BswM_AI_NvMWriteAll
            BswMAvailableActions_0 (BswMAvailableActions)
              BswMUserCallout: BswMUserCalloutFunction=IC_BswM_NvM_WriteAll()
          BswM_AI_NvMReadAll
            BswMAvailableActions_0 (BswMAvailableActions)
              BswMUserCallout: BswMUserCalloutFunction=IC_BswM_NvM_ReadAll()
          BswM_AI_NvMInit
            BswMAvailableActions_0 (BswMAvailableActions)
              BswMUserCallout: BswMUserCalloutFunction=NvM_Init()
          BswMAction_SwitchAppMode_Dummy
            BswMAvailableActions
              BswMSchMSwitch: BswMSchMSwitchedMode=SWC_REQUEST_SHUTDOWN
          BswMAction_EcuM_LoopMainFunc
            BswMAvailableActions
              BswMUserCallout: BswMUserCalloutFunction=Loop_EcuM_MainFunc()
          BswM_AI_Dcm_Init
            BswMAvailableActions_0 (BswMAvailableActions)
              BswMUserCallout: BswMUserCalloutFunction=Dcm_Init(NULL_PTR)
          BswM_AI_CanTp_Init
            BswMAvailableActions_0 (BswMAvailableActions)
              BswMUserCallout: BswMUserCalloutFunction=CanTp_Init(NULL_PTR)
          BswMAction_EcuM_SelectShutdownTarget_RESET_MCU
            BswMAvailableActions_0 (BswMAvailableActions)
              BswMUserCallout: BswMUserCalloutFunction=EcuM_SelectShutdownTarget(ECUM_SHUTDOWN_TARGET_RESET,ECUM_RESET_MCU)
          BswMAction_EcuM_SelectShutdownTarget_RESET_IO
            BswMAvailableActions_0 (BswMAvailableActions)
              BswMUserCallout: BswMUserCalloutFunction=EcuM_SelectShutdownTarget(ECUM_SHUTDOWN_TARGET_RESET,ECUM_RESET_IO)
          BswMAction_EnableRxPduGroup
            BswMAvailableActions_0 (BswMAvailableActions)
              BswMPduGroupSwitch: BswMPduGroupSwitchReinit=false, BswMEnabledPduGroupRef=ComIPduGroup_Rx
          BswMAction_DisableRxPduGroup
            BswMAvailableActions_0 (BswMAvailableActions)
              BswMPduGroupSwitch: BswMPduGroupSwitchReinit=false, BswMDisabledPduGroupRef=ComIPduGroup_Rx
          BswMAction_EnableTxPduGroup
            BswMAvailableActions_0 (BswMAvailableActions)
              BswMPduGroupSwitch: BswMPduGroupSwitchReinit=false, BswMEnabledPduGroupRef=ComIPduGroup_Tx
          BswMAction_DisableTxPduGroup
            BswMAvailableActions_0 (BswMAvailableActions)
              BswMPduGroupSwitch: BswMPduGroupSwitchReinit=false, BswMDisabledPduGroupRef=ComIPduGroup_Tx
        4 x BswMActionList, all with BswMActionListExecution=BSWM_TRIGGER:
          BswM_AL_DCM_ENABLE_RX_TX_NORM
            BswMActionListItem_EnableRxPduGroup (BswMActionListItem): BswMAbortOnFail=false, BswMActionListItemIndex=0, BswMActionListItemRef=BswMAction_EnableRxPduGroup
            BswMActionListItem_EnableTxPduGroup (BswMActionListItem): BswMAbortOnFail=false, BswMActionListItemIndex=1, BswMActionListItemRef=BswMAction_EnableTxPduGroup
          BswM_AL_DCM_DISABLE_RX_TX_NORM
            BswMActionListItem_DisableRxPduGroup (BswMActionListItem): BswMAbortOnFail=false, BswMActionListItemIndex=0, BswMActionListItemRef=BswMAction_DisableRxPduGroup
            BswMActionListItem_DisableTxPduGroup (BswMActionListItem): BswMAbortOnFail=false, BswMActionListItemIndex=1, BswMActionListItemRef=BswMAction_DisableTxPduGroup
          BswM_AL_DCM_ENABLE_RX_DISABLE_TX_NORM
            BswMActionListItem_EnableRxPduGroup (BswMActionListItem): BswMAbortOnFail=false, BswMActionListItemIndex=0, BswMActionListItemRef=BswMAction_EnableRxPduGroup
            BswMActionListItem_DisableTxPduGroup (BswMActionListItem): BswMAbortOnFail=false, BswMActionListItemIndex=1, BswMActionListItemRef=BswMAction_DisableTxPduGroup
          BswM_AL_DCM_DISABLE_RX_ENABLE_TX_NORM
            BswMActionListItem_DisableRxPduGroup (BswMActionListItem): BswMAbortOnFail=false, BswMActionListItemIndex=0, BswMActionListItemRef=BswMAction_DisableRxPduGroup
            BswMActionListItem_EnableTxPduGroup (BswMActionListItem): BswMAbortOnFail=false, BswMActionListItemIndex=1, BswMActionListItemRef=BswMAction_EnableTxPduGroup
        9 x BswMAction:
          BswMAction_DemInit
            BswMAvailableActions_0 (BswMAvailableActions)
              BswMUserCallout: BswMUserCalloutFunction=Dem_Init()
          BswMAction_DemShutdown
            BswMAvailableActions_0 (BswMAvailableActions)
              BswMUserCallout: BswMUserCalloutFunction=Dem_Shutdown()
          BswMAction_Dem_EndOperation
            BswMAvailableActions
              BswMUserCallout: BswMUserCalloutFunction=Dem_SetOperationCycleState(0,DEM_CYCLE_STATE_END)
          BswM_AI_WdgMInit
            BswMAvailableActions
              BswMUserCallout: BswMUserCalloutFunction=WdgM_Init(NULL_PTR)
          BswM_AI_XcpInit
            BswMAvailableActions_0 (BswMAvailableActions)
              BswMUserCallout: BswMUserCalloutFunction=Xcp_Init(NULL_PTR)
          BswM_AI_ComMReqFullComm_User1
            BswMAvailableActions_0 (BswMAvailableActions)
              BswMComMModeSwitch: BswMComMRequestedMode=BSWM_FULL_COM, BswMComMUserRef=ComMUser_Can_Network_XCP_Channel
          BswM_AI_ComMCommAllowed_Can1
            BswMAvailableActions_0 (BswMAvailableActions)
              BswMComMAllowCom: BswMComAllowed=true, BswMComMAllowChannelRef=ComMChannel_Can_Network_XCP_Channel
          BswM_AI_ComMReqNoComm_User1
            BswMAvailableActions_0 (BswMAvailableActions)
              BswMComMModeSwitch: BswMComMRequestedMode=BSWM_NO_COM, BswMComMUserRef=ComMUser_Can_Network_XCP_Channel
          BswM_AI_ComMCommNotAllowed_Can1
            BswMAvailableActions_0 (BswMAvailableActions)
              BswMComMAllowCom: BswMComAllowed=false, BswMComMAllowChannelRef=ComMChannel_Can_Network_XCP_Channel
        BswM_AL_BswMInAppRun (BswMActionList): BswMActionListExecution=BSWM_TRIGGER
          BswM_ALI_StartPduGroup (BswMActionListItem): BswMAbortOnFail=0, BswMActionListItemIndex=0, BswMActionListItemRef=BswM_AI_StartPduGroup_All
        5 x BswMAction:
          BswM_AI_CheckCondition
            BswMAvailableActions_0 (BswMAvailableActions)
              BswMUserCallout: BswMUserCalloutFunction=CheckCondition()
          BswM_AI_CanNm_Init
            BswMAvailableActions_0 (BswMAvailableActions)
              BswMUserCallout: BswMUserCalloutFunction=CanNm_Init(NULL_PTR)
          BswM_AI_Nm_Init
            BswMAvailableActions_0 (BswMAvailableActions)
              BswMUserCallout: BswMUserCalloutFunction=Nm_Init(NULL_PTR)
          BswMAction_NM_Start
            BswMAvailableActions_0 (BswMAvailableActions)
              BswMNMControl: BswMNMAction=BSWM_NM_ENABLE, BswMComMNetworkHandleRef=ComMChannel_Can_Network_Channel
          BswMAction_NM_Stop
            BswMAvailableActions_0 (BswMAvailableActions)
              BswMNMControl: BswMNMAction=BSWM_NM_DISABLE, BswMComMNetworkHandleRef=ComMChannel_Can_Network_Channel
        4 x BswMActionList, all with BswMActionListExecution=BSWM_TRIGGER:
          BswM_AL_DCM_ENABLE_TX_RX_NM
            BswMActionListItem_0 (BswMActionListItem): BswMAbortOnFail=false, BswMActionListItemIndex=0, BswMActionListItemRef=BswMAction_NM_Start
          BswM_AL_DCM_DISABLE_TX_RX_NM
            BswMActionListItem_0 (BswMActionListItem): BswMAbortOnFail=false, BswMActionListItemIndex=0, BswMActionListItemRef=BswMAction_NM_Stop
          BswM_AL_NetworkRequest
            7 x BswMActionListItem:
              BswM_ALI_ComMReqFullComm_User0: BswMAbortOnFail=false, BswMActionListItemIndex=0, BswMActionListItemRef=BswM_AI_ComMReqFullComm_User0
              BswM_ALI_ComMReqFullComm_User1: BswMAbortOnFail=0, BswMActionListItemIndex=1, BswMActionListItemRef=BswM_AI_ComMReqFullComm_User1
              BswM_ALI_ComMCommAllowed_Can0: BswMAbortOnFail=0, BswMActionListItemIndex=2, BswMActionListItemRef=BswM_AI_ComMCommAllowed_Can0
              BswM_ALI_ComMCommAllowed_Can1: BswMAbortOnFail=0, BswMActionListItemIndex=3, BswMActionListItemRef=BswM_AI_ComMCommAllowed_Can1
              BswM_ALI_StartPduGroup_All: BswMAbortOnFail=0, BswMActionListItemIndex=8, BswMActionListItemRef=BswM_AI_StartPduGroup_All
              BswM_ALI_ComMCommAllowed_Eth: BswMAbortOnFail=0, BswMActionListItemIndex=4, BswMActionListItemRef=BswM_AI_ComMCommAllowed_Eth
              BswM_ALI_ComMReqFullComm_Eth: BswMAbortOnFail=0, BswMActionListItemIndex=5, BswMActionListItemRef=BswM_AI_ComMReqFullComm_Eth
          BswM_AL_NetworkRelease
            6 x BswMActionListItem:
              BswM_ALI_ComMReqNoComm_User0: BswMAbortOnFail=false, BswMActionListItemIndex=0, BswMActionListItemRef=BswM_AI_ComMReqNoComm_User0
              BswM_ALI_ComMReqNoComm_User1: BswMAbortOnFail=0, BswMActionListItemIndex=1, BswMActionListItemRef=BswM_AI_ComMReqNoComm_User1
              BswM_ALI_ComMCommNotAllowed_Can0: BswMAbortOnFail=0, BswMActionListItemIndex=2, BswMActionListItemRef=BswM_AI_ComMCommNotAllowed_Can0
              BswM_ALI_ComMCommNotAllowed_Can1: BswMAbortOnFail=0, BswMActionListItemIndex=3, BswMActionListItemRef=BswM_AI_ComMCommNotAllowed_Can1
              BswM_ALI_ComMReqNoComm_Eth: BswMAbortOnFail=0, BswMActionListItemIndex=4, BswMActionListItemRef=BswM_AI_ComMReqNoComm_Eth
              BswM_ALI_ComMCommNotAllowed_Eth: BswMAbortOnFail=0, BswMActionListItemIndex=5, BswMActionListItemRef=BswM_AI_ComMCommNotAllowed_Eth
        12 x BswMAction:
          BswMAction_FeeRbEndInit
            BswMAvailableActions
              BswMUserCallout: BswMUserCalloutFunction=Fee_Rb_EndInit()
          BswMAction_Adc_Init
            BswMAvailableActions
              BswMUserCallout: BswMUserCalloutFunction=Adc_Init(&Adc_Config)
          BswM_AI_StbmInit
            BswMAvailableActions
              BswMUserCallout: BswMUserCalloutFunction=StbM_Init(NULL_PTR)
          BswM_AI_EthIfInit
            BswMAvailableActions
              BswMUserCallout: BswMUserCalloutFunction=EthIf_Init(NULL_PTR)
          BswM_AI_EthSMInit
            BswMAvailableActions
              BswMUserCallout: BswMUserCalloutFunction=EthSM_Init()
          BswM_AI_TcpIpInit
            BswMAvailableActions
              BswMUserCallout: BswMUserCalloutFunction=TcpIp_Init(NULL_PTR)
          BswM_AI_SoAdInit
            BswMAvailableActions
              BswMUserCallout: BswMUserCalloutFunction=SoAd_Init(NULL_PTR)
          BswM_AI_ComMReqFullComm_Eth
            BswMAvailableActions
              BswMComMModeSwitch: BswMComMRequestedMode=BSWM_FULL_COM, BswMComMUserRef=ComMUser_Eth_Network_Channel
          BswM_AI_ComMReqNoComm_Eth
            BswMAvailableActions
              BswMComMModeSwitch: BswMComMRequestedMode=BSWM_NO_COM, BswMComMUserRef=ComMUser_Eth_Network_Channel
          BswM_AI_ComMCommAllowed_Eth
            BswMAvailableActions
              BswMComMAllowCom: BswMComAllowed=true, BswMComMAllowChannelRef=Eth_Network_Channel_EthernetCluster
          BswM_AI_ComMCommNotAllowed_Eth
            BswMAvailableActions
              BswMComMAllowCom: BswMComAllowed=false, BswMComMAllowChannelRef=Eth_Network_Channel_EthernetCluster
          BswM_AI_DoIPInit
            BswMAvailableActions
              BswMUserCallout: BswMUserCalloutFunction=DoIP_Init(NULL_PTR)
        BswM_AL_BswMSwitchAppRun_WAKEUP (BswMActionList): BswMActionListExecution=BSWM_TRIGGER
          4 x BswMActionListItem:
            BswM_ALI_ComMReqFullComm_Eth: BswMAbortOnFail=0, BswMActionListItemIndex=2, BswMActionListItemRef=BswM_AI_ComMReqFullComm_Eth
            BswM_ALI_BswMAppRun: BswMAbortOnFail=false, BswMActionListItemIndex=4, BswMActionListItemRef=BswM_AI_BswMSwitchAppRun
            BswM_ALI_ComMReqFullComm_User0: BswMAbortOnFail=0, BswMActionListItemIndex=0, BswMActionListItemRef=BswM_AI_ComMReqFullComm_User0
            BswM_ALI_ComMReqFullComm_User1: BswMAbortOnFail=false, BswMActionListItemIndex=1, BswMActionListItemRef=BswM_AI_ComMReqFullComm_User1
        BswM_Al_EthTsynInit (BswMAction)
          BswMAvailableActions
            BswMUserCallout: BswMUserCalloutFunction=EthTSyn_Init(NULL_PTR)
        BswM_AI_EthTsynTransmitEnable (BswMAction)
          BswMAvailableActions
            BswMUserCallout: BswMUserCalloutFunction=EthTSyn_SetTransmissionMode(0, 1)
