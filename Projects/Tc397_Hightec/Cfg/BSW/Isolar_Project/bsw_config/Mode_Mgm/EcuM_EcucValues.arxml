AUTOSAR XML (schema 4-2-2)
package /ETAS_Project/EcucModuleConfigurationValuess
  module config EcuM
    EcuMConfiguration_0 (EcuMConfiguration)
      EcuMCommonConfiguration: EcuMDefaultAppMode=OSDEFAULTAPPMODE
        EcuMDefaultShutdownTarget: EcuMDefaultState=EcuMStateOff, EcuMDefaultResetModeRef=ECUM_RESET_MCU
        5 x EcuMWakeupSource, all with EcuMValidationTimeout=0.0:
          ECUM_WKSOURCE_POWER: EcuMWakeupSourceId=0
          ECUM_WKSOURCE_RESET: EcuMWakeupSourceId=1
          ECUM_WKSOURCE_INTERNAL_RESET: EcuMWakeupSourceId=2
          ECUM_WKSOURCE_INTERNAL_WDG: EcuMWakeupSourceId=3
          ECUM_WKSOURCE_EXTERNAL_WDG: EcuMWakeupSourceId=4
        EcuMDriverInitListOne
          25 x EcuMDriverInitItem:
            Det: EcuMModuleID=Det, EcuMModuleParameter=NULL_PTR, EcuMModuleService=Init
            Dem_PreInit: EcuMModuleID=Dem, EcuMModuleParameter=NULL_PTR, EcuMModuleService=PreInit
            Mcu: EcuMModuleID=Mcu, EcuMModuleParameter=POSTBUILD_PTR, EcuMModuleService=Init
            McuFunc: EcuMModuleID=McuFunc, EcuMModuleParameter=VOID, EcuMModuleService=InitializeClock
            Port: EcuMModuleID=Port, EcuMModuleParameter=POSTBUILD_PTR, EcuMModuleService=Init
            Spi: EcuMModuleID=Spi, EcuMModuleService=Init, EcuMModuleParameter=POSTBUILD_PTR
            Adc: EcuMModuleID=Adc, EcuMModuleParameter=POSTBUILD_PTR, EcuMModuleService=Init
            Pwm: EcuMModuleID=Pwm_17_GtmCcu6, EcuMModuleParameter=POSTBUILD_PTR, EcuMModuleService=Init
            Icu: EcuMModuleID=Icu_17_TimerIp, EcuMModuleService=Init, EcuMModuleParameter=POSTBUILD_PTR
            Os_core0: EcuMModuleID=VectorTable_Core0, EcuMModuleParameter=VOID, EcuMModuleService=Init, EcuMRbDriverInitCoreId=0
            Fls: EcuMModuleID=Fls, EcuMModuleParameter=POSTBUILD_PTR, EcuMModuleService=Init
            Os_core{1..5}: EcuMModuleID=VectorTable_Core{1..5}, EcuMModuleParameter=VOID, EcuMModuleService=Init, EcuMRbDriverInitCoreId={1..5}
            IoHwAb_ADC: EcuMModuleID=IoHwAb_ADC, EcuMModuleParameter=VOID, EcuMModuleService=Init_func
            IoHwAb_ICU: EcuMModuleID=IoHwAb_ICU, EcuMModuleParameter=VOID, EcuMModuleService=Init_func
            IoHwAb_DIO_test: EcuMModuleID=IoHwAb_DIO_Test, EcuMModuleParameter=VOID, EcuMModuleService=Init_func
            Smu: EcuMModuleID=Smu, EcuMModuleParameter=POSTBUILD_PTR, EcuMModuleService=Init
            Can: EcuMModuleID=Can_17_McmCan, EcuMModuleParameter=POSTBUILD_PTR, EcuMModuleService=Init
            Eth: EcuMModuleID=Eth_17_GEthMac, EcuMModuleParameter=POSTBUILD_PTR, EcuMModuleService=Init
            Check_Wakeup_src: EcuMModuleID=EcuM_User, EcuMModuleParameter=VOID, EcuMModuleService=CheckWKSourceAll
            Wdg_Init: EcuMModuleID=Wdg_17_Scu, EcuMModuleParameter=POSTBUILD_PTR, EcuMModuleService=Init
            Wdg_InitCheck: EcuMModuleID=Wdg_17_Scu, EcuMModuleParameter=POSTBUILD_PTR, EcuMModuleService=InitCheck
        ECUM_WKSOURCE_KL15 (EcuMWakeupSource): EcuMValidationTimeout=0.0
        ECUM_WKSOURCE_CANMSG (EcuMWakeupSource): EcuMValidationTimeout=0.0
      EcuMFlexConfiguration
        EcuMFlexUserConfig_0 (EcuMFlexUserConfig): EcuMFlexUser=0
        EcuMGoDownAllowedUsers: EcuMGoDownAllowedUserRef=EcuMFlexUserConfig_0
        3 x EcuMResetMode:
          ECUM_RESET_MCU: EcuMResetModeId=0
          ECUM_RESET_WDGM: EcuMResetModeId=1
          ECUM_RESET_IO: EcuMResetModeId=2
        3 x EcuMShutdownCause:
          ECUM_CAUSE_ECU_STATE: EcuMShutdownCauseId=1
          ECUM_CAUSE_WDGM: EcuMShutdownCauseId=2
          ECUM_CAUSE_DCM: EcuMShutdownCauseId=3
    EcuMGeneral: EcuMDevErrorDetect=1, EcuMIncludeDet=1, EcuMMainFunctionPeriod=0.01, EcuMVersionInfoApi=true
      EcuMRbIncludeHeaderList: EcuMRbModuleHeader=EcuM_PBDefine
