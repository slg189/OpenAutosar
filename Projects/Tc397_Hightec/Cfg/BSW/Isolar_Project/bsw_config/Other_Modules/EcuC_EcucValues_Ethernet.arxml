AUTOSAR XML (schema 4-2-2)
package /ETAS_Project/EcucModuleConfigurationValuess
  module config EcuC: implementation-config-variant=VARIANT-PRE-COMPILE
    EcucConfigSet
      PduCollection (EcucPduCollection): PduIdTypeEnum=uint16, PduLengthTypeEnum=uint16
        26 x Pdu:
          RXFrame_EthernetUDP_SoAd2PduR: PduLength=534
          RXFrame_EthernetUDP_PduR2Com: PduLength=534
          TXFrame_EthernetUDP_Com2PduR: PduLength=534
          TXFrame_EthernetUDP_PduR2SoAd: PduLength=534
          RXFrame_EthernetTCP_SoAd2PduR: PduLength=4
          RXFrame_EthernetTCP_PduR2Com: PduLength=4
          TXFrame_EthernetTCP_Com2PduR: PduLength=4
          TXFrame_EthernetTCP_PduR2SoAd: PduLength=4
          RXFrame_EthernetCommunicationController_SoAd2PduR: PduLength=15
          RXFrame_EthernetCommunicationController_PduR2Com: PduLength=15
          TXFrame_EthernetCommunicationController_Com2PduR: PduLength=15
          TXFrame_EthernetCommunicationController_PduR2SoAd: PduLength=15
          RXFrame_EthernetUDP_SoAd2DoIP: PduLength=1024
          TXFrame_EthernetUDP_DoIP2SoAd: PduLength=1024
          RXFrame_EthernetUDP_Discovery: PduLength=256
          TXFrame_EthernetUDP_Discovery: PduLength=256
          RXFrame_EthernetTCP_SoAd2DoIP: PduLength=1024
          TXFrame_EthernetTCP_DoIP2SoAd: PduLength=1024
          RXFrame_Ethernet_DoIP2PduR: PduLength=1024
          TXFrame_Ethernet_PduR2DoIP: PduLength=1024
          TXFrame_Ethernet_Dcm2PduR: PduLength=1024
          RXFrame_Ethernet_PduR2Dcm: PduLength=1024
          TXFrame_EthernetUDP_Xcp2SoAd: PduLength=1024
          RXFrame_EthernetUDP_SoAd2Xcp: PduLength=1024
          TXFrame_EthernetTCP_Xcp2SoAd: PduLength=1024
          RXFrame_EthernetTCP_SoAd2Xcp: PduLength=1024
