AUTOSAR XML (schema 4-2-2)
package /ETAS_Project/EcucModuleConfigurationValuess
  module config EcuC
    EcucPartitionCollection
      6 x EcucPartition, all with PartitionCanBeRestarted=false:
        EcucPartition_Core0: EcucPartitionBswModuleExecution=1, EcucPartitionSoftwareComponentInstanceRef=CPT_NvM, EcucPartitionSoftwareComponentInstanceRef=CPT_XCP, EcucPartitionSoftwareComponentInstanceRef=CPT_BswM, EcucPartitionSoftwareComponentInstanceRef=CPT_EcuM, EcucPartitionSoftwareComponentInstanceRef=CPT_ASW_COM, EcucPartitionSoftwareComponentInstanceRef=CPT_Dcm, EcucPartitionSoftwareComponentInstanceRef=CPT_ComM, EcucPartitionSoftwareComponentInstanceRef=CPT_Det, EcucPartitionSoftwareComponentInstanceRef=CPT_Dem, EcucPartitionSoftwareComponentInstanceRef=CPT_ASW_NM, EcucPartitionSoftwareComponentInstanceRef=CPT_ASW_NVM, EcucPartitionSoftwareComponentInstanceRef=CPT_ASW_WDG, EcucPartitionSoftwareComponentInstanceRef=CPT_SensorActuator_ADC, EcucPartitionSoftwareComponentInstanceRef=CPT_IoHwAb_ADC, EcucPartitionSoftwareComponentInstanceRef=CPT_SensorActuator_DIO, EcucPartitionSoftwareComponentInstanceRef=CPT_IoHwAb_DIO, EcucPartitionSoftwareComponentInstanceRef=CPT_SensorActuator_ICU, EcucPartitionSoftwareComponentInstanceRef=CPT_IoHwAb_PWM, EcucPartitionSoftwareComponentInstanceRef=CPT_SensorActuator_PWM, EcucPartitionSoftwareComponentInstanceRef=CPT_IoHwAb_ICU, EcucPartitionSoftwareComponentInstanceRef=CPT_WdgM, EcucPartitionSoftwareComponentInstanceRef=CPT_rba_DiagLib, EcucPartitionSoftwareComponentInstanceRef=CPT_ASW_CORE0, EcucPartitionSoftwareComponentInstanceRef=CPT_ASW_DEM, EcucPartitionSoftwareComponentInstanceRef=CPT_CDD_CORE0, EcucPartitionSoftwareComponentInstanceRef=CPT_ASW_DCM, EcucPartitionSoftwareComponentInstanceRef=CPT_ASW_ETH, EcucPartitionSoftwareComponentInstanceRef=CPT_DoIP, EcucPartitionSoftwareComponentInstanceRef=(unset), EcucPartitionSoftwareComponentInstanceRef=(unset), EcucPartitionSoftwareComponentInstanceRef=CPT_ASW_StbM, EcucPartitionSoftwareComponentInstanceRef=CPT_StbM, EcucPartitionSoftwareComponentInstanceRef=CPT_SensorActuator_DIO_Test, EcucPartitionSoftwareComponentInstanceRef=CPT_IoHwAb_DIO_Test
        EcucPartition_Core{1..5}: EcucPartitionBswModuleExecution=false, EcucPartitionSoftwareComponentInstanceRef=CPT_ASW_CORE{1..5}, EcucPartitionSoftwareComponentInstanceRef=CPT_CDD_CORE{1..5}
    EcucHardware
      6 x EcucCoreDefinition:
        EcucCore{0..5}: EcucCoreId={0..5}
