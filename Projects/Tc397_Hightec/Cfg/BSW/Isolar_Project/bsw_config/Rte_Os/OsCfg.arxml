AUTOSAR XML (schema 4-2-2)
package /Os
  module config Os
    OSDEFAULTAPPMODE (OsAppMode)
    OsOS:
      OsNumberOfCores = 6
      OsScalabilityClass = SC1
      OsStatus = STANDARD
      OsStackMonitoring = true
      OsUseGetServiceId = false
      OsUseParameterAccess = false
      OsUseResScheduler = true
      OsSuppressVectorGen = false
      OsDefaultInterrupt = DefaultInterruptHandler
      OsCyclesPerSecond = 300000000
      OsTicksPerSecond = 100000000
      meter_execution (Param)
      meter_elapsed_time (Param)
      OsHooks: OsStackFaultHook=true, OsErrorHook=true, OsPostTaskHook=false, OsPreTaskHook=false, OsProtectionHook=true, OsShutdownHook=true, OsStartupHook=true
    6 x OsApplication, all with OsTrusted=true, OsTrustedApplicationDelayTimingViolationCall=false:
      OsApplication_Core0: OsTrustedApplicationWithProtection=false, OsAppCounterRef=Rte_TickCounter, OsAppEcucPartitionRef=EcucPartition_Core0, OsApplicationCoreRef=EcucCore0, OsAppTaskRef=Core0_OsTask_BSW_1ms, OsAppTaskRef=Core0_OsTask_BSW_10ms, OsAppTaskRef=Core0_OsTask_Background_1ms, OsAppTaskRef=Core0_OsTask_ASW_10ms, OsAppTaskRef=Core0_OsTask_ASW_100ms, OsAppTaskRef=Core0_ECU_StartupTask, OsAppTaskRef=Core0_BSW_OsTask_SwcRequest, OsAppTaskRef=Core0_OsTask_BSW_50ms, OsAppTaskRef=Core0_OsTask_BSW_5ms
        OsApplicationHooks: OsAppStartupHook=false, OsAppShutdownHook=false, OsAppErrorHook=true
      OsApplication_Core1: OsTrustedApplicationWithProtection=false, OsAppEcucPartitionRef=EcucPartition_Core1, OsApplicationCoreRef=EcucCore1, OsAppTaskRef=Core1_OsTask_BSW_10ms, OsAppTaskRef=Core1_OsTask_ASW_10ms
        OsApplicationHooks: OsAppStartupHook=false, OsAppShutdownHook=false, OsAppErrorHook=true
      OsApplication_Core2: OsTrustedApplicationWithProtection=false, OsAppEcucPartitionRef=EcucPartition_Core2, OsApplicationCoreRef=EcucCore2, OsAppTaskRef=Core2_OsTask_BSW_10ms, OsAppTaskRef=Core2_OsTask_ASW_10ms
        OsApplicationHooks: OsAppStartupHook=false, OsAppShutdownHook=false, OsAppErrorHook=true
      OsApplication_Core3: OsTrustedApplicationWithProtection=0, OsAppEcucPartitionRef=EcucPartition_Core3, OsApplicationCoreRef=EcucCore3, OsAppTaskRef=Core3_OsTask_BSW_10ms, OsAppTaskRef=Core3_OsTask_ASW_10ms
        OsApplicationHooks: OsAppErrorHook=true, OsAppShutdownHook=false, OsAppStartupHook=false
      OsApplication_Core4: OsTrustedApplicationWithProtection=0, OsAppEcucPartitionRef=EcucPartition_Core4, OsApplicationCoreRef=EcucCore4, OsAppTaskRef=Core4_OsTask_BSW_10ms, OsAppTaskRef=Core4_OsTask_ASW_10ms
        OsApplicationHooks_0 (OsApplicationHooks): OsAppErrorHook=true, OsAppShutdownHook=false, OsAppStartupHook=false
      OsApplication_Core5: OsTrustedApplicationWithProtection=0, OsAppEcucPartitionRef=EcucPartition_Core5, OsApplicationCoreRef=EcucCore5, OsAppTaskRef=Core5_OsTask_BSW_10ms, OsAppTaskRef=Core5_OsTask_ASW_10ms
        OsApplicationHooks_0 (OsApplicationHooks): OsAppErrorHook=true, OsAppShutdownHook=false, OsAppStartupHook=false
    19 x OsTask, all with OsTaskActivation=1:
      Core0_ECU_StartupTask: OsTaskPriority=13, OsTaskSchedule=FULL, OsTaskStackAllocation=2048,2048
        OsTaskAutostart: OsTaskAppModeRef=OSDEFAULTAPPMODE
      Core0_OsTask_Background_1ms: OsTaskPriority=3, OsTaskSchedule=NON, OsTaskStackAllocation=2048,2048
      Core0_BSW_OsTask_SwcRequest: OsTaskStackAllocation=1536,1536, OsTaskPriority=11, OsTaskSchedule=FULL
      Core1_OsTask_ASW_10ms: OsTaskStackAllocation=1024,1024, OsTaskPriority=3, OsTaskSchedule=FULL, OsTaskAccessingApplication=OsApplication_Core0
      Core1_OsTask_BSW_10ms: OsTaskStackAllocation=512,512, OsTaskPriority=4, OsTaskSchedule=FULL, OsTaskAccessingApplication=OsApplication_Core0
      Core2_OsTask_ASW_10ms: OsTaskStackAllocation=512,512, OsTaskPriority=3, OsTaskSchedule=FULL, OsTaskAccessingApplication=OsApplication_Core0
      Core2_OsTask_BSW_10ms: OsTaskStackAllocation=512,512, OsTaskPriority=4, OsTaskSchedule=FULL, OsTaskAccessingApplication=OsApplication_Core0
      Core3_OsTask_ASW_10ms: OsTaskStackAllocation=512,512, OsTaskPriority=3, OsTaskSchedule=FULL, OsTaskAccessingApplication=OsApplication_Core0
      Core3_OsTask_BSW_10ms: OsTaskStackAllocation=512,512, OsTaskPriority=4, OsTaskSchedule=FULL, OsTaskAccessingApplication=OsApplication_Core0
      Core0_OsTask_ASW_100ms: OsTaskStackAllocation=4608,1536, OsTaskPriority=4, OsTaskSchedule=FULL
      Core0_OsTask_ASW_10ms: OsTaskStackAllocation=512,512, OsTaskPriority=7, OsTaskSchedule=FULL
      Core0_OsTask_BSW_10ms: OsTaskStackAllocation=2048,2048, OsTaskPriority=8, OsTaskSchedule=FULL
      Core0_OsTask_BSW_1ms: OsTaskStackAllocation=1536,1536, OsTaskPriority=10, OsTaskSchedule=FULL
      Core0_OsTask_BSW_5ms: OsTaskPriority=9, OsTaskSchedule=FULL, OsTaskStackAllocation=1024,1024
      Core0_OsTask_BSW_50ms: OsTaskSchedule=FULL, OsTaskPriority=6, OsTaskStackAllocation=512,512
      Core4_OsTask_ASW_10ms: OsTaskStackAllocation=512,512, OsTaskPriority=3, OsTaskSchedule=FULL, OsTaskAccessingApplication=OsApplication_Core0
      Core4_OsTask_BSW_10ms: OsTaskStackAllocation=512,512, OsTaskPriority=4, OsTaskSchedule=FULL, OsTaskAccessingApplication=OsApplication_Core0
      Core5_OsTask_ASW_10ms: OsTaskStackAllocation=512,512, OsTaskPriority=3, OsTaskSchedule=FULL, OsTaskAccessingApplication=OsApplication_Core0
      Core5_OsTask_BSW_10ms: OsTaskStackAllocation=512,512, OsTaskPriority=4, OsTaskSchedule=FULL, OsTaskAccessingApplication=OsApplication_Core0
    6 x OsResource, all with OsResourceProperty=STANDARD:
      RTE_RESOURCE_OS_APP_OsApplication_Core{0..5}: OsResourceAccessingApplication=OsApplication_Core{0..5}
