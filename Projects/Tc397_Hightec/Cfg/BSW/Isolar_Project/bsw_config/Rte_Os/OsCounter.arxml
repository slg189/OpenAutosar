AUTOSAR XML (schema 4-2-2)
package /Os
  module config Os
    Rte_TickCounter (OsCounter):
      OsSecondsPerTick = 0.001
      OsCounterType = HARDWARE
      OsCounterMaxAllowedValue = 65535
      OsCounterMinCycle = 1
      OsCounterTicksPerBase = 1
      OsCounterAccessingApplication = OsApplication_Core0
    OsOS:
      OsUseResScheduler = true
      OsSuppressVectorGen = false
      OsNumberOfCores = 6
      OsScalabilityClass = SC1
      OsStatus = STANDARD
      OsUseGetServiceId = false
      OsUseParameterAccess = false
      OsCyclesPerSecond = 300000000
      OsTicksPerSecond = 100000000
      OsDefaultInterrupt = DefaultInterruptHandler
      meter_execution (Param)
      meter_elapsed_time (Param)
