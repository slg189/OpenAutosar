AUTOSAR XML (schema 4-2-2)
package /Rte
  module config Rte
    RteGeneration_0 (RteGeneration):
      RteBypassSupport = NONE
      RteCalibrationSupport = NONE
      RteDevErrorDetect = false
      RteDevErrorDetectUninit = false
      RteGenerationMode = VENDOR_MODE
      RteInExclusiveAreaCheckEnabled = true
      RteIocInteractionReturnValue = RTE_IOC
      RteMeasurementSupport = false
      RteOptimizationMode = RUNTIME
      RteToolChainSignificantCharacters = 31
      RteValueRangeCheckEnabled = false
      RteVfbTraceEnabled = false
    RteInitializationBehavior_0 (RteInitializationBehavior)
    RteOsInteraction_0 (RteOsInteraction)
    6 x RteBswModuleInstance:
      BSWIMPL_BswM: RteBswImplementationRef=BSWIMPL_BswM, RteBswModuleConfigurationRef=BswM
        TE_BswM_MainFunction (RteBswEventToTaskMapping): RteBswPositionInTask=13, RteBswActivationOffset=0.0, RteBswMappedToTaskRef=Core0_OsTask_BSW_10ms, RteBswEventRef=TE_BswM_MainFunction
        RteBswRequiredModeGroupConnection:
          RteBswProvidedModeGroupRef = MDGP_AUTOSAR_BswM_ModeDeclarationGroups_MDG_ECUM_STATE
          RteBswRequiredModeGroupRef = MDGR_BswM_MRP_BswM_MDG
          RteBswProvidedModeGrpModInstRef = BSWIMPL_BswM
        6 x RteBswEventToTaskMapping:
          MSE_BswM_Cfg_ImdtBswNotification_BswM_MRP_BswM_MDG_ECUM_STATE_SHUTDOWN: RteBswEventRef=MSE_BswM_Cfg_ImdtBswNotification_BswM_MRP_BswM_MDG_ECUM_STATE_SHUTDOWN
          MSE_BswM_Cfg_ImdtBswNotification_BswM_MRP_BswM_MDG_ECUM_STATE_STARTUP_TWO: RteBswEventRef=MSE_BswM_Cfg_ImdtBswNotification_BswM_MRP_BswM_MDG_ECUM_STATE_STARTUP_TWO
          MSE_BswM_Cfg_ImdtBswNotification_BswM_MRP_BswM_MDG_ECUM_STATE_RUN: RteBswEventRef=MSE_BswM_Cfg_ImdtBswNotification_BswM_MRP_BswM_MDG_ECUM_STATE_RUN
          MSE_BswM_Cfg_ImdtBswNotification_BswM_MRP_BswM_MDG_ECUM_STATE_PREP_SHUTDOWN: RteBswEventRef=MSE_BswM_Cfg_ImdtBswNotification_BswM_MRP_BswM_MDG_ECUM_STATE_PREP_SHUTDOWN
          MSE_BswM_Cfg_ImdtBswNotification_BswM_MRP_BswM_MDG_ECUM_STATE_APP_RUN: RteBswEventRef=MSE_BswM_Cfg_ImdtBswNotification_BswM_MRP_BswM_MDG_ECUM_STATE_APP_RUN
          MSE_BswM_Cfg_ImdtBswNotification_BswM_MRP_BswM_MDG_ECUM_STATE_STARTUP_ONE: RteBswEventRef=MSE_BswM_Cfg_ImdtBswNotification_BswM_MRP_BswM_MDG_ECUM_STATE_STARTUP_ONE
      Com: RteBswImplementationRef=Com
        EV_SE_MainFunctionRx (RteBswEventToTaskMapping): RteBswPositionInTask=11, RteBswActivationOffset=0.0, RteBswMappedToTaskRef=Core0_OsTask_BSW_10ms, RteBswEventRef=EV_SE_MainFunctionRx
        EV_SE_MainFunctionTx (RteBswEventToTaskMapping): RteBswPositionInTask=12, RteBswActivationOffset=0.0, RteBswMappedToTaskRef=Core0_OsTask_BSW_10ms, RteBswEventRef=EV_SE_MainFunctionTx
      ComM: RteBswImplementationRef=ComM
        3 x RteBswEventToTaskMapping, all with RteBswActivationOffset=0.0, RteBswMappedToTaskRef=Core0_OsTask_BSW_10ms:
          EV_SE_MainFunction_ComMChannel_Can_Network_Channel: RteBswPositionInTask=14, RteBswEventRef=EV_SE_MainFunction_ComMChannel_Can_Network_Channel
          EV_SE_MainFunction_ComMChannel_Can_Network_XCP_Channel: RteBswPositionInTask=15, RteBswEventRef=EV_SE_MainFunction_ComMChannel_Can_Network_XCP_Channel
          EV_SE_MainFunction_ComMChannel_Eth_Network_Channel: RteBswPositionInTask=16, RteBswEventRef=EV_SE_MainFunction_Eth_Network_Channel_EthernetCluster
      PduR: RteBswImplementationRef=PduR
      BSWIMPL_Can: RteBswImplementationRef=BSWIMPL_Can
        3 x RteBswEventToTaskMapping, all with RteBswActivationOffset=0.0:
          BSWTE_MainFunction_BusOff: RteBswPositionInTask=17, RteBswMappedToTaskRef=Core0_OsTask_BSW_10ms, RteBswEventRef=BSWTE_MainFunction_BusOff
          BSWTE_MainFunction_Write: RteBswPositionInTask=5, RteBswMappedToTaskRef=Core0_OsTask_BSW_1ms, RteBswEventRef=BSWTE_MainFunction_Write
          BSWTE_MainFunction_Read: RteBswPositionInTask=4, RteBswMappedToTaskRef=Core0_OsTask_BSW_1ms, RteBswEventRef=BSWTE_MainFunction_Read
      NVM: RteBswImplementationRef=NvM
        EV_SE_MainFunction (RteBswEventToTaskMapping): RteBswPositionInTask=10, RteBswActivationOffset=0.0, RteBswMappedToTaskRef=Core0_OsTask_BSW_10ms, RteBswEventRef=EV_SE_MainFunction
    CPT_BswM (RteSwComponentInstance): RteSoftwareComponentInstanceRef=CPT_BswM
      DRE_BswM_Cfg_DfrdSwcReqst_BswMSwcModeRequest (RteEventToTaskMapping):
        RtePositionInTask = 3
        RteActivationOffset = 0.0
        RteMappedToTaskRef = Core0_BSW_OsTask_SwcRequest
        RteEventRef = DRE_BswM_Cfg_DfrdSwcReqst_BswMSwcModeRequest
      DRE_BswM_Cfg_DfrdSwcReqst_BswM_MRP_SWC_Network (RteEventToTaskMapping):
        RtePositionInTask = 2
        RteActivationOffset = 0.0
        RteMappedToTaskRef = Core0_BSW_OsTask_SwcRequest
        RteEventRef = DRE_BswM_Cfg_DfrdSwcReqst_BswM_MRP_SWC_Network
    CPT_ASW_NVM (RteSwComponentInstance): RteSoftwareComponentInstanceRef=CPT_ASW_NVM
      TE_ASW_NVM_10ms (RteEventToTaskMapping): RtePositionInTask=5, RteActivationOffset=0.0, RteMappedToTaskRef=Core0_OsTask_ASW_10ms, RteEventRef=TE_ASW_NVM_10ms
    3 x RteBswModuleInstance:
      Dcm: RteBswImplementationRef=Dcm
        EV_Dcm_MainFunction (RteBswEventToTaskMapping): RteBswPositionInTask=9, RteBswActivationOffset=0.0, RteBswMappedToTaskRef=Core0_OsTask_BSW_1ms, RteBswEventRef=EV_Dcm_MainFunction
        RteBswRequiredModeGroupConnection:
          RteBswProvidedModeGroupRef = DcmCommunicationControl_ComMChannel_Can_Network_Channel
          RteBswRequiredModeGroupRef = R_DcmCommunicationControl_ComMChannel_Can_Network_Channel
          RteBswProvidedModeGrpModInstRef = Dcm
      CanTp: RteBswImplementationRef=CanTp
        TE_CanTpNormalOperatingMode (RteBswEventToTaskMapping): RteBswPositionInTask=7, RteBswActivationOffset=0.0, RteBswMappedToTaskRef=Core0_OsTask_BSW_1ms, RteBswEventRef=TE_CanTpNormalOperatingMode
      Xcp: RteBswImplementationRef=Xcp
        5 x RteBswEventToTaskMapping, all with RteBswActivationOffset=0.0:
          EV_SE_EventChannel_100ms: RteBswPositionInTask=10, RteBswMappedToTaskRef=Core0_OsTask_ASW_100ms, RteBswEventRef=EV_SE_EventChannel_100ms
          EV_SE_EventChannel_10ms: RteBswPositionInTask=6, RteBswMappedToTaskRef=Core0_OsTask_BSW_10ms, RteBswEventRef=EV_SE_EventChannel_10ms
          EV_SE_EventChannel_50ms: RteBswPositionInTask=1, RteBswMappedToTaskRef=Core0_OsTask_BSW_50ms, RteBswEventRef=EV_SE_EventChannel_50ms
          EV_SE_EthMainFunctionTx: RteBswPositionInTask=17, RteBswMappedToTaskRef=Core0_OsTask_BSW_1ms, RteBswEventRef=EV_SE_EthMainFunctionTx
          EV_SE_MainFunction: RteBswPositionInTask=5, RteBswMappedToTaskRef=Core0_OsTask_BSW_10ms, RteBswEventRef=EV_SE_MainFunction
    CPT_XCP (RteSwComponentInstance): RteSoftwareComponentInstanceRef=CPT_XCP
      TimingEvent_0 (RteEventToTaskMapping): RtePositionInTask=9, RteActivationOffset=0.0, RteMappedToTaskRef=Core0_OsTask_ASW_100ms, RteEventRef=TimingEvent_0
    Dem (RteBswModuleInstance): RteBswImplementationRef=Dem, RteBswModuleConfigurationRef=Dem
      EV_MainFunction (RteBswEventToTaskMapping): RteBswPositionInTask=2, RteBswActivationOffset=0.0, RteBswMappedToTaskRef=Core0_OsTask_BSW_1ms, RteBswEventRef=EV_MainFunction
    CPT_ASW_NM (RteSwComponentInstance): RteSoftwareComponentInstanceRef=CPT_ASW_NM
      TE_ASW_Nm_10ms (RteEventToTaskMapping): RtePositionInTask=3, RteActivationOffset=0.0, RteMappedToTaskRef=Core0_OsTask_ASW_10ms, RteEventRef=TE_ASW_Nm_10ms
    WdgM (RteBswModuleInstance): RteBswImplementationRef=WdgM
      TE_WdgMSupervisionCycle0 (RteBswEventToTaskMapping): RteBswPositionInTask=9, RteBswActivationOffset=0.0, RteBswMappedToTaskRef=Core0_OsTask_BSW_10ms, RteBswEventRef=TE_WdgMSupervisionCycle0
    CanNm (RteBswModuleInstance): RteBswImplementationRef=CanNm
      EV_SE_MainFunction (RteBswEventToTaskMapping): RteBswPositionInTask=8, RteBswActivationOffset=0.0, RteBswMappedToTaskRef=Core0_OsTask_BSW_10ms, RteBswEventRef=EV_SE_MainFunction
    CPT_ASW_CORE1 (RteSwComponentInstance): RteSoftwareComponentInstanceRef=CPT_ASW_CORE1
      TimingEvent_0 (RteEventToTaskMapping): RtePositionInTask=2, RteActivationOffset=0.0, RteMappedToTaskRef=Core1_OsTask_ASW_10ms, RteEventRef=TimingEvent_0
    EcuM (RteBswModuleInstance): RteBswImplementationRef=EcuM
      6 x RteBswEventToTaskMapping, all with RteBswActivationOffset=0.0:
        TE_EcuM_MainFunction_Core0: RteBswPositionInTask=7, RteBswMappedToTaskRef=Core0_OsTask_BSW_10ms, RteBswEventRef=TE_EcuM_MainFunction_Core0
        TE_EcuM_MainFunction_Core{1..3}: RteBswPositionInTask=1, RteBswMappedToTaskRef=Core{1..3}_OsTask_BSW_10ms, RteBswEventRef=TE_EcuM_MainFunction_Core{1..3}
        TE_EcuM_MainFunction_Core5: RteBswPositionInTask=1, RteBswMappedToTaskRef=Core4_OsTask_BSW_10ms, RteBswEventRef=TE_EcuM_MainFunction_Core5
        TE_EcuM_MainFunction_Core4: RteBswPositionInTask=1, RteBswMappedToTaskRef=Core5_OsTask_BSW_10ms, RteBswEventRef=TE_EcuM_MainFunction_Core4
    19 x RteSwComponentInstance:
      CPT_ASW_CORE2: RteSoftwareComponentInstanceRef=CPT_ASW_CORE2
        TimingEvent_0 (RteEventToTaskMapping): RtePositionInTask=2, RteActivationOffset=0.0, RteMappedToTaskRef=Core2_OsTask_ASW_10ms, RteEventRef=TimingEvent_0
      CPT_SensorActuator_PWM: RteSoftwareComponentInstanceRef=CPT_SensorActuator_PWM
        TimingEvent_0 (RteEventToTaskMapping): RtePositionInTask=8, RteActivationOffset=0.0, RteMappedToTaskRef=Core0_OsTask_ASW_100ms, RteEventRef=TimingEvent_0
      CPT_SensorActuator_DIO: RteSoftwareComponentInstanceRef=CPT_SensorActuator_DIO
        TimingEvent_1 (RteEventToTaskMapping): RtePositionInTask=7, RteActivationOffset=0.0, RteMappedToTaskRef=Core0_OsTask_ASW_100ms, RteEventRef=TimingEvent_1
        TimingEvent_0 (RteEventToTaskMapping): RtePositionInTask=4, RteActivationOffset=0.0, RteMappedToTaskRef=Core0_OsTask_ASW_100ms, RteEventRef=TimingEvent_0
      CPT_SensorActuator_ADC: RteSoftwareComponentInstanceRef=CPT_SensorActuator_ADC
        TimingEvent_0 (RteEventToTaskMapping): RtePositionInTask=6, RteActivationOffset=0.0, RteMappedToTaskRef=Core0_OsTask_ASW_100ms, RteEventRef=TimingEvent_0
      CPT_SensorActuator_ICU: RteSoftwareComponentInstanceRef=CPT_SensorActuator_ICU
        TimingEvent_0 (RteEventToTaskMapping): RtePositionInTask=5, RteActivationOffset=0.0, RteMappedToTaskRef=Core0_OsTask_ASW_100ms, RteEventRef=TimingEvent_0
      CPT_ASW_CORE4: RteSoftwareComponentInstanceRef=CPT_ASW_CORE4
        TimingEvent_0 (RteEventToTaskMapping): RtePositionInTask=2, RteActivationOffset=0.0, RteMappedToTaskRef=Core4_OsTask_ASW_10ms, RteEventRef=TimingEvent_0
      CPT_ASW_WDG: RteSoftwareComponentInstanceRef=CPT_ASW_WDG
        TimingEvent_Alive_Supervision_Entity1 (RteEventToTaskMapping): RtePositionInTask=4, RteActivationOffset=0.0, RteMappedToTaskRef=Core0_OsTask_ASW_10ms, RteEventRef=TimingEvent_Alive_Supervision_Entity1
        TimingEvent_Deadline_Supervision_Entity1 (RteEventToTaskMapping): RtePositionInTask=10, RteActivationOffset=0.0, RteMappedToTaskRef=Core0_OsTask_ASW_10ms, RteEventRef=TimingEvent_Deadline_Supervision_Entity1
      CPT_ASW_CORE5: RteSoftwareComponentInstanceRef=CPT_ASW_CORE5
        TimingEvent_0 (RteEventToTaskMapping): RtePositionInTask=2, RteActivationOffset=0.0, RteMappedToTaskRef=Core5_OsTask_ASW_10ms, RteEventRef=TimingEvent_0
      CPT_ASW_CORE3: RteSoftwareComponentInstanceRef=CPT_ASW_CORE3
        TimingEvent_0 (RteEventToTaskMapping): RtePositionInTask=2, RteActivationOffset=0.0, RteMappedToTaskRef=Core3_OsTask_ASW_10ms, RteEventRef=TimingEvent_0
      CPT_ASW_CORE0: RteSoftwareComponentInstanceRef=CPT_ASW_CORE0
        3 x RteEventToTaskMapping, all with RteActivationOffset=0.0:
          TimingEvent_0: RtePositionInTask=3, RteMappedToTaskRef=Core0_OsTask_ASW_100ms, RteEventRef=TimingEvent_0
          TimingEvent_1: RtePositionInTask=14, RteMappedToTaskRef=Core0_OsTask_ASW_10ms, RteEventRef=TimingEvent_1
          AsynchronousServerCallReturnsEvent_0: RtePositionInTask=5, RteMappedToTaskRef=Core0_BSW_OsTask_SwcRequest, RteEventRef=AsynchronousServerCallReturnsEvent_0
      CPT_CDD_CORE0: RteSoftwareComponentInstanceRef=CPT_CDD_CORE0
        3 x RteEventToTaskMapping, all with RteActivationOffset=0.0:
          TimingEvent_0: RtePositionInTask=11, RteMappedToTaskRef=Core0_OsTask_ASW_10ms, RteEventRef=TimingEvent_0
          TimingEvent_1: RtePositionInTask=10, RteMappedToTaskRef=Core0_OsTask_BSW_1ms, RteEventRef=TimingEvent_1
          OperationInvokedEvent_0: RtePositionInTask=6, RteMappedToTaskRef=Core0_BSW_OsTask_SwcRequest, RteEventRef=OperationInvokedEvent_0
      CPT_CDD_CORE3: RteSoftwareComponentInstanceRef=CPT_CDD_CORE3
        TimingEvent_0 (RteEventToTaskMapping): RtePositionInTask=1, RteActivationOffset=0.0, RteMappedToTaskRef=Core3_OsTask_ASW_10ms, RteEventRef=TimingEvent_0
      CPT_CDD_CORE2: RteSoftwareComponentInstanceRef=CPT_CDD_CORE2
        TimingEvent_0 (RteEventToTaskMapping): RtePositionInTask=1, RteActivationOffset=0.0, RteMappedToTaskRef=Core2_OsTask_ASW_10ms, RteEventRef=TimingEvent_0
      CPT_CDD_CORE1: RteSoftwareComponentInstanceRef=CPT_CDD_CORE1
        TimingEvent_0 (RteEventToTaskMapping): RtePositionInTask=1, RteActivationOffset=0.0, RteMappedToTaskRef=Core1_OsTask_ASW_10ms, RteEventRef=TimingEvent_0
      CPT_CDD_CORE4: RteSoftwareComponentInstanceRef=CPT_CDD_CORE4
        TimingEvent_0 (RteEventToTaskMapping): RtePositionInTask=1, RteActivationOffset=0.0, RteMappedToTaskRef=Core4_OsTask_ASW_10ms, RteEventRef=TimingEvent_0
      CPT_CDD_CORE5: RteSoftwareComponentInstanceRef=CPT_CDD_CORE5
        TimingEvent_0 (RteEventToTaskMapping): RtePositionInTask=1, RteActivationOffset=0.0, RteMappedToTaskRef=Core5_OsTask_ASW_10ms, RteEventRef=TimingEvent_0
      CPT_ASW_DCM: RteSoftwareComponentInstanceRef=CPT_ASW_DCM
        3 x RteEventToTaskMapping, all with RteActivationOffset=0.0, RteMappedToTaskRef=Core0_OsTask_ASW_10ms:
          TE_ModeControl_NRC22: RtePositionInTask=12, RteEventRef=TE_ModeControl_NRC22
          TE_ModeControl_NRC72: RtePositionInTask=13, RteEventRef=TE_ModeControl_NRC72
          TE_ASW_DCM: RtePositionInTask=6, RteEventRef=TE_ASW_DCM
      CPT_ASW_DEM: RteSoftwareComponentInstanceRef=CPT_ASW_DEM
        TimingEvent_Dem_SWC (RteEventToTaskMapping): RtePositionInTask=7, RteActivationOffset=0.0, RteMappedToTaskRef=Core0_OsTask_ASW_10ms, RteEventRef=TimingEvent_Dem_SWC
      CPT_ASW_ETH: RteSoftwareComponentInstanceRef=CPT_ASW_ETH
        TE_ETH_SWC_10ms (RteEventToTaskMapping): RtePositionInTask=15, RteActivationOffset=0.0, RteMappedToTaskRef=Core0_OsTask_ASW_10ms, RteEventRef=TE_ETH_SWC_10ms
    EthIf (RteBswModuleInstance): RteBswImplementationRef=EthIf
      3 x RteBswEventToTaskMapping, all with RteBswActivationOffset=0.0:
        EV_SE_MainFunctionTx: RteBswPositionInTask=14, RteBswMappedToTaskRef=Core0_OsTask_BSW_1ms, RteBswEventRef=EV_SE_MainFunctionTx
        EV_SE_MainFunctionState: RteBswPositionInTask=2, RteBswMappedToTaskRef=Core0_OsTask_BSW_5ms, RteBswEventRef=EV_SE_MainFunctionState
        EV_SE_MainFunctionRx_EthIfPhysCtrlRxMainFunctionPriorityProcessing: RteBswPositionInTask=3, RteBswMappedToTaskRef=Core0_OsTask_BSW_10ms, RteBswEventRef=EV_SE_MainFunctionRx_EthIfPhysCtrlRxMainFunctionPriorityProcessing
    EthSM (RteBswModuleInstance): RteBswImplementationRef=EthSM
      EV_SE_MainFunction (RteBswEventToTaskMapping): RteBswPositionInTask=19, RteBswActivationOffset=0.0, RteBswMappedToTaskRef=Core0_OsTask_BSW_10ms, RteBswEventRef=EV_SE_MainFunction
    CPT_DoIP (RteSwComponentInstance): RteSoftwareComponentInstanceRef=CPT_DoIP
      SwcModeSwitchEvent_0 (RteEventToTaskMapping): RteEventRef=SwcModeSwitchEvent_0
      SwcModeSwitchEvent_1 (RteEventToTaskMapping): RteEventRef=SwcModeSwitchEvent_1
    3 x RteBswModuleInstance:
      DoIP: RteBswImplementationRef=DoIP
        EV_DoIP_MainFunction (RteBswEventToTaskMapping): RteBswPositionInTask=20, RteBswActivationOffset=0.0, RteBswMappedToTaskRef=Core0_OsTask_BSW_10ms, RteBswEventRef=EV_DoIP_MainFunction
      SoAd: RteBswImplementationRef=SoAd
        EV_SE_MainFunction (RteBswEventToTaskMapping): RteBswPositionInTask=11, RteBswActivationOffset=0.0, RteBswMappedToTaskRef=Core0_OsTask_BSW_1ms, RteBswEventRef=EV_SE_MainFunction
      TcpIp: RteBswImplementationRef=TcpIp
        EV_SE_MainFunction (RteBswEventToTaskMapping): RteBswPositionInTask=12, RteBswActivationOffset=0.0, RteBswMappedToTaskRef=Core0_OsTask_BSW_1ms, RteBswEventRef=EV_SE_MainFunction
    CPT_ASW_COM (RteSwComponentInstance): RteSoftwareComponentInstanceRef=CPT_ASW_COM
      TE_SWC_COM_10ms (RteEventToTaskMapping): RtePositionInTask=2, RteActivationOffset=0.0, RteMappedToTaskRef=Core0_OsTask_ASW_10ms, RteEventRef=TE_SWC_COM_10ms
    3 x RteBswModuleInstance:
      CanSM: RteBswImplementationRef=CanSM
        EV_SE_MainFunction (RteBswEventToTaskMapping): RteBswPositionInTask=1, RteBswActivationOffset=0.0, RteBswMappedToTaskRef=Core0_OsTask_BSW_1ms, RteBswEventRef=EV_SE_MainFunction
      EthTSyn: RteBswImplementationRef=EthTSyn
        EV_SE_MainFunction (RteBswEventToTaskMapping): RteBswPositionInTask=2, RteBswActivationOffset=0.0, RteBswMappedToTaskRef=Core0_OsTask_BSW_10ms, RteBswEventRef=EV_SE_MainFunction
      StbM: RteBswImplementationRef=StbM
        TE_StbM_MainFunction (RteBswEventToTaskMapping): RteBswPositionInTask=1, RteBswActivationOffset=0.0, RteBswMappedToTaskRef=Core0_OsTask_BSW_10ms, RteBswEventRef=TE_StbM_MainFunction
    CPT_ASW_StbM (RteSwComponentInstance): RteSoftwareComponentInstanceRef=CPT_ASW_StbM
      TimingEvent_0 (RteEventToTaskMapping): RtePositionInTask=2, RteActivationOffset=0.0, RteMappedToTaskRef=Core0_OsTask_ASW_100ms, RteEventRef=TimingEvent_0
    CPT_SensorActuator_DIO_Test (RteSwComponentInstance): RteSoftwareComponentInstanceRef=CPT_SensorActuator_DIO_Test
      TimingEvent_0 (RteEventToTaskMapping): RtePositionInTask=1, RteActivationOffset=0.0, RteMappedToTaskRef=Core0_OsTask_ASW_100ms, RteEventRef=TimingEvent_0
