AUTOSAR XML (schema 4-2-2)
package /RB/UBK/Project/EcucModuleConfigurationValuess
  module config Crc
    CrcGeneral_0 (CrcGeneral):
      Crc8H2F = 1
      Crc8H2FMode = CRC_8H2F_TABLE
      Crc8 = 1
      Crc8Mode = CRC_8_TABLE
      Crc16 = 1
      Crc16Mode = CRC_16_TABLE
      Crc32 = 1
      Crc32Mode = CRC_32_TABLE
      Crc32P4 = 1
      Crc64 = false
      Crc64Mode = CRC_64_TABLE
      CrcVersionInfoApi = 1
      Crc32P4Mode = CRC_32P4_TABLE
    CrcRbRevision_0 (CrcRbRevision): CrcRbRev=Revision_2
