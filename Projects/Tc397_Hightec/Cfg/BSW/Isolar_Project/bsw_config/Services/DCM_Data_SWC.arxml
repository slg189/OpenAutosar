AUTOSAR XML (schema 4-2-2)
package /AUTOSAR_Dcm/ApplicationDataTypes
  16 x app type, all with category=VALUE:
    Dcm_DataType_0xB950_New_Bit_Field: compu {mask 15: 0=Default Value (BitTableDT_002_Event_2_0_Default_Value), mask 15: 1=Power fail reset (BitTableDT_002_Event_2_1_Power_fail_reset), mask 15: 2=External reset (BitTableDT_002_Event_2_2_External_reset), mask 15: 3=Flag for code or data flash fatal error (BitTableDT_002_Event_2_3_Flag_for_code_or_data_flash_fa), mask 15: 4=Low Power Reset (2.7V) (BitTableDT_002_Event_2_4_Low_Power_Reset_27V), mask 15: 5=Flag for CMU clock frequency higher/lower than reference (BitTableDT_002_Event_2_5_Flag_for_CMU_clock_frequency_h), mask 15: 6=Flag for FXOSC frequency lower than reference (BitTableDT_002_Event_2_6_Flag_for_FXOSC_frequency_lower), mask 15: 7=Flag for FMPLL fail (BitTableDT_002_Event_2_7_Flag_for_FMPLL_fail), mask 15: 8=Flag for software reset (BitTableDT_002_Event_2_8_Flag_for_software_reset), mask 15: 9=Flag for 2.7 V low-voltage detected (BitTableDT_002_Event_2_9_Flag_for_27_V_lowvoltage_detec), mask 15: 10=Flag for 1.2 V low-voltage detected (power domain #1) (BitTableDT_002_Event_2_10_Flag_for_12_V_lowvoltage_detec), mask 15: 11=Flag for 1.2 V low-voltage detected (power domain #0) (BitTableDT_002_Event_2_11_Flag_for_12_V_lowvoltage_detec), mask 240: 0=Default Value (BitTableDT_002_Event_1_0_Default_Value), mask 240: 16=Power fail reset (BitTableDT_002_Event_1_16_Power_fail_reset), mask 240: 32=External reset (BitTableDT_002_Event_1_32_External_reset), mask 240: 48=Flag for code or data flash fatal error (BitTableDT_002_Event_1_48_Flag_for_code_or_data_flash_fa), mask 240: 64=Low Power Reset (2.7V) (BitTableDT_002_Event_1_64_Low_Power_Reset_27V), mask 240: 80=Flag for CMU clock frequency higher/lower than reference (BitTableDT_002_Event_1_80_Flag_for_CMU_clock_frequency_h), mask 240: 96=Flag for FXOSC frequency lower than reference (BitTableDT_002_Event_1_96_Flag_for_FXOSC_frequency_lower), mask 240: 112=Flag for FMPLL fail (BitTableDT_002_Event_1_112_Flag_for_FMPLL_fail), mask 240: 128=Flag for software reset (BitTableDT_002_Event_1_128_Flag_for_software_reset), mask 240: 144=Flag for 2.7 V low-voltage detected (BitTableDT_002_Event_1_144_Flag_for_27_V_lowvoltage_detec), mask 240: 160=Flag for 1.2 V low-voltage detected (power domain #1) (BitTableDT_002_Event_1_160_Flag_for_12_V_lowvoltage_detec), mask 240: 176=Flag for 1.2 V low-voltage detected (power domain #0) (BitTableDT_002_Event_1_176_Flag_for_12_V_lowvoltage_detec)}
    Dcm_DataType_0xB950_New_Bit_Field_8: compu {mask 15: 0=Default Value (BitTableDT_003_Event_4_0_Default_Value), mask 15: 1=Power fail reset (BitTableDT_003_Event_4_1_Power_fail_reset), mask 15: 2=External reset (BitTableDT_003_Event_4_2_External_reset), mask 15: 3=Flag for code or data flash fatal error (BitTableDT_003_Event_4_3_Flag_for_code_or_data_flash_fa), mask 15: 4=Low Power Reset (2.7V) (BitTableDT_003_Event_4_4_Low_Power_Reset_27V), mask 15: 5=Flag for CMU clock frequency higher/lower than reference (BitTableDT_003_Event_4_5_Flag_for_CMU_clock_frequency_h), mask 15: 6=Flag for FXOSC frequency lower than reference (BitTableDT_003_Event_4_6_Flag_for_FXOSC_frequency_lower), mask 15: 7=Flag for FMPLL fail (BitTableDT_003_Event_4_7_Flag_for_FMPLL_fail), mask 15: 8=Flag for software reset (BitTableDT_003_Event_4_8_Flag_for_software_reset), mask 15: 9=Flag for 2.7 V low-voltage detected (BitTableDT_003_Event_4_9_Flag_for_27_V_lowvoltage_detec), mask 15: 10=Flag for 1.2 V low-voltage detected (power domain #1) (BitTableDT_003_Event_4_10_Flag_for_12_V_lowvoltage_detec), mask 15: 11=Flag for 1.2 V low-voltage detected (power domain #0) (BitTableDT_003_Event_4_11_Flag_for_12_V_lowvoltage_detec), mask 240: 0=Default Value (BitTableDT_003_Event_3_0_Default_Value), mask 240: 16=Power fail reset (BitTableDT_003_Event_3_16_Power_fail_reset), mask 240: 32=External reset (BitTableDT_003_Event_3_32_External_reset), mask 240: 48=Flag for code or data flash fatal error (BitTableDT_003_Event_3_48_Flag_for_code_or_data_flash_fa), mask 240: 64=Low Power Reset (2.7V) (BitTableDT_003_Event_3_64_Low_Power_Reset_27V), mask 240: 80=Flag for CMU clock frequency higher/lower than reference (BitTableDT_003_Event_3_80_Flag_for_CMU_clock_frequency_h), mask 240: 96=Flag for FXOSC frequency lower than reference (BitTableDT_003_Event_3_96_Flag_for_FXOSC_frequency_lower), mask 240: 112=Flag for FMPLL fail (BitTableDT_003_Event_3_112_Flag_for_FMPLL_fail), mask 240: 128=Flag for software reset (BitTableDT_003_Event_3_128_Flag_for_software_reset), mask 240: 144=Flag for 2.7 V low-voltage detected (BitTableDT_003_Event_3_144_Flag_for_27_V_lowvoltage_detec), mask 240: 160=Flag for 1.2 V low-voltage detected (power domain #1) (BitTableDT_003_Event_3_160_Flag_for_12_V_lowvoltage_detec), mask 240: 176=Flag for 1.2 V low-voltage detected (power domain #0) (BitTableDT_003_Event_3_176_Flag_for_12_V_lowvoltage_detec)}
    Dcm_DataType_0xB950_New_Bit_Field_7: compu {mask 15: 0=Default Value (BitTableDT_004_Event_6_0_Default_Value), mask 15: 1=Power fail reset (BitTableDT_004_Event_6_1_Power_fail_reset), mask 15: 2=External reset (BitTableDT_004_Event_6_2_External_reset), mask 15: 3=Flag for code or data flash fatal error (BitTableDT_004_Event_6_3_Flag_for_code_or_data_flash_fa), mask 15: 4=Low Power Reset (2.7V) (BitTableDT_004_Event_6_4_Low_Power_Reset_27V), mask 15: 5=Flag for CMU clock frequency higher/lower than reference (BitTableDT_004_Event_6_5_Flag_for_CMU_clock_frequency_h), mask 15: 6=Flag for FXOSC frequency lower than reference (BitTableDT_004_Event_6_6_Flag_for_FXOSC_frequency_lower), mask 15: 7=Flag for FMPLL fail (BitTableDT_004_Event_6_7_Flag_for_FMPLL_fail), mask 15: 8=Flag for software reset (BitTableDT_004_Event_6_8_Flag_for_software_reset), mask 15: 9=Flag for 2.7 V low-voltage detected (BitTableDT_004_Event_6_9_Flag_for_27_V_lowvoltage_detec), mask 15: 10=Flag for 1.2 V low-voltage detected (power domain #1) (BitTableDT_004_Event_6_10_Flag_for_12_V_lowvoltage_detec), mask 15: 11=Flag for 1.2 V low-voltage detected (power domain #0) (BitTableDT_004_Event_6_11_Flag_for_12_V_lowvoltage_detec), mask 240: 0=Default Value (BitTableDT_004_Event_5_0_Default_Value), mask 240: 16=Power fail reset (BitTableDT_004_Event_5_16_Power_fail_reset), mask 240: 32=External reset (BitTableDT_004_Event_5_32_External_reset), mask 240: 48=Flag for code or data flash fatal error (BitTableDT_004_Event_5_48_Flag_for_code_or_data_flash_fa), mask 240: 64=Low Power Reset (2.7V) (BitTableDT_004_Event_5_64_Low_Power_Reset_27V), mask 240: 80=Flag for CMU clock frequency higher/lower than reference (BitTableDT_004_Event_5_80_Flag_for_CMU_clock_frequency_h), mask 240: 96=Flag for FXOSC frequency lower than reference (BitTableDT_004_Event_5_96_Flag_for_FXOSC_frequency_lower), mask 240: 112=Flag for FMPLL fail (BitTableDT_004_Event_5_112_Flag_for_FMPLL_fail), mask 240: 128=Flag for software reset (BitTableDT_004_Event_5_128_Flag_for_software_reset), mask 240: 144=Flag for 2.7 V low-voltage detected (BitTableDT_004_Event_5_144_Flag_for_27_V_lowvoltage_detec), mask 240: 160=Flag for 1.2 V low-voltage detected (power domain #1) (BitTableDT_004_Event_5_160_Flag_for_12_V_lowvoltage_detec), mask 240: 176=Flag for 1.2 V low-voltage detected (power domain #0) (BitTableDT_004_Event_5_176_Flag_for_12_V_lowvoltage_detec)}
    Dcm_DataType_0xB950_New_Bit_Field_6: compu {mask 15: 0=Default Value (BitTableDT_005_Event_8_0_Default_Value), mask 15: 1=Power fail reset (BitTableDT_005_Event_8_1_Power_fail_reset), mask 15: 2=External reset (BitTableDT_005_Event_8_2_External_reset), mask 15: 3=Flag for code or data flash fatal error (BitTableDT_005_Event_8_3_Flag_for_code_or_data_flash_fa), mask 15: 4=Low Power Reset (2.7V) (BitTableDT_005_Event_8_4_Low_Power_Reset_27V), mask 15: 5=Flag for CMU clock frequency higher/lower than reference (BitTableDT_005_Event_8_5_Flag_for_CMU_clock_frequency_h), mask 15: 6=Flag for FXOSC frequency lower than reference (BitTableDT_005_Event_8_6_Flag_for_FXOSC_frequency_lower), mask 15: 7=Flag for FMPLL fail (BitTableDT_005_Event_8_7_Flag_for_FMPLL_fail), mask 15: 8=Flag for software reset (BitTableDT_005_Event_8_8_Flag_for_software_reset), mask 15: 9=Flag for 2.7 V low-voltage detected (BitTableDT_005_Event_8_9_Flag_for_27_V_lowvoltage_detec), mask 15: 10=Flag for 1.2 V low-voltage detected (power domain #1) (BitTableDT_005_Event_8_10_Flag_for_12_V_lowvoltage_detec), mask 15: 11=Flag for 1.2 V low-voltage detected (power domain #0) (BitTableDT_005_Event_8_11_Flag_for_12_V_lowvoltage_detec), mask 240: 0=Default Value (BitTableDT_005_Event_7_0_Default_Value), mask 240: 16=Power fail reset (BitTableDT_005_Event_7_16_Power_fail_reset), mask 240: 32=External reset (BitTableDT_005_Event_7_32_External_reset), mask 240: 48=Flag for code or data flash fatal error (BitTableDT_005_Event_7_48_Flag_for_code_or_data_flash_fa), mask 240: 64=Low Power Reset (2.7V) (BitTableDT_005_Event_7_64_Low_Power_Reset_27V), mask 240: 80=Flag for CMU clock frequency higher/lower than reference (BitTableDT_005_Event_7_80_Flag_for_CMU_clock_frequency_h), mask 240: 96=Flag for FXOSC frequency lower than reference (BitTableDT_005_Event_7_96_Flag_for_FXOSC_frequency_lower), mask 240: 112=Flag for FMPLL fail (BitTableDT_005_Event_7_112_Flag_for_FMPLL_fail), mask 240: 128=Flag for software reset (BitTableDT_005_Event_7_128_Flag_for_software_reset), mask 240: 144=Flag for 2.7 V low-voltage detected (BitTableDT_005_Event_7_144_Flag_for_27_V_lowvoltage_detec), mask 240: 160=Flag for 1.2 V low-voltage detected (power domain #1) (BitTableDT_005_Event_7_160_Flag_for_12_V_lowvoltage_detec), mask 240: 176=Flag for 1.2 V low-voltage detected (power domain #0) (BitTableDT_005_Event_7_176_Flag_for_12_V_lowvoltage_detec)}
    Dcm_DataType_0xB950_New_Bit_Field_5: compu {mask 15: 0=Default Value (BitTableDT_006_Event_10_0_Default_Value), mask 15: 1=Power fail reset (BitTableDT_006_Event_10_1_Power_fail_reset), mask 15: 2=External reset (BitTableDT_006_Event_10_2_External_reset), mask 15: 3=Flag for code or data flash fatal error (BitTableDT_006_Event_10_3_Flag_for_code_or_data_flash_fa), mask 15: 4=Low Power Reset (2.7V) (BitTableDT_006_Event_10_4_Low_Power_Reset_27V), mask 15: 5=Flag for CMU clock frequency higher/lower than reference (BitTableDT_006_Event_10_5_Flag_for_CMU_clock_frequency_h), mask 15: 6=Flag for FXOSC frequency lower than reference (BitTableDT_006_Event_10_6_Flag_for_FXOSC_frequency_lower), mask 15: 7=Flag for FMPLL fail (BitTableDT_006_Event_10_7_Flag_for_FMPLL_fail), mask 15: 8=Flag for software reset (BitTableDT_006_Event_10_8_Flag_for_software_reset), mask 15: 9=Flag for 2.7 V low-voltage detected (BitTableDT_006_Event_10_9_Flag_for_27_V_lowvoltage_detec), mask 15: 10=Flag for 1.2 V low-voltage detected (power domain #1) (BitTableDT_006_Event_10_10_Flag_for_12_V_lowvoltage_detec), mask 15: 11=Flag for 1.2 V low-voltage detected (power domain #0) (BitTableDT_006_Event_10_11_Flag_for_12_V_lowvoltage_detec), mask 240: 0=Default Value (BitTableDT_006_Event_9_0_Default_Value), mask 240: 16=Power fail reset (BitTableDT_006_Event_9_16_Power_fail_reset), mask 240: 32=External reset (BitTableDT_006_Event_9_32_External_reset), mask 240: 48=Flag for code or data flash fatal error (BitTableDT_006_Event_9_48_Flag_for_code_or_data_flash_fa), mask 240: 64=Low Power Reset (2.7V) (BitTableDT_006_Event_9_64_Low_Power_Reset_27V), mask 240: 80=Flag for CMU clock frequency higher/lower than reference (BitTableDT_006_Event_9_80_Flag_for_CMU_clock_frequency_h), mask 240: 96=Flag for FXOSC frequency lower than reference (BitTableDT_006_Event_9_96_Flag_for_FXOSC_frequency_lower), mask 240: 112=Flag for FMPLL fail (BitTableDT_006_Event_9_112_Flag_for_FMPLL_fail), mask 240: 128=Flag for software reset (BitTableDT_006_Event_9_128_Flag_for_software_reset), mask 240: 144=Flag for 2.7 V low-voltage detected (BitTableDT_006_Event_9_144_Flag_for_27_V_lowvoltage_detec), mask 240: 160=Flag for 1.2 V low-voltage detected (power domain #1) (BitTableDT_006_Event_9_160_Flag_for_12_V_lowvoltage_detec), mask 240: 176=Flag for 1.2 V low-voltage detected (power domain #0) (BitTableDT_006_Event_9_176_Flag_for_12_V_lowvoltage_detec)}
    Dcm_DataType_0xB950_New_Bit_Field_4: compu {mask 15: 0=Default Value (BitTableDT_007_Event_12_0_Default_Value), mask 15: 1=Power fail reset (BitTableDT_007_Event_12_1_Power_fail_reset), mask 15: 2=External reset (BitTableDT_007_Event_12_2_External_reset), mask 15: 3=Flag for code or data flash fatal error (BitTableDT_007_Event_12_3_Flag_for_code_or_data_flash_fa), mask 15: 4=Low Power Reset (2.7V) (BitTableDT_007_Event_12_4_Low_Power_Reset_27V), mask 15: 5=Flag for CMU clock frequency higher/lower than reference (BitTableDT_007_Event_12_5_Flag_for_CMU_clock_frequency_h), mask 15: 6=Flag for FXOSC frequency lower than reference (BitTableDT_007_Event_12_6_Flag_for_FXOSC_frequency_lower), mask 15: 7=Flag for FMPLL fail (BitTableDT_007_Event_12_7_Flag_for_FMPLL_fail), mask 15: 8=Flag for software reset (BitTableDT_007_Event_12_8_Flag_for_software_reset), mask 15: 9=Flag for 2.7 V low-voltage detected (BitTableDT_007_Event_12_9_Flag_for_27_V_lowvoltage_detec), mask 15: 10=Flag for 1.2 V low-voltage detected (power domain #1) (BitTableDT_007_Event_12_10_Flag_for_12_V_lowvoltage_detec), mask 15: 11=Flag for 1.2 V low-voltage detected (power domain #0) (BitTableDT_007_Event_12_11_Flag_for_12_V_lowvoltage_detec), mask 240: 0=Default Value (BitTableDT_007_Event_11_0_Default_Value), mask 240: 16=Power fail reset (BitTableDT_007_Event_11_16_Power_fail_reset), mask 240: 32=External reset (BitTableDT_007_Event_11_32_External_reset), mask 240: 48=Flag for code or data flash fatal error (BitTableDT_007_Event_11_48_Flag_for_code_or_data_flash_fa), mask 240: 64=Low Power Reset (2.7V) (BitTableDT_007_Event_11_64_Low_Power_Reset_27V), mask 240: 80=Flag for CMU clock frequency higher/lower than reference (BitTableDT_007_Event_11_80_Flag_for_CMU_clock_frequency_h), mask 240: 96=Flag for FXOSC frequency lower than reference (BitTableDT_007_Event_11_96_Flag_for_FXOSC_frequency_lower), mask 240: 112=Flag for FMPLL fail (BitTableDT_007_Event_11_112_Flag_for_FMPLL_fail), mask 240: 128=Flag for software reset (BitTableDT_007_Event_11_128_Flag_for_software_reset), mask 240: 144=Flag for 2.7 V low-voltage detected (BitTableDT_007_Event_11_144_Flag_for_27_V_lowvoltage_detec), mask 240: 160=Flag for 1.2 V low-voltage detected (power domain #1) (BitTableDT_007_Event_11_160_Flag_for_12_V_lowvoltage_detec), mask 240: 176=Flag for 1.2 V low-voltage detected (power domain #0) (BitTableDT_007_Event_11_176_Flag_for_12_V_lowvoltage_detec)}
    Dcm_DataType_0xB950_New_Bit_Field_3: compu {mask 15: 0=Default Value (BitTableDT_008_Event_14_0_Default_Value), mask 15: 1=Power fail reset (BitTableDT_008_Event_14_1_Power_fail_reset), mask 15: 2=External reset (BitTableDT_008_Event_14_2_External_reset), mask 15: 3=Flag for code or data flash fatal error (BitTableDT_008_Event_14_3_Flag_for_code_or_data_flash_fa), mask 15: 4=Low Power Reset (2.7V) (BitTableDT_008_Event_14_4_Low_Power_Reset_27V), mask 15: 5=Flag for CMU clock frequency higher/lower than reference (BitTableDT_008_Event_14_5_Flag_for_CMU_clock_frequency_h), mask 15: 6=Flag for FXOSC frequency lower than reference (BitTableDT_008_Event_14_6_Flag_for_FXOSC_frequency_lower), mask 15: 7=Flag for FMPLL fail (BitTableDT_008_Event_14_7_Flag_for_FMPLL_fail), mask 15: 8=Flag for software reset (BitTableDT_008_Event_14_8_Flag_for_software_reset), mask 15: 9=Flag for 2.7 V low-voltage detected (BitTableDT_008_Event_14_9_Flag_for_27_V_lowvoltage_detec), mask 15: 10=Flag for 1.2 V low-voltage detected (power domain #1) (BitTableDT_008_Event_14_10_Flag_for_12_V_lowvoltage_detec), mask 15: 11=Flag for 1.2 V low-voltage detected (power domain #0) (BitTableDT_008_Event_14_11_Flag_for_12_V_lowvoltage_detec), mask 240: 0=Default Value (BitTableDT_008_Event_13_0_Default_Value), mask 240: 16=Power fail reset (BitTableDT_008_Event_13_16_Power_fail_reset), mask 240: 32=External reset (BitTableDT_008_Event_13_32_External_reset), mask 240: 48=Flag for code or data flash fatal error (BitTableDT_008_Event_13_48_Flag_for_code_or_data_flash_fa), mask 240: 64=Low Power Reset (2.7V) (BitTableDT_008_Event_13_64_Low_Power_Reset_27V), mask 240: 80=Flag for CMU clock frequency higher/lower than reference (BitTableDT_008_Event_13_80_Flag_for_CMU_clock_frequency_h), mask 240: 96=Flag for FXOSC frequency lower than reference (BitTableDT_008_Event_13_96_Flag_for_FXOSC_frequency_lower), mask 240: 112=Flag for FMPLL fail (BitTableDT_008_Event_13_112_Flag_for_FMPLL_fail), mask 240: 128=Flag for software reset (BitTableDT_008_Event_13_128_Flag_for_software_reset), mask 240: 144=Flag for 2.7 V low-voltage detected (BitTableDT_008_Event_13_144_Flag_for_27_V_lowvoltage_detec), mask 240: 160=Flag for 1.2 V low-voltage detected (power domain #1) (BitTableDT_008_Event_13_160_Flag_for_12_V_lowvoltage_detec), mask 240: 176=Flag for 1.2 V low-voltage detected (power domain #0) (BitTableDT_008_Event_13_176_Flag_for_12_V_lowvoltage_detec)}
    Dcm_DataType_0xB950_New_Bit_Field_2: compu {mask 15: 0=Default Value (BitTableDT_009_Event_16_0_Default_Value), mask 15: 1=Power fail reset (BitTableDT_009_Event_16_1_Power_fail_reset), mask 15: 2=External reset (BitTableDT_009_Event_16_2_External_reset), mask 15: 3=Flag for code or data flash fatal error (BitTableDT_009_Event_16_3_Flag_for_code_or_data_flash_fa), mask 15: 4=Low Power Reset (2.7V) (BitTableDT_009_Event_16_4_Low_Power_Reset_27V), mask 15: 5=Flag for CMU clock frequency higher/lower than reference (BitTableDT_009_Event_16_5_Flag_for_CMU_clock_frequency_h), mask 15: 6=Flag for FXOSC frequency lower than reference (BitTableDT_009_Event_16_6_Flag_for_FXOSC_frequency_lower), mask 15: 7=Flag for FMPLL fail (BitTableDT_009_Event_16_7_Flag_for_FMPLL_fail), mask 15: 8=Flag for software reset (BitTableDT_009_Event_16_8_Flag_for_software_reset), mask 15: 9=Flag for 2.7 V low-voltage detected (BitTableDT_009_Event_16_9_Flag_for_27_V_lowvoltage_detec), mask 15: 10=Flag for 1.2 V low-voltage detected (power domain #1) (BitTableDT_009_Event_16_10_Flag_for_12_V_lowvoltage_detec), mask 15: 11=Flag for 1.2 V low-voltage detected (power domain #0) (BitTableDT_009_Event_16_11_Flag_for_12_V_lowvoltage_detec), mask 240: 0=Default Value (BitTableDT_009_Event_15_0_Default_Value), mask 240: 16=Power fail reset (BitTableDT_009_Event_15_16_Power_fail_reset), mask 240: 32=External reset (BitTableDT_009_Event_15_32_External_reset), mask 240: 48=Flag for code or data flash fatal error (BitTableDT_009_Event_15_48_Flag_for_code_or_data_flash_fa), mask 240: 64=Low Power Reset (2.7V) (BitTableDT_009_Event_15_64_Low_Power_Reset_27V), mask 240: 80=Flag for CMU clock frequency higher/lower than reference (BitTableDT_009_Event_15_80_Flag_for_CMU_clock_frequency_h), mask 240: 96=Flag for FXOSC frequency lower than reference (BitTableDT_009_Event_15_96_Flag_for_FXOSC_frequency_lower), mask 240: 112=Flag for FMPLL fail (BitTableDT_009_Event_15_112_Flag_for_FMPLL_fail), mask 240: 128=Flag for software reset (BitTableDT_009_Event_15_128_Flag_for_software_reset), mask 240: 144=Flag for 2.7 V low-voltage detected (BitTableDT_009_Event_15_144_Flag_for_27_V_lowvoltage_detec), mask 240: 160=Flag for 1.2 V low-voltage detected (power domain #1) (BitTableDT_009_Event_15_160_Flag_for_12_V_lowvoltage_detec), mask 240: 176=Flag for 1.2 V low-voltage detected (power domain #0) (BitTableDT_009_Event_15_176_Flag_for_12_V_lowvoltage_detec)}
    Dcm_DataType_0xD901_New_Bit_Field: compu {mask 1: 0=off (BitTableDT_010_EPTRdy_0_off), mask 1: 1=on (BitTableDT_010_EPTRdy_1_on)}
    Dcm_DataType_0xE900_New_Bit_Field: compu {mask 15: 0=Key Off (BitTableDT_011_SysPwrMd_0_Key_Off), mask 15: 1=KL.R (BitTableDT_011_SysPwrMd_1_KLR), mask 15: 2=KL.15 (BitTableDT_011_SysPwrMd_2_KL15), mask 15: 3=KL.50 (BitTableDT_011_SysPwrMd_3_KL50)}
    Dcm_DataType_0xF100_Number_of_Module: compu {identical}, range raw 0..255
    Dcm_DataType_0xF100_Module_ID_1: compu {1=Application Software (Module_ID_1_Application_Software), 2=Clibration Data 1 (Module_ID_2_Clibration_Data_1), 3=Clibration Data 2 (Module_ID_3_Clibration_Data_2), 4=Clibration Data 3 (Module_ID_4_Clibration_Data_3), 51=ECU Secondary Application Software (Module_ID_51_ECU_Secondary_Application_Soft), 90=Network Configuration Data (Module_ID_90_Network_Configuration_Data)}
    Dcm_DataType_0xF100_SVN_1: compu {identical}, range raw 0..4294967295
    Dcm_DataType_0xF100_Module_ID_2: compu {1=Application Software (Module_ID_1_Application_Software), 2=Clibration Data 1 (Module_ID_2_Clibration_Data_1), 3=Clibration Data 2 (Module_ID_3_Clibration_Data_2), 4=Clibration Data 3 (Module_ID_4_Clibration_Data_3), 51=ECU Secondary Application Software (Module_ID_51_ECU_Secondary_Application_Soft), 90=Network Configuration Data (Module_ID_90_Network_Configuration_Data)}
    Dcm_DataType_0xF100_SVN_2: compu {identical}, range raw 0..4294967295
    Dcm_DataType_0xF110_ECU_Part_Number: compu {identical}, range raw ..9999999999
  application array data type Dcm_ArrDataType_0xF110_ECU_Part_Number: category=ARRAY
    element ApplicationArrayElement_ECU_Part_Number: category=VALUE, type=Dcm_DataType_0xF110_ECU_Part_Number, array-size-semantics=FIXED-SIZE, max-number-of-elements=5
  app type Dcm_DataType_0xF110_Tester_Reference_Nunber: category=VALUE, compu {identical}
  application array data type Dcm_ArrDataType_0xF110_Tester_Reference_Nunber: category=ARRAY
    element ApplicationArrayElement_Tester_Reference_Nunber: category=VALUE, type=Dcm_DataType_0xF110_Tester_Reference_Nunber, array-size-semantics=FIXED-SIZE, max-number-of-elements=6
  app type Dcm_DataType_0xF110_Odometer_Reading: category=VALUE, compu {identical}
  application array data type Dcm_ArrDataType_0xF110_Odometer_Reading: category=ARRAY
    element ApplicationArrayElement_Odometer_Reading: category=VALUE, type=Dcm_DataType_0xF110_Odometer_Reading, array-size-semantics=FIXED-SIZE, max-number-of-elements=3
  app type Dcm_DataType_0xF110_Reserved: category=VALUE, compu {identical}, range raw 0..65535
  app type Dcm_DataType_0xF111_ECU_Part_Number: category=VALUE, compu {identical}, range raw ..9999999999
  application array data type Dcm_ArrDataType_0xF111_ECU_Part_Number: category=ARRAY
    element ApplicationArrayElement_ECU_Part_Number: category=VALUE, type=Dcm_DataType_0xF111_ECU_Part_Number, array-size-semantics=FIXED-SIZE, max-number-of-elements=5
  app type Dcm_DataType_0xF111_Tester_Reference_Nunber: category=VALUE, compu {identical}
  application array data type Dcm_ArrDataType_0xF111_Tester_Reference_Nunber: category=ARRAY
    element ApplicationArrayElement_Tester_Reference_Nunber: category=VALUE, type=Dcm_DataType_0xF111_Tester_Reference_Nunber, array-size-semantics=FIXED-SIZE, max-number-of-elements=6
  app type Dcm_DataType_0xF111_Odometer_Reading: category=VALUE, compu {identical}
  application array data type Dcm_ArrDataType_0xF111_Odometer_Reading: category=ARRAY
    element ApplicationArrayElement_Odometer_Reading: category=VALUE, type=Dcm_DataType_0xF111_Odometer_Reading, array-size-semantics=FIXED-SIZE, max-number-of-elements=3
  app type Dcm_DataType_0xF111_Reserved: category=VALUE, compu {identical}, range raw 0..65535
  app type Dcm_DataType_0xF112_ECU_Part_Number: category=VALUE, compu {identical}, range raw ..9999999999
  application array data type Dcm_ArrDataType_0xF112_ECU_Part_Number: category=ARRAY
    element ApplicationArrayElement_ECU_Part_Number: category=VALUE, type=Dcm_DataType_0xF112_ECU_Part_Number, array-size-semantics=FIXED-SIZE, max-number-of-elements=5
  app type Dcm_DataType_0xF112_Tester_Reference_Nunber: category=VALUE, compu {identical}
  application array data type Dcm_ArrDataType_0xF112_Tester_Reference_Nunber: category=ARRAY
    element ApplicationArrayElement_Tester_Reference_Nunber: category=VALUE, type=Dcm_DataType_0xF112_Tester_Reference_Nunber, array-size-semantics=FIXED-SIZE, max-number-of-elements=6
  app type Dcm_DataType_0xF112_Odometer_Reading: category=VALUE, compu {identical}
  application array data type Dcm_ArrDataType_0xF112_Odometer_Reading: category=ARRAY
    element ApplicationArrayElement_Odometer_Reading: category=VALUE, type=Dcm_DataType_0xF112_Odometer_Reading, array-size-semantics=FIXED-SIZE, max-number-of-elements=3
  app type Dcm_DataType_0xF112_Reserved: category=VALUE, compu {identical}, range raw 0..65535
  app type Dcm_DataType_0xF113_ECU_Part_Number: category=VALUE, compu {identical}, range raw ..9999999999
  application array data type Dcm_ArrDataType_0xF113_ECU_Part_Number: category=ARRAY
    element ApplicationArrayElement_ECU_Part_Number: category=VALUE, type=Dcm_DataType_0xF113_ECU_Part_Number, array-size-semantics=FIXED-SIZE, max-number-of-elements=5
  app type Dcm_DataType_0xF113_Tester_Reference_Nunber: category=VALUE, compu {identical}
  application array data type Dcm_ArrDataType_0xF113_Tester_Reference_Nunber: category=ARRAY
    element ApplicationArrayElement_Tester_Reference_Nunber: category=VALUE, type=Dcm_DataType_0xF113_Tester_Reference_Nunber, array-size-semantics=FIXED-SIZE, max-number-of-elements=6
  app type Dcm_DataType_0xF113_Odometer_Reading: category=VALUE, compu {identical}
  application array data type Dcm_ArrDataType_0xF113_Odometer_Reading: category=ARRAY
    element ApplicationArrayElement_Odometer_Reading: category=VALUE, type=Dcm_DataType_0xF113_Odometer_Reading, array-size-semantics=FIXED-SIZE, max-number-of-elements=3
  app type Dcm_DataType_0xF113_Reserved: category=VALUE, compu {identical}, range raw 0..65535
  app type Dcm_DataType_0xF114_ECU_Part_Number: category=VALUE, compu {identical}, range raw ..9999999999
  application array data type Dcm_ArrDataType_0xF114_ECU_Part_Number: category=ARRAY
    element ApplicationArrayElement_ECU_Part_Number: category=VALUE, type=Dcm_DataType_0xF114_ECU_Part_Number, array-size-semantics=FIXED-SIZE, max-number-of-elements=5
  app type Dcm_DataType_0xF114_Tester_Reference_Nunber: category=VALUE, compu {identical}
  application array data type Dcm_ArrDataType_0xF114_Tester_Reference_Nunber: category=ARRAY
    element ApplicationArrayElement_Tester_Reference_Nunber: category=VALUE, type=Dcm_DataType_0xF114_Tester_Reference_Nunber, array-size-semantics=FIXED-SIZE, max-number-of-elements=6
  app type Dcm_DataType_0xF114_Odometer_Reading: category=VALUE, compu {identical}
  application array data type Dcm_ArrDataType_0xF114_Odometer_Reading: category=ARRAY
    element ApplicationArrayElement_Odometer_Reading: category=VALUE, type=Dcm_DataType_0xF114_Odometer_Reading, array-size-semantics=FIXED-SIZE, max-number-of-elements=3
  app type Dcm_DataType_0xF114_Reserved: category=VALUE, compu {identical}, range raw 0..65535
  app type Dcm_DataType_0xF115_ECU_Part_Number: category=VALUE, compu {identical}, range raw ..9999999999
  application array data type Dcm_ArrDataType_0xF115_ECU_Part_Number: category=ARRAY
    element ApplicationArrayElement_ECU_Part_Number: category=VALUE, type=Dcm_DataType_0xF115_ECU_Part_Number, array-size-semantics=FIXED-SIZE, max-number-of-elements=5
  app type Dcm_DataType_0xF115_Tester_Reference_Nunber: category=VALUE, compu {identical}
  application array data type Dcm_ArrDataType_0xF115_Tester_Reference_Nunber: category=ARRAY
    element ApplicationArrayElement_Tester_Reference_Nunber: category=VALUE, type=Dcm_DataType_0xF115_Tester_Reference_Nunber, array-size-semantics=FIXED-SIZE, max-number-of-elements=6
  app type Dcm_DataType_0xF115_Odometer_Reading: category=VALUE, compu {identical}
  application array data type Dcm_ArrDataType_0xF115_Odometer_Reading: category=ARRAY
    element ApplicationArrayElement_Odometer_Reading: category=VALUE, type=Dcm_DataType_0xF115_Odometer_Reading, array-size-semantics=FIXED-SIZE, max-number-of-elements=3
  app type Dcm_DataType_0xF115_Reserved: category=VALUE, compu {identical}, range raw 0..65535
  app type Dcm_DataType_0xF116_ECU_Part_Number: category=VALUE, compu {identical}, range raw ..9999999999
  application array data type Dcm_ArrDataType_0xF116_ECU_Part_Number: category=ARRAY
    element ApplicationArrayElement_ECU_Part_Number: category=VALUE, type=Dcm_DataType_0xF116_ECU_Part_Number, array-size-semantics=FIXED-SIZE, max-number-of-elements=5
  app type Dcm_DataType_0xF116_Tester_Reference_Nunber: category=VALUE, compu {identical}
  application array data type Dcm_ArrDataType_0xF116_Tester_Reference_Nunber: category=ARRAY
    element ApplicationArrayElement_Tester_Reference_Nunber: category=VALUE, type=Dcm_DataType_0xF116_Tester_Reference_Nunber, array-size-semantics=FIXED-SIZE, max-number-of-elements=6
  app type Dcm_DataType_0xF116_Odometer_Reading: category=VALUE, compu {identical}
  application array data type Dcm_ArrDataType_0xF116_Odometer_Reading: category=ARRAY
    element ApplicationArrayElement_Odometer_Reading: category=VALUE, type=Dcm_DataType_0xF116_Odometer_Reading, array-size-semantics=FIXED-SIZE, max-number-of-elements=3
  app type Dcm_DataType_0xF116_Reserved: category=VALUE, compu {identical}, range raw 0..65535
  app type Dcm_DataType_0xF117_ECU_Part_Number: category=VALUE, compu {identical}, range raw ..9999999999
  application array data type Dcm_ArrDataType_0xF117_ECU_Part_Number: category=ARRAY
    element ApplicationArrayElement_ECU_Part_Number: category=VALUE, type=Dcm_DataType_0xF117_ECU_Part_Number, array-size-semantics=FIXED-SIZE, max-number-of-elements=5
  app type Dcm_DataType_0xF117_Tester_Reference_Nunber: category=VALUE, compu {identical}
  application array data type Dcm_ArrDataType_0xF117_Tester_Reference_Nunber: category=ARRAY
    element ApplicationArrayElement_Tester_Reference_Nunber: category=VALUE, type=Dcm_DataType_0xF117_Tester_Reference_Nunber, array-size-semantics=FIXED-SIZE, max-number-of-elements=6
  app type Dcm_DataType_0xF117_Odometer_Reading: category=VALUE, compu {identical}
  application array data type Dcm_ArrDataType_0xF117_Odometer_Reading: category=ARRAY
    element ApplicationArrayElement_Odometer_Reading: category=VALUE, type=Dcm_DataType_0xF117_Odometer_Reading, array-size-semantics=FIXED-SIZE, max-number-of-elements=3
  app type Dcm_DataType_0xF117_Reserved: category=VALUE, compu {identical}, range raw 0..65535
  app type Dcm_DataType_0xF118_ECU_Part_Number: category=VALUE, compu {identical}, range raw ..9999999999
  application array data type Dcm_ArrDataType_0xF118_ECU_Part_Number: category=ARRAY
    element ApplicationArrayElement_ECU_Part_Number: category=VALUE, type=Dcm_DataType_0xF118_ECU_Part_Number, array-size-semantics=FIXED-SIZE, max-number-of-elements=5
  app type Dcm_DataType_0xF118_Tester_Reference_Nunber: category=VALUE, compu {identical}
  application array data type Dcm_ArrDataType_0xF118_Tester_Reference_Nunber: category=ARRAY
    element ApplicationArrayElement_Tester_Reference_Nunber: category=VALUE, type=Dcm_DataType_0xF118_Tester_Reference_Nunber, array-size-semantics=FIXED-SIZE, max-number-of-elements=6
  app type Dcm_DataType_0xF118_Odometer_Reading: category=VALUE, compu {identical}
  application array data type Dcm_ArrDataType_0xF118_Odometer_Reading: category=ARRAY
    element ApplicationArrayElement_Odometer_Reading: category=VALUE, type=Dcm_DataType_0xF118_Odometer_Reading, array-size-semantics=FIXED-SIZE, max-number-of-elements=3
  app type Dcm_DataType_0xF118_Reserved: category=VALUE, compu {identical}, range raw 0..65535
  app type Dcm_DataType_0xF119_ECU_Part_Number: category=VALUE, compu {identical}, range raw ..9999999999
  application array data type Dcm_ArrDataType_0xF119_ECU_Part_Number: category=ARRAY
    element ApplicationArrayElement_ECU_Part_Number: category=VALUE, type=Dcm_DataType_0xF119_ECU_Part_Number, array-size-semantics=FIXED-SIZE, max-number-of-elements=5
  app type Dcm_DataType_0xF119_Tester_Reference_Nunber: category=VALUE, compu {identical}
  application array data type Dcm_ArrDataType_0xF119_Tester_Reference_Nunber: category=ARRAY
    element ApplicationArrayElement_Tester_Reference_Nunber: category=VALUE, type=Dcm_DataType_0xF119_Tester_Reference_Nunber, array-size-semantics=FIXED-SIZE, max-number-of-elements=6
  app type Dcm_DataType_0xF119_Odometer_Reading: category=VALUE, compu {identical}
  application array data type Dcm_ArrDataType_0xF119_Odometer_Reading: category=ARRAY
    element ApplicationArrayElement_Odometer_Reading: category=VALUE, type=Dcm_DataType_0xF119_Odometer_Reading, array-size-semantics=FIXED-SIZE, max-number-of-elements=3
  app type Dcm_DataType_0xF119_Reserved: category=VALUE, compu {identical}, range raw 0..65535
  app type Dcm_DataType_0xF11A_ECU_Part_Number: category=VALUE, compu {identical}, range raw ..9999999999
  application array data type Dcm_ArrDataType_0xF11A_ECU_Part_Number: category=ARRAY
    element ApplicationArrayElement_ECU_Part_Number: category=VALUE, type=Dcm_DataType_0xF11A_ECU_Part_Number, array-size-semantics=FIXED-SIZE, max-number-of-elements=5
  app type Dcm_DataType_0xF11A_Tester_Reference_Nunber: category=VALUE, compu {identical}
  application array data type Dcm_ArrDataType_0xF11A_Tester_Reference_Nunber: category=ARRAY
    element ApplicationArrayElement_Tester_Reference_Nunber: category=VALUE, type=Dcm_DataType_0xF11A_Tester_Reference_Nunber, array-size-semantics=FIXED-SIZE, max-number-of-elements=6
  app type Dcm_DataType_0xF11A_Odometer_Reading: category=VALUE, compu {identical}
  application array data type Dcm_ArrDataType_0xF11A_Odometer_Reading: category=ARRAY
    element ApplicationArrayElement_Odometer_Reading: category=VALUE, type=Dcm_DataType_0xF11A_Odometer_Reading, array-size-semantics=FIXED-SIZE, max-number-of-elements=3
  app type Dcm_DataType_0xF11A_Reserved: category=VALUE, compu {identical}, range raw 0..65535
  app type Dcm_DataType_0xF11B_ECU_Part_Number: category=VALUE, compu {identical}, range raw ..9999999999
  application array data type Dcm_ArrDataType_0xF11B_ECU_Part_Number: category=ARRAY
    element ApplicationArrayElement_ECU_Part_Number: category=VALUE, type=Dcm_DataType_0xF11B_ECU_Part_Number, array-size-semantics=FIXED-SIZE, max-number-of-elements=5
  app type Dcm_DataType_0xF11B_Tester_Reference_Nunber: category=VALUE, compu {identical}
  application array data type Dcm_ArrDataType_0xF11B_Tester_Reference_Nunber: category=ARRAY
    element ApplicationArrayElement_Tester_Reference_Nunber: category=VALUE, type=Dcm_DataType_0xF11B_Tester_Reference_Nunber, array-size-semantics=FIXED-SIZE, max-number-of-elements=6
  app type Dcm_DataType_0xF11B_Odometer_Reading: category=VALUE, compu {identical}
  application array data type Dcm_ArrDataType_0xF11B_Odometer_Reading: category=ARRAY
    element ApplicationArrayElement_Odometer_Reading: category=VALUE, type=Dcm_DataType_0xF11B_Odometer_Reading, array-size-semantics=FIXED-SIZE, max-number-of-elements=3
  app type Dcm_DataType_0xF11B_Reserved: category=VALUE, compu {identical}, range raw 0..65535
  app type Dcm_DataType_0xF11C_ECU_Part_Number: category=VALUE, compu {identical}, range raw ..9999999999
  application array data type Dcm_ArrDataType_0xF11C_ECU_Part_Number: category=ARRAY
    element ApplicationArrayElement_ECU_Part_Number: category=VALUE, type=Dcm_DataType_0xF11C_ECU_Part_Number, array-size-semantics=FIXED-SIZE, max-number-of-elements=5
  app type Dcm_DataType_0xF11C_Tester_Reference_Nunber: category=VALUE, compu {identical}
  application array data type Dcm_ArrDataType_0xF11C_Tester_Reference_Nunber: category=ARRAY
    element ApplicationArrayElement_Tester_Reference_Nunber: category=VALUE, type=Dcm_DataType_0xF11C_Tester_Reference_Nunber, array-size-semantics=FIXED-SIZE, max-number-of-elements=6
  app type Dcm_DataType_0xF11C_Odometer_Reading: category=VALUE, compu {identical}
  application array data type Dcm_ArrDataType_0xF11C_Odometer_Reading: category=ARRAY
    element ApplicationArrayElement_Odometer_Reading: category=VALUE, type=Dcm_DataType_0xF11C_Odometer_Reading, array-size-semantics=FIXED-SIZE, max-number-of-elements=3
  app type Dcm_DataType_0xF11C_Reserved: category=VALUE, compu {identical}, range raw 0..65535
  app type Dcm_DataType_0xF11D_ECU_Part_Number: category=VALUE, compu {identical}, range raw ..9999999999
  application array data type Dcm_ArrDataType_0xF11D_ECU_Part_Number: category=ARRAY
    element ApplicationArrayElement_ECU_Part_Number: category=VALUE, type=Dcm_DataType_0xF11D_ECU_Part_Number, array-size-semantics=FIXED-SIZE, max-number-of-elements=5
  app type Dcm_DataType_0xF11D_Tester_Reference_Nunber: category=VALUE, compu {identical}
  application array data type Dcm_ArrDataType_0xF11D_Tester_Reference_Nunber: category=ARRAY
    element ApplicationArrayElement_Tester_Reference_Nunber: category=VALUE, type=Dcm_DataType_0xF11D_Tester_Reference_Nunber, array-size-semantics=FIXED-SIZE, max-number-of-elements=6
  app type Dcm_DataType_0xF11D_Odometer_Reading: category=VALUE, compu {identical}
  application array data type Dcm_ArrDataType_0xF11D_Odometer_Reading: category=ARRAY
    element ApplicationArrayElement_Odometer_Reading: category=VALUE, type=Dcm_DataType_0xF11D_Odometer_Reading, array-size-semantics=FIXED-SIZE, max-number-of-elements=3
  app type Dcm_DataType_0xF11D_Reserved: category=VALUE, compu {identical}, range raw 0..65535
  app type Dcm_DataType_0xF11E_ECU_Part_Number: category=VALUE, compu {identical}, range raw ..9999999999
  application array data type Dcm_ArrDataType_0xF11E_ECU_Part_Number: category=ARRAY
    element ApplicationArrayElement_ECU_Part_Number: category=VALUE, type=Dcm_DataType_0xF11E_ECU_Part_Number, array-size-semantics=FIXED-SIZE, max-number-of-elements=5
  app type Dcm_DataType_0xF11E_Tester_Reference_Nunber: category=VALUE, compu {identical}
  application array data type Dcm_ArrDataType_0xF11E_Tester_Reference_Nunber: category=ARRAY
    element ApplicationArrayElement_Tester_Reference_Nunber: category=VALUE, type=Dcm_DataType_0xF11E_Tester_Reference_Nunber, array-size-semantics=FIXED-SIZE, max-number-of-elements=6
  app type Dcm_DataType_0xF11E_Odometer_Reading: category=VALUE, compu {identical}
  application array data type Dcm_ArrDataType_0xF11E_Odometer_Reading: category=ARRAY
    element ApplicationArrayElement_Odometer_Reading: category=VALUE, type=Dcm_DataType_0xF11E_Odometer_Reading, array-size-semantics=FIXED-SIZE, max-number-of-elements=3
  app type Dcm_DataType_0xF11E_Reserved: category=VALUE, compu {identical}, range raw 0..65535
  app type Dcm_DataType_0xF11F_ECU_Part_Number: category=VALUE, compu {identical}, range raw ..9999999999
  application array data type Dcm_ArrDataType_0xF11F_ECU_Part_Number: category=ARRAY
    element ApplicationArrayElement_ECU_Part_Number: category=VALUE, type=Dcm_DataType_0xF11F_ECU_Part_Number, array-size-semantics=FIXED-SIZE, max-number-of-elements=5
  app type Dcm_DataType_0xF11F_Tester_Reference_Nunber: category=VALUE, compu {identical}
  application array data type Dcm_ArrDataType_0xF11F_Tester_Reference_Nunber: category=ARRAY
    element ApplicationArrayElement_Tester_Reference_Nunber: category=VALUE, type=Dcm_DataType_0xF11F_Tester_Reference_Nunber, array-size-semantics=FIXED-SIZE, max-number-of-elements=6
  app type Dcm_DataType_0xF11F_Odometer_Reading: category=VALUE, compu {identical}
  application array data type Dcm_ArrDataType_0xF11F_Odometer_Reading: category=ARRAY
    element ApplicationArrayElement_Odometer_Reading: category=VALUE, type=Dcm_DataType_0xF11F_Odometer_Reading, array-size-semantics=FIXED-SIZE, max-number-of-elements=3
  app type Dcm_DataType_0xF11F_Reserved: category=VALUE, compu {identical}, range raw 0..65535
  app type Dcm_DataType_0xF120_NCF_Part_Number: category=VALUE, compu {identical}, range raw ..9999999999
  application array data type Dcm_ArrDataType_0xF120_NCF_Part_Number: category=ARRAY
    element ApplicationArrayElement_NCF_Part_Number: category=VALUE, type=Dcm_DataType_0xF120_NCF_Part_Number, array-size-semantics=FIXED-SIZE, max-number-of-elements=5
  app type Dcm_DataType_0xF120_Tester_Reference_Number: category=VALUE, compu {identical}
  application array data type Dcm_ArrDataType_0xF120_Tester_Reference_Number: category=ARRAY
    element ApplicationArrayElement_Tester_Reference_Number: category=VALUE, type=Dcm_DataType_0xF120_Tester_Reference_Number, array-size-semantics=FIXED-SIZE, max-number-of-elements=6
  app type Dcm_DataType_0xF120_Odometer_Reading: category=VALUE, compu {identical}
  application array data type Dcm_ArrDataType_0xF120_Odometer_Reading: category=ARRAY
    element ApplicationArrayElement_Odometer_Reading: category=VALUE, type=Dcm_DataType_0xF120_Odometer_Reading, array-size-semantics=FIXED-SIZE, max-number-of-elements=3
  app type Dcm_DataType_0xF120_Reserved: category=VALUE, compu {identical}, range raw 0..65535
  app type Dcm_DataType_0xF121_NCF_Part_Number: category=VALUE, compu {identical}, range raw ..9999999999
  application array data type Dcm_ArrDataType_0xF121_NCF_Part_Number: category=ARRAY
    element ApplicationArrayElement_NCF_Part_Number: category=VALUE, type=Dcm_DataType_0xF121_NCF_Part_Number, array-size-semantics=FIXED-SIZE, max-number-of-elements=5
  app type Dcm_DataType_0xF121_Tester_Reference_Number: category=VALUE, compu {identical}
  application array data type Dcm_ArrDataType_0xF121_Tester_Reference_Number: category=ARRAY
    element ApplicationArrayElement_Tester_Reference_Number: category=VALUE, type=Dcm_DataType_0xF121_Tester_Reference_Number, array-size-semantics=FIXED-SIZE, max-number-of-elements=6
  app type Dcm_DataType_0xF121_Odometer_Reading: category=VALUE, compu {identical}
  application array data type Dcm_ArrDataType_0xF121_Odometer_Reading: category=ARRAY
    element ApplicationArrayElement_Odometer_Reading: category=VALUE, type=Dcm_DataType_0xF121_Odometer_Reading, array-size-semantics=FIXED-SIZE, max-number-of-elements=3
  app type Dcm_DataType_0xF121_Reserved: category=VALUE, compu {identical}, range raw 0..65535
  app type Dcm_DataType_0xF183_ECU_Bootloader_Software_Reference_Number: category=VALUE, compu {identical}
  application array data type Dcm_ArrDataType_0xF183_ECU_Bootloader_Software_Reference_Number: category=ARRAY
    element ApplicationArrayElement_ECU_Bootloader_Software_Reference_Number: category=VALUE, type=Dcm_DataType_0xF183_ECU_Bootloader_Software_Reference_Number, array-size-semantics=FIXED-SIZE, max-number-of-elements=10
  app type Dcm_DataType_0xF187_ECU_Part_Number: category=VALUE, compu {identical}, range raw ..9999999999
  application array data type Dcm_ArrDataType_0xF187_ECU_Part_Number: category=ARRAY
    element ApplicationArrayElement_ECU_Part_Number: category=VALUE, type=Dcm_DataType_0xF187_ECU_Part_Number, array-size-semantics=FIXED-SIZE, max-number-of-elements=5
  app type Dcm_DataType_0xF18A_System_Supplier_Identifier: category=VALUE, compu {identical}, range raw ..9999999999
  application array data type Dcm_ArrDataType_0xF18A_System_Supplier_Identifier: category=ARRAY
    element ApplicationArrayElement_System_Supplier_Identifier: category=VALUE, type=Dcm_DataType_0xF18A_System_Supplier_Identifier, array-size-semantics=FIXED-SIZE, max-number-of-elements=5
  app type Dcm_DataType_0xF18B_ECU_Manufacture_Date: category=VALUE, compu {identical}
  application array data type Dcm_ArrDataType_0xF18B_ECU_Manufacture_Date: category=ARRAY
    element ApplicationArrayElement_ECU_Manufacture_Date: category=VALUE, type=Dcm_DataType_0xF18B_ECU_Manufacture_Date, array-size-semantics=FIXED-SIZE, max-number-of-elements=3
  app type Dcm_DataType_0xF18C_ECU_Serial_Number: category=VALUE, compu {identical}
  application array data type Dcm_ArrDataType_0xF18C_ECU_Serial_Number: category=ARRAY
    element ApplicationArrayElement_ECU_Serial_Number: category=VALUE, type=Dcm_DataType_0xF18C_ECU_Serial_Number, array-size-semantics=FIXED-SIZE, max-number-of-elements=16
  app type Dcm_DataType_0xF190_VIN: category=VALUE, compu {identical}
  application array data type Dcm_ArrDataType_0xF190_VIN: category=ARRAY
    element ApplicationArrayElement_VIN: category=VALUE, type=Dcm_DataType_0xF190_VIN, array-size-semantics=FIXED-SIZE, max-number-of-elements=17
  app type Dcm_DataType_0xF191_ECU_Hardware_Nunber: category=VALUE, compu {identical}, range raw ..9999999999
  application array data type Dcm_ArrDataType_0xF191_ECU_Hardware_Nunber: category=ARRAY
    element ApplicationArrayElement_ECU_Hardware_Nunber: category=VALUE, type=Dcm_DataType_0xF191_ECU_Hardware_Nunber, array-size-semantics=FIXED-SIZE, max-number-of-elements=5
  app type Dcm_DataType_0xF192_Supplier_ECU_Hardware_Reference_Number: category=VALUE, compu {identical}
  application array data type Dcm_ArrDataType_0xF192_Supplier_ECU_Hardware_Reference_Number: category=ARRAY
    element ApplicationArrayElement_Supplier_ECU_Hardware_Reference_Number: category=VALUE, type=Dcm_DataType_0xF192_Supplier_ECU_Hardware_Reference_Number, array-size-semantics=FIXED-SIZE, max-number-of-elements=10
  app type Dcm_DataType_0xF194_Supplier_ECU_Softdware_Reference_Number: category=VALUE, compu {identical}
  application array data type Dcm_ArrDataType_0xF194_Supplier_ECU_Softdware_Reference_Number: category=ARRAY
    element ApplicationArrayElement_Supplier_ECU_Softdware_Reference_Number: category=VALUE, type=Dcm_DataType_0xF194_Supplier_ECU_Softdware_Reference_Number, array-size-semantics=FIXED-SIZE, max-number-of-elements=10
  app type Dcm_DataType_0xF198_Tester_Odometer_Number: category=VALUE, compu {identical}
  application array data type Dcm_ArrDataType_0xF198_Tester_Odometer_Number: category=ARRAY
    element ApplicationArrayElement_Tester_Odometer_Number: category=VALUE, type=Dcm_DataType_0xF198_Tester_Odometer_Number, array-size-semantics=FIXED-SIZE, max-number-of-elements=6
  app type Dcm_DataType_0xF198_Odometer_Reading: category=VALUE, compu {identical}
  application array data type Dcm_ArrDataType_0xF198_Odometer_Reading: category=ARRAY
    element ApplicationArrayElement_Odometer_Reading: category=VALUE, type=Dcm_DataType_0xF198_Odometer_Reading, array-size-semantics=FIXED-SIZE, max-number-of-elements=3
  app type Dcm_DataType_0xF198_Reserved: category=VALUE, compu {identical}, range raw 0..65535
  app type Dcm_DataType_0xF1A0_ECU_Application_Software_Number: category=VALUE, compu {identical}, range raw ..9999999999
  application array data type Dcm_ArrDataType_0xF1A0_ECU_Application_Software_Number: category=ARRAY
    element ApplicationArrayElement_ECU_Application_Software_Number: category=VALUE, type=Dcm_DataType_0xF1A0_ECU_Application_Software_Number, array-size-semantics=FIXED-SIZE, max-number-of-elements=5
  app type Dcm_DataType_0xF1A1_ECU_Calibration_Software_Number: category=VALUE, compu {identical}, range raw ..9999999999
  application array data type Dcm_ArrDataType_0xF1A1_ECU_Calibration_Software_Number: category=ARRAY
    element ApplicationArrayElement_ECU_Calibration_Software_Number: category=VALUE, type=Dcm_DataType_0xF1A1_ECU_Calibration_Software_Number, array-size-semantics=FIXED-SIZE, max-number-of-elements=5
  app type Dcm_DataType_0xF1A2_ECU_NCF_Reference_Number: category=VALUE, compu {identical}
  application array data type Dcm_ArrDataType_0xF1A2_ECU_NCF_Reference_Number: category=ARRAY
    element ApplicationArrayElement_ECU_NCF_Reference_Number: category=VALUE, type=Dcm_DataType_0xF1A2_ECU_NCF_Reference_Number, array-size-semantics=FIXED-SIZE, max-number-of-elements=8
  4 x app type, all with category=VALUE, compu {identical}:
    Dcm_DataType_0xF1A5_Configuration_Index: range raw 0..255
    Dcm_DataType_0xF1A5_Diagnostic_Index: range raw 0..255
    Dcm_DataType_0xF1A5_Bus_Index: range raw 0..255
    Dcm_DataType_0xF1A8_Vehicle_Feature_Information
  application array data type Dcm_ArrDataType_0xF1A8_Vehicle_Feature_Information: category=ARRAY
    element ApplicationArrayElement_Vehicle_Feature_Information: category=VALUE, type=Dcm_DataType_0xF1A8_Vehicle_Feature_Information, array-size-semantics=FIXED-SIZE, max-number-of-elements=20
  app type Dcm_DataType_0xF1A9_ECU_Congfiguration_File_Number: category=VALUE, compu {identical}, range raw ..9999999999
  application array data type Dcm_ArrDataType_0xF1A9_ECU_Congfiguration_File_Number: category=ARRAY
    element ApplicationArrayElement_ECU_Congfiguration_File_Number: category=VALUE, type=Dcm_DataType_0xF1A9_ECU_Congfiguration_File_Number, array-size-semantics=FIXED-SIZE, max-number-of-elements=5
  app type Dcm_DataType_0xF1AA_ECU_Programming_Process_File_Number: category=VALUE, compu {identical}, range raw ..9999999999
  application array data type Dcm_ArrDataType_0xF1AA_ECU_Programming_Process_File_Number: category=ARRAY
    element ApplicationArrayElement_ECU_Programming_Process_File_Number: category=VALUE, type=Dcm_DataType_0xF1AA_ECU_Programming_Process_File_Number, array-size-semantics=FIXED-SIZE, max-number-of-elements=5
package /AUTOSAR_Dcm/CompuMethods
  compu method Dcm_CompuMethod_RequestOut_44031_Out_CLE_RES_REC_RES: 0=Routine Successfully completed (CLE_RES_REC_RES_0_Routine_Successfully_completed), 1=Routine Running (CLE_RES_REC_RES_1_Routine_Running), 255=Failed due to EEPROM error (CLE_RES_REC_RES_255_Failed_due_to_EEPROM_error)
