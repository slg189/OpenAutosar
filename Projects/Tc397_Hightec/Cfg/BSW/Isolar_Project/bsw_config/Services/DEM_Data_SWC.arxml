AUTOSAR XML (schema 4-2-2)
package /AUTOSAR_Dem/ApplicationDataTypes
  13 x app type, all with category=VALUE:
    Dem_DataType_Supply_voltage: compu {phys=raw*0.1 for raw 0..255}, range raw 0..255
    Dem_DataType_Odometer_reading: compu {identical}
    Dem_DataType_Power_Mode: compu {mask 16: 0=off (BitTableDT_013_Global_KL_R_status_0_off), mask 16: 16=on (BitTableDT_013_Global_KL_R_status_16_on), mask 32: 0=off (BitTableDT_013_Global_KL_15_status_0_off), mask 32: 32=on (BitTableDT_013_Global_KL_15_status_32_on), mask 64: 0=off (BitTableDT_013_Global_engine_run_active_status_0_off), mask 64: 64=on (BitTableDT_013_Global_engine_run_active_status_64_on), mask 128: 0=off (BitTableDT_013_Global_KL_50_status_0_off), mask 128: 128=on (BitTableDT_013_Global_KL_50_status_128_on)}
    Dem_DataType_Year: compu {phys=raw+2000 for raw 0}, range raw 0
    Dem_DataType_Month: compu {phys=raw for raw 1..12}, range raw 1..12
    Dem_DataType_Day: compu {phys=raw for raw 1..31}, range raw 1..31
    Dem_DataType_Hour: compu {phys=raw for raw 0..59}, range raw 0..59
    Dem_DataType_Minute: compu {phys=raw for raw 1..12}, range raw 1..12
    Dem_DataType_Second: compu {phys=raw for raw 0..59}, range raw 0..59
    Dem_DataType_Fault_occurrence_counter: compu {identical}, range raw 0..255
    Dem_DataType_Fault_pending_counter: compu {identical}, range raw 0..255
    Dem_DataType_Aged_counter: compu {identical}, range raw 0..255
    Dem_DataType_Ageing_counter: compu {identical}, range raw 0..255
