AUTOSAR XML (schema 4-2-2)
package /DataTypeMappingSet_NRC72
  data type mapping set DataTypeMappingSet_NRC72: mode-request-type-map{implementation-data-type=uint8, mode-group=ModeDeclarationGroup_NRC72}
