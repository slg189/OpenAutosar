AUTOSAR XML (schema 4-2-2)
package /ETAS_Project/EcucModuleConfigurationValuess
  module config Dcm: implementation-config-variant=VARIANT-PRE-COMPILE
    DcmConfigSet
      DcmDsd: DcmDsdRequestManufacturerNotificationEnabled=false, DcmDsdRequestSupplierNotificationEnabled=false
        DcmDsdServiceTable_UDS (DcmDsdServiceTable): DcmDsdSidTabId=0
          12 x DcmDsdService, all with DcmDsdSidTabSessionLevelRef=DcmDspSession/ExtendedDiagnosticSession:
            DiagnosticSessionControl: DcmDsdSidTabFnc=Dcm_DcmDiagnosticSessionControl, DcmDsdSidTabServiceId=16, DcmDsdSidTabSubfuncAvail=true, DcmRbDsdSidTabSidInitFunction=Dcm_Dsp_DscIni, DcmDsdSidTabSessionLevelRef=DcmDspSession/DefaultSession, DcmDsdSidTabSessionLevelRef=DcmDspSession/ProgrammingSession, DcmDsdSidTabSessionLevelRef=DcmDspSession/DevelopmentSession, DcmDsdSidTabSessionLevelRef=DcmDspSession/SupplierDiagnosticSession
              5 x DcmDsdSubService, all with DcmDsdSubServiceSessionLevelRef=DcmDspSession/ProgrammingSession, DcmDsdSubServiceSessionLevelRef=DcmDspSession/ExtendedDiagnosticSession:
                DefaultSession: DcmDsdSubServiceId=1, DcmDsdSubServiceSessionLevelRef=DcmDspSession/DefaultSession, DcmDsdSubServiceSessionLevelRef=DcmDspSession/DevelopmentSession, DcmDsdSubServiceSessionLevelRef=DcmDspSession/SupplierDiagnosticSession, DcmDsdSubServiceModeRuleRef=DcmModeRule_NRC22
                ProgrammingSession: DcmDsdSubServiceId=2
                ExtendedDiagnosticSession: DcmDsdSubServiceId=3, DcmDsdSubServiceSessionLevelRef=DcmDspSession/DefaultSession, DcmDsdSubServiceSessionLevelRef=DcmDspSession/DevelopmentSession, DcmDsdSubServiceSessionLevelRef=DcmDspSession/SupplierDiagnosticSession
                DevelopmentSession: DcmDsdSubServiceId=64, DcmDsdSubServiceSessionLevelRef=DcmDspSession/DevelopmentSession, DcmDsdSubServiceSessionLevelRef=DcmDspSession/DefaultSession, DcmDsdSubServiceSessionLevelRef=DcmDspSession/SupplierDiagnosticSession
                SupplierDiagnosticSession: DcmDsdSubServiceId=96, DcmDsdSubServiceSessionLevelRef=DcmDspSession/SupplierDiagnosticSession, DcmDsdSubServiceSessionLevelRef=DcmDspSession/DevelopmentSession, DcmDsdSubServiceSessionLevelRef=DcmDspSession/DefaultSession
            SecurityAccess: DcmDsdSidTabFnc=Dcm_DcmSecurityAccess, DcmDsdSidTabServiceId=39, DcmDsdSidTabSubfuncAvail=true, DcmRbDsdSidTabSidInitFunction=Dcm_Dsp_SecaIni, DcmDsdSidTabSessionLevelRef=DcmDspSession/SupplierDiagnosticSession
              10 x DcmDsdSubService:
                DcmDsdSubService_requestSeed_SEC_LEV_L1: DcmDsdSubServiceId=1, DcmDsdSubServiceSessionLevelRef=DcmDspSession/ExtendedDiagnosticSession, DcmDsdSubServiceModeRuleRef=DcmModeRule_NRC22
                DcmDsdSubService_sendKey_SEC_LEV_L1: DcmDsdSubServiceId=2, DcmDsdSubServiceSessionLevelRef=DcmDspSession/ExtendedDiagnosticSession
                DcmDsdSubService_requestSeed_SEC_LEV_L2: DcmDsdSubServiceId=3, DcmDsdSubServiceSessionLevelRef=DcmDspSession/ExtendedDiagnosticSession
                DcmDsdSubService_sendKey_SEC_LEV_L2: DcmDsdSubServiceId=4, DcmDsdSubServiceSessionLevelRef=DcmDspSession/ExtendedDiagnosticSession
                DcmDsdSubService_requestSeed_SEC_LEV_L3: DcmDsdSubServiceId=5, DcmDsdSubServiceSessionLevelRef=DcmDspSession/ExtendedDiagnosticSession
                DcmDsdSubService_sendKey_SEC_LEV_L3: DcmDsdSubServiceId=6, DcmDsdSubServiceSessionLevelRef=DcmDspSession/ExtendedDiagnosticSession
                DcmDsdSubService_requestSeed_SEC_LEV_L5: DcmDsdSubServiceId=9, DcmDsdSubServiceSessionLevelRef=DcmDspSession/ExtendedDiagnosticSession
                DcmDsdSubService_sendKey_SEC_LEV_L5: DcmDsdSubServiceId=10, DcmDsdSubServiceSessionLevelRef=DcmDspSession/ExtendedDiagnosticSession
                DcmDsdSubService_requestSeed_SEC_LEV_L49: DcmDsdSubServiceId=97, DcmDsdSubServiceSessionLevelRef=DcmDspSession/SupplierDiagnosticSession
                DcmDsdSubService_sendKey_SEC_LEV_L49: DcmDsdSubServiceId=98, DcmDsdSubServiceSessionLevelRef=DcmDspSession/SupplierDiagnosticSession
            TesterPresent: DcmDsdSidTabFnc=Dcm_DcmTesterPresent, DcmDsdSidTabServiceId=62, DcmDsdSidTabSubfuncAvail=true, DcmRbDsdSidTabSidInitFunction=NULL_PTR, DcmDsdSidTabSessionLevelRef=DcmDspSession/DefaultSession, DcmDsdSidTabSessionLevelRef=DcmDspSession/ProgrammingSession
              zeroSubFunction (DcmDsdSubService):
                DcmDsdSubServiceId = 0
                DcmDsdSubServiceSessionLevelRef = DcmDspSession/DefaultSession
                DcmDsdSubServiceSessionLevelRef = DcmDspSession/ExtendedDiagnosticSession
                DcmDsdSubServiceSessionLevelRef = DcmDspSession/ProgrammingSession
            ECUReset: DcmDsdSidTabFnc=Dcm_DcmEcuReset, DcmDsdSidTabServiceId=17, DcmDsdSidTabSubfuncAvail=true, DcmRbDsdSidTabSidInitFunction=Dcm_Dsp_EcuReset_Ini, DcmDsdSidTabSessionLevelRef=DcmDspSession/DefaultSession
              3 x DcmDsdSubService, all with DcmDsdSubServiceSessionLevelRef=DcmDspSession/DefaultSession, DcmDsdSubServiceSessionLevelRef=DcmDspSession/ExtendedDiagnosticSession:
                HARD: DcmDsdSubServiceId=1, DcmDsdSubServiceModeRuleRef=DcmModeRule_NRC22
                KEYONOFF: DcmDsdSubServiceId=2
                SOFT: DcmDsdSubServiceId=3
            CommunicationControl: DcmDsdSidTabFnc=Dcm_DcmCommunicationControl, DcmDsdSidTabServiceId=40, DcmDsdSidTabSubfuncAvail=true, DcmRbDsdSidTabSidInitFunction=NULL_PTR
              4 x DcmDsdSubService, all with DcmDsdSubServiceSessionLevelRef=DcmDspSession/ExtendedDiagnosticSession:
                enableRxAndTx: DcmDsdSubServiceId=0, DcmDsdSubServiceModeRuleRef=DcmModeRule_NRC22
                enableRxAndDisableTx: DcmDsdSubServiceId=1
                disableRxAndEnableTx: DcmDsdSubServiceId=2
                disableRxAndTx: DcmDsdSubServiceId=3
            RoutineControl: DcmDsdSidTabFnc=Dcm_DcmRoutineControl, DcmDsdSidTabServiceId=49, DcmDsdSidTabSubfuncAvail=true, DcmRbDsdSidTabSidInitFunction=Dcm_Dsp_RC_Ini, DcmDsdSidTabSecurityLevelRef=DCM_SEC_LEV_L1
              3 x DcmDsdSubService, all with DcmDsdSubServiceSecurityLevelRef=DCM_SEC_LEV_L1, DcmDsdSubServiceSessionLevelRef=DcmDspSession/ExtendedDiagnosticSession:
                startRoutine: DcmDsdSubServiceId=1, DcmDsdSubServiceModeRuleRef=DcmModeRule_NRC22
                stopRoutine: DcmDsdSubServiceId=2, DcmDsdSubServiceModeRuleRef=DcmModeRule_NRC72
                requestRoutineResults: DcmDsdSubServiceId=3, DcmDsdSubServiceModeRuleRef=DcmModeRule_NRC22
            InputOutpuControlByIdentifier: DcmDsdSidTabFnc=Dcm_DcmInputOutputControlByIdentifier, DcmDsdSidTabServiceId=47, DcmRbDsdSidTabSidInitFunction=Dcm_Dsp_IOCBI_Ini, DcmDsdSidTabSubfuncAvail=false, DcmDsdSidTabSecurityLevelRef=DCM_SEC_LEV_L1, DcmDsdSidTabModeRuleRef=DcmModeRule_NRC22
            ReadDataByIdentifier: DcmDsdSidTabFnc=Dcm_DcmReadDataByIdentifier, DcmDsdSidTabServiceId=34, DcmDsdSidTabSubfuncAvail=false, DcmRbDsdSidTabSidInitFunction=Dcm_Dsp_RdbiIni, DcmDsdSidTabSessionLevelRef=DcmDspSession/DefaultSession, DcmDsdSidTabModeRuleRef=DcmModeRule_NRC22
            WriteDataByIdentifier: DcmDsdSidTabFnc=Dcm_DcmWriteDataByIdentifier, DcmDsdSidTabServiceId=46, DcmDsdSidTabSubfuncAvail=false, DcmRbDsdSidTabSidInitFunction=Dcm_Dcm_WDBIInit, DcmDsdSidTabModeRuleRef=DcmModeRule_NRC22, DcmDsdSidTabSessionLevelRef=DcmDspSession/DefaultSession
            ReadDTCInformation: DcmDsdSidTabFnc=Dcm_DcmReadDTCInformation, DcmDsdSidTabServiceId=25, DcmDsdSidTabSubfuncAvail=true, DcmRbDsdSidTabSidInitFunction=Dcm_Dsp_ReadDTCInfo_Ini, DcmDsdSidTabSessionLevelRef=DcmDspSession/DefaultSession
              5 x DcmDsdSubService, all with DcmDsdSubServiceSessionLevelRef=DcmDspSession/DefaultSession, DcmDsdSubServiceSessionLevelRef=DcmDspSession/ExtendedDiagnosticSession:
                DcmDsdSubService_ReportNumberOfDTCByStatusMask: DcmDsdSubServiceId=1
                DcmDsdSubService_ReportDTCByStatusMask: DcmDsdSubServiceId=2
                DcmDsdSubService_ReportDTCSnapshotRecordByDTCNumber: DcmDsdSubServiceId=4
                DcmDsdSubService_ReportDTCExtendedDataRecordByDTCNumber: DcmDsdSubServiceId=6
                DcmDsdSubService_ReportSupportedDTC: DcmDsdSubServiceId=10
            ClearDiagnosticInformation: DcmDsdSidTabFnc=Dcm_DcmClearDiagnosticInformation, DcmDsdSidTabServiceId=20, DcmDsdSidTabSubfuncAvail=false, DcmRbDsdSidTabSidInitFunction=NULL_PTR, DcmDsdSidTabSessionLevelRef=DcmDspSession/DefaultSession, DcmDsdSidTabModeRuleRef=DcmModeRule_NRC22
            ControlDTCSetting: DcmDsdSidTabFnc=Dcm_DcmControlDTCSetting, DcmDsdSidTabServiceId=133, DcmDsdSidTabSubfuncAvail=true, DcmRbDsdSidTabSidInitFunction=Dcm_Dsp_CDTCSIni
              On (DcmDsdSubService): DcmDsdSubServiceId=1, DcmDsdSubServiceSessionLevelRef=DcmDspSession/ExtendedDiagnosticSession, DcmDsdSubServiceModeRuleRef=DcmModeRule_NRC22
              Off (DcmDsdSubService): DcmDsdSubServiceId=2, DcmDsdSubServiceSessionLevelRef=DcmDspSession/ExtendedDiagnosticSession
      DcmDsl
        DcmDslBuffer_UDSonCAN_Tx (DcmDslBuffer): DcmDslBufferSize=4095
        DcmDslBuffer_UDSonCAN_Rx (DcmDslBuffer): DcmDslBufferSize=4095
        DcmDslDiagResp: DcmDslDiagRespMaxNumRespPend=5
        DcmDslProtocol
          DcmDslProtocolRow_UDSonCAN (DcmDslProtocolRow):
            DcmDslProtocolID = DCM_UDS_ON_CAN
            DcmDslProtocolPriority = 1
            DcmSendRespPendOnTransToBoot = true
            DcmTimStrP2ServerAdjust = 0.01
            DcmTimStrP2StarServerAdjust = 0.01
            DcmDslProtocolMaximumResponseSize = 20
            DcmDslProtocolRxBufferRef = DcmDslBuffer_UDSonCAN_Rx
            DcmDslProtocolSIDTable = DcmDsdServiceTable_UDS
            DcmDslProtocolTxBufferRef = DcmDslBuffer_UDSonCAN_Tx
            DcmDemClientRef = DemClient
            DcmDslConnection_CAN (DcmDslConnection)
              DcmDslMainConnection: DcmDslProtocolRxTesterSourceAddr=0, DcmDslProtocolComMChannelRef=ComMChannel_Can_Network_Channel
                Diag_Physical_request_Can_Network_CANNODE_0_Phys_PduR2Dcm (DcmDslProtocolRx): DcmDslProtocolRxAddrType=DCM_PHYSICAL_TYPE, DcmDslProtocolRxPduRef=Diag_Physical_request_Can_Network_CANNODE_0_PduR2Dcm
                Diag_Functional_request_Can_Network_CANNODE_0_Phys_PduR2Dcm (DcmDslProtocolRx): DcmDslProtocolRxAddrType=DCM_FUNCTIONAL_TYPE, DcmDslProtocolRxPduRef=Diag_Functional_request_Can_Network_CANNODE_0_PduR2Dcm
                Diag_Physical_response_Can_Network_CANNODE_0_Phys_Dcm2PduR (DcmDslProtocolTx): DcmDslProtocolTxPduRef=Diag_Physical_response_Can_Network_CANNODE_0_Phys_Dcm2PduR
          DcmDslProtocolRow_UDSonIP (DcmDslProtocolRow):
            DcmDslProtocolID = DCM_UDS_ON_IP
            DcmDslProtocolPriority = 1
            DcmSendRespPendOnTransToBoot = true
            DcmTimStrP2ServerAdjust = 0.01
            DcmTimStrP2StarServerAdjust = 0.01
            DcmDslProtocolMaximumResponseSize = 20
            DcmDslProtocolRxBufferRef = DcmDslBuffer_UDSonETH_Rx
            DcmDslProtocolSIDTable = DcmDsdServiceTable_UDS
            DcmDslProtocolTxBufferRef = DcmDslBuffer_UDSonETH_Tx
            DcmDemClientRef = DemClient
            DcmDslConnection_ETHERNET (DcmDslConnection)
              DcmDslMainConnection: DcmDslProtocolRxTesterSourceAddr=0, DcmDslProtocolComMChannelRef=Eth_Network_Channel_EthernetCluster
                DcmDslProtocolRx_DoIP_PduR2Dcm (DcmDslProtocolRx): DcmDslProtocolRxAddrType=DCM_PHYSICAL_TYPE, DcmDslProtocolRxPduRef=RXFrame_Ethernet_PduR2Dcm
                DcmDslProtocolTx_DoIP_Dcm2PduR (DcmDslProtocolTx): DcmDslProtocolTxPduRef=TXFrame_Ethernet_Dcm2PduR
        DcmDslBuffer_UDSonETH_Tx (DcmDslBuffer): DcmDslBufferSize=4095
        DcmDslBuffer_UDSonETH_Rx (DcmDslBuffer): DcmDslBufferSize=4095
      DcmDsp:
        DcmDspDataDefaultEndianness = BIG_ENDIAN
        DcmDspMaxDidToRead = 10
        DcmDspMaxPeriodicDidToRead = 1
        DcmRbDspSesSecUsedInProtocol = UDS
        DcmRbDspSequenceCheckRequestUploadDisabled = false
        DcmDspSecurity: DcmRbDspSecurityDelayTimerMonitor=REQUEST_SEED, DcmRbDspSecurityNRCExceedNoOfAttempt=NumAttDelayAndNumAttLock, DcmRbDspSecurityStoreSeed=false
          5 x DcmDspSecurityRow, all with DcmDspSecurityAttemptCounterEnabled=false, DcmDspSecurityDelayTime=10.0, DcmDspSecurityDelayTimeOnBoot=10.0, DcmDspSecurityKeySize=4, DcmDspSecurityNumAttDelay=2, DcmDspSecuritySeedSize=4, DcmDspSecurityUsePort=USE_ASYNCH_FNC, DcmRbDspSecurityNumAttLock=0:
            DCM_SEC_LEV_L{1..3}: DcmDspSecurityLevel={1..3}, DcmDspSecurityGetSeedFnc=GetSeed_L{1..3}, DcmDspSecurityCompareKeyFnc=CompareKey_L{1..3}
            DCM_SEC_LEV_L5: DcmDspSecurityLevel=5, DcmDspSecurityGetSeedFnc=GetSeed_L5, DcmDspSecurityCompareKeyFnc=CompareKey_L5
            DCM_SEC_LEV_L49: DcmDspSecurityLevel=49, DcmDspSecurityGetSeedFnc=GetSeed_L49, DcmDspSecurityCompareKeyFnc=CompareKey_L49
        DcmDspSession: DcmRbDspSessionParamRecordEnabled=true
          5 x DcmDspSessionRow, all with DcmDspSessionP2ServerMax=0.05, DcmDspSessionP2StarServerMax=5.0:
            DefaultSession: DcmDspSessionForBoot=DCM_NO_BOOT, DcmDspSessionLevel=1
            ProgrammingSession: DcmDspSessionForBoot=DCM_OEM_BOOT, DcmDspSessionLevel=2
            ExtendedDiagnosticSession: DcmDspSessionForBoot=DCM_NO_BOOT, DcmDspSessionLevel=3
            DevelopmentSession: DcmDspSessionForBoot=DCM_NO_BOOT, DcmDspSessionLevel=64
            SupplierDiagnosticSession: DcmDspSessionForBoot=DCM_NO_BOOT, DcmDspSessionLevel=96
        DcmDspDriveVacuumPumpRoutineAuthorization (DcmDspCommonAuthorization): DcmDspCommonAuthorizationSessionRef=DcmDspSession/ExtendedDiagnosticSession, DcmDspCommonAuthorizationSecurityLevelRef=DCM_SEC_LEV_L1
        DcmDspComControl
          DcmDspComControlAllChannel_Can (DcmDspComControlAllChannel): DcmDspAllComMChannelRef=ComMChannel_Can_Network_Channel
          DcmDspComControlAllChannel_Ethernet (DcmDspComControlAllChannel): DcmDspAllComMChannelRef=Eth_Network_Channel_EthernetCluster
        DcmDspRoutine_DriveVacuumPump (DcmDspRoutine): DcmRbDspStopRoutineOnSessionChange=true, DcmDspRoutineIdentifier=1537, DcmDspRoutineUsePort=true
          DcmDspRequestRoutineResults: DcmDspRequestRoutineResultsCommonAuthorizationRef=DcmDspDriveVacuumPumpRoutineAuthorization
            DcmDspRequestRoutineResultsOut
              DcmDspRequestRoutineResultsOutSignal_0 (DcmDspRequestRoutineResultsOutSignal): DcmDspRoutineSignalEndianness=LITTLE_ENDIAN, DcmDspRoutineSignalPos=0, DcmDspRoutineSignalType=UINT8
          DcmDspStartRoutine: DcmDspStartRoutineCommonAuthorizationRef=DcmDspDriveVacuumPumpRoutineAuthorization
            DcmDspStartRoutineIn
              DcmDspStartRoutineInSignal: DcmDspRoutineSignalEndianness=LITTLE_ENDIAN, DcmDspRoutineSignalPos=0, DcmDspRoutineSignalType=UINT8
            DcmDspStartRoutineOut
              DcmDspStartRoutineOutSignal: DcmDspRoutineSignalEndianness=LITTLE_ENDIAN, DcmDspRoutineSignalPos=0, DcmDspRoutineSignalType=UINT8
          DcmDspStopRoutine: DcmDspStopRoutineCommonAuthorizationRef=DcmDspDriveVacuumPumpRoutineAuthorization
            DcmDspStopRoutineOut
              DcmDspStopRoutineOutSignal: DcmDspRoutineSignalEndianness=LITTLE_ENDIAN, DcmDspRoutineSignalPos=0, DcmDspRoutineSignalType=UINT8
        VacuumPumpPres (DcmDspData): DcmDspDataSize=8, DcmDspDataType=UINT8_N, DcmDspDataUsePort=USE_DATA_SYNCH_CLIENT_SERVER, DcmDspDataConditionCheckReadFncUsed=false
        DcmDspDidInfo_VacuumPumpPressure (DcmDspDidInfo): DcmDspDidDynamicallyDefined=false
          DcmDspDidControl:
            DcmDspDidControlMask = DCM_CONTROLMASK_NO
            DcmRbDspIoCtrlResetOnSessSecurityChange = true
            DcmDspDidFreezeCurrentState = true
            DcmDspDidResetToDefault = true
            DcmDspDidShortTermAdjustment = true
            DcmDspDidControlSecurityLevelRef = DCM_SEC_LEV_L1
            DcmDspDidControlSessionRef = DcmDspSession/ExtendedDiagnosticSession
          DcmDspDidRead: DcmDspDidReadSessionRef=DcmDspSession/ExtendedDiagnosticSession, DcmDspDidReadSecurityLevelRef=DCM_SEC_LEV_L1
        DcmDspDid_VacuumPumpPressure (DcmDspDid):
          DcmDspDidIdentifier = 4352
          DcmDspDidUsePort = USE_DATA_ELEMENT_SPECIFIC_INTERFACES
          DcmRbAtomicSenderReceiverCommunication = false
          DcmDspDidInfoRef = DcmDspDidInfo_VacuumPumpPressure
          DcmDspDidSignal: DcmDspDidDataPos=0, DcmDspDidDataRef=VacuumPumpPres
        VehicleSpeed (DcmDspData): DcmDspDataSize=32, DcmDspDataType=UINT8_N, DcmDspDataUsePort=USE_DATA_SENDER_RECEIVER
        SystemFaultRank (DcmDspData): DcmDspDataSize=32, DcmDspDataType=UINT8_N, DcmDspDataUsePort=USE_DATA_SENDER_RECEIVER
        DcmDspDidInfo_VehicleSpeed (DcmDspDidInfo): DcmDspDidDynamicallyDefined=false
          DcmDspDidRead: DcmDspDidReadSessionRef=DcmDspSession/DefaultSession, DcmDspDidReadSessionRef=DcmDspSession/ExtendedDiagnosticSession
          DcmDspDidRead
          DcmDspDidWrite: DcmDspDidWriteSessionRef=DcmDspSession/DefaultSession, DcmDspDidWriteSessionRef=DcmDspSession/ExtendedDiagnosticSession
        DcmDspDidInfo_SystemFaultRank (DcmDspDidInfo): DcmDspDidDynamicallyDefined=false
          DcmDspDidRead: DcmDspDidReadSessionRef=DcmDspSession/DefaultSession, DcmDspDidReadSessionRef=DcmDspSession/ExtendedDiagnosticSession
          DcmDspDidWrite: DcmDspDidWriteSessionRef=DcmDspSession/DefaultSession, DcmDspDidWriteSessionRef=DcmDspSession/ExtendedDiagnosticSession
        DcmDspDid_VehicleSpeed (DcmDspDid):
          DcmDspDidIdentifier = 8976
          DcmDspDidUsePort = USE_DATA_ELEMENT_SPECIFIC_INTERFACES
          DcmRbAtomicSenderReceiverCommunication = false
          DcmDspDidInfoRef = DcmDspDidInfo_VehicleSpeed
          DcmDspDidSignal: DcmDspDidDataPos=0, DcmDspDidDataRef=VehicleSpeed
        DcmDspDid_SystemFaultRank (DcmDspDid):
          DcmDspDidIdentifier = 8977
          DcmDspDidUsePort = USE_DATA_ELEMENT_SPECIFIC_INTERFACES
          DcmRbAtomicSenderReceiverCommunication = false
          DcmDspDidInfoRef = DcmDspDidInfo_SystemFaultRank
          DcmDspDidSignal: DcmDspDidDataPos=0, DcmDspDidDataRef=SystemFaultRank
        DcmRbDspReadDTC: DcmRbDspReadDTCMaxNumDTCRead=5, DcmRbDspReadDTCMaxNumRecordRead=5
        DcmDspDid_IOControl (DcmDspDid):
          DcmDspDidIdentifier = 8981
          DcmRbAtomicSenderReceiverCommunication = false
          DcmDspDidUsePort = USE_DATA_ELEMENT_SPECIFIC_INTERFACES
          DcmDspDidInfoRef = DcmDspDidInfo_IOControl
          DcmDspData_EngineTemperature (DcmDspDidSignal): DcmDspDidDataPos=0, DcmDspDidDataRef=EngineTemperature
          DcmDspDidSignal_PowerMode (DcmDspDidSignal): DcmDspDidDataPos=8, DcmDspDidDataRef=PowerMode
        DcmDspDidInfo_IOControl (DcmDspDidInfo): DcmDspDidDynamicallyDefined=false
          DcmDspDidControl:
            DcmDspDidControlMask = DCM_CONTROLMASK_INTERNAL
            DcmRbDspIoCtrlResetOnSessSecurityChange = true
            DcmDspDidFreezeCurrentState = true
            DcmDspDidResetToDefault = true
            DcmDspDidShortTermAdjustment = true
            DcmDspDidControlMaskSize = 1
            DcmDspDidControlSessionRef = DcmDspSession/ExtendedDiagnosticSession
            DcmDspDidControlSecurityLevelRef = DCM_SEC_LEV_L1
          DcmDspDidRead: DcmDspDidReadSessionRef=DcmDspSession/ExtendedDiagnosticSession, DcmDspDidReadSessionRef=DcmDspSession/DefaultSession
        EngineTemperature (DcmDspData): DcmDspDataSize=8, DcmDspDataType=UINT8_N, DcmDspDataUsePort=USE_DATA_SYNCH_CLIENT_SERVER, DcmDspDataConditionCheckReadFncUsed=false
        DcmDspDidInfo_SerialNumber (DcmDspDidInfo): DcmDspDidDynamicallyDefined=false
          SerialNumber_Read (DcmDspDidRead): DcmDspDidReadSessionRef=DcmDspSession/ExtendedDiagnosticSession, DcmDspDidReadSessionRef=DcmDspSession/DefaultSession
          SerialNumber_Write (DcmDspDidWrite): DcmDspDidWriteSessionRef=DcmDspSession/ExtendedDiagnosticSession, DcmDspDidWriteSecurityLevelRef=DCM_SEC_LEV_L1
        ECU_Serial_Number (DcmDspData): DcmDspDataType=UINT8_N, DcmDspDataSize=128, DcmDspDataEndianness=opaque, DcmDspDataUsePort=USE_DATA_SENDER_RECEIVER
          DcmDspDiagnosisScaling
            DcmDspAlternativeDataType: DcmApplicationDataType=Dcm_ArrDataType_0xF18C_ECU_Serial_Number
        DcmDspDid_SerialNumber (DcmDspDid):
          DcmDspDidIdentifier = 61836
          DcmDspDidUsePort = USE_DATA_ELEMENT_SPECIFIC_INTERFACES
          DcmRbAtomicSenderReceiverCommunication = false
          DcmDspDidInfoRef = DcmDspDidInfo_SerialNumber
          ECU_Serial_Number (DcmDspDidSignal): DcmDspDidDataPos=0, DcmDspDidDataRef=DcmDsp/ECU_Serial_Number
        DcmDspDidInfo_VIN (DcmDspDidInfo): DcmDspDidDynamicallyDefined=false
          Vehicle_Identification_Read (DcmDspDidRead): DcmDspDidReadSessionRef=DcmDspSession/ExtendedDiagnosticSession, DcmDspDidReadSessionRef=DcmDspSession/DefaultSession
          Vehicle_Identification_Write (DcmDspDidWrite): DcmDspDidWriteSessionRef=DcmDspSession/ExtendedDiagnosticSession, DcmDspDidWriteSecurityLevelRef=DCM_SEC_LEV_L1
        DcmDspDid_VIN (DcmDspDid):
          DcmDspDidIdentifier = 61840
          DcmDspDidUsePort = USE_DATA_ELEMENT_SPECIFIC_INTERFACES
          DcmRbAtomicSenderReceiverCommunication = false
          DcmDspDidInfoRef = DcmDspDidInfo_VIN
          VIN (DcmDspDidSignal): DcmDspDidDataPos=0, DcmDspDidDataRef=DcmDspData_VIN
        DcmDspData_VIN (DcmDspData): DcmDspDataType=UINT8_N, DcmDspDataSize=136, DcmDspDataEndianness=opaque, DcmDspDataUsePort=USE_DATA_SENDER_RECEIVER
          DcmDspDiagnosisScaling
            DcmDspAlternativeDataType: DcmApplicationDataType=Dcm_ArrDataType_0xF190_VIN
        PowerMode (DcmDspData): DcmDspDataSize=8, DcmDspDataType=UINT8_N, DcmDspDataUsePort=USE_DATA_SYNCH_CLIENT_SERVER, DcmDspDataConditionCheckReadFncUsed=false
        DcmDspDid_Supplier_ECU_Software_Reference_Number (DcmDspDid):
          DcmDspDidIdentifier = 61844
          DcmDspDidUsePort = USE_DATA_ELEMENT_SPECIFIC_INTERFACES
          DcmRbAtomicSenderReceiverCommunication = false
          DcmDspDidInfoRef = DcmDspDidInfo_Supplier_ECU_Software_Reference_Number_info
          Supplier_ECU_Softdware_Reference_Number (DcmDspDidSignal): DcmDspDidDataPos=0, DcmDspDidDataRef=ECU_SW_Ref_Num
        DcmDspDidInfo_Supplier_ECU_Software_Reference_Number_info (DcmDspDidInfo): DcmDspDidDynamicallyDefined=false
          DID_0xF194_Read (DcmDspDidRead)
        ECU_SW_Ref_Num (DcmDspData): DcmDspDataType=UINT8_N, DcmDspDataSize=80, DcmDspDataEndianness=opaque, DcmDspDataUsePort=USE_DATA_SENDER_RECEIVER
          DcmDspDiagnosisScaling
            DcmDspAlternativeDataType: DcmApplicationDataType=Dcm_ArrDataType_0xF194_Supplier_ECU_Softdware_Reference_Number
        ECU_HW_Ref_Num (DcmDspData): DcmDspDataType=UINT8_N, DcmDspDataSize=80, DcmDspDataEndianness=opaque, DcmDspDataUsePort=USE_DATA_SENDER_RECEIVER
          DcmDspDiagnosisScaling
            DcmDspAlternativeDataType: DcmApplicationDataType=Dcm_ArrDataType_0xF192_Supplier_ECU_Hardware_Reference_Number
        DcmDspDidInfo_Supplier_ECU_Hardware_Reference_Number_info (DcmDspDidInfo): DcmDspDidDynamicallyDefined=false
          DID_0xF192_Read (DcmDspDidRead)
        DcmDspDid_Supplier_ECU_Hardware_Reference_Number (DcmDspDid):
          DcmDspDidIdentifier = 61842
          DcmDspDidUsePort = USE_DATA_ELEMENT_SPECIFIC_INTERFACES
          DcmRbAtomicSenderReceiverCommunication = false
          DcmDspDidInfoRef = DcmDspDidInfo_Supplier_ECU_Hardware_Reference_Number_info
          Supplier_ECU_Hardware_Reference_Number (DcmDspDidSignal): DcmDspDidDataPos=0, DcmDspDidDataRef=ECU_HW_Ref_Num
        ECU_NCF_Ref_Num (DcmDspData): DcmDspDataType=UINT8_N, DcmDspDataSize=64, DcmDspDataEndianness=opaque, DcmDspDataUsePort=USE_DATA_SENDER_RECEIVER
          DcmDspDiagnosisScaling
            DcmDspAlternativeDataType: DcmApplicationDataType=Dcm_ArrDataType_0xF1A2_ECU_NCF_Reference_Number
        DcmDspDidInfo_ECU_NCF_Reference_Number_info (DcmDspDidInfo): DcmDspDidDynamicallyDefined=false
          DID_0xF1A2_Read (DcmDspDidRead)
        DcmDspDid_ECU_NCF_Reference_Number (DcmDspDid):
          DcmDspDidIdentifier = 61858
          DcmDspDidUsePort = USE_DATA_ELEMENT_SPECIFIC_INTERFACES
          DcmRbAtomicSenderReceiverCommunication = false
          DcmDspDidInfoRef = DcmDspDidInfo_ECU_NCF_Reference_Number_info
          ECU_NCF_Reference_Number (DcmDspDidSignal): DcmDspDidDataPos=0, DcmDspDidDataRef=ECU_NCF_Ref_Num
        DcmDspRoutine_CheckMemoryCRC (DcmDspRoutine): DcmRbDspStopRoutineOnSessionChange=true, DcmDspRoutineIdentifier=514, DcmDspRoutineUsePort=true
          DcmDspRequestRoutineResults: DcmDspRequestRoutineResultsCommonAuthorizationRef=DcmDspCheckMemoryCRCRoutineAuthorization
            DcmDspRequestRoutineResultsOut_0 (DcmDspRequestRoutineResultsOut)
              DcmDspRequestRoutineResultsOutSignal_0 (DcmDspRequestRoutineResultsOutSignal): DcmDspRoutineSignalEndianness=LITTLE_ENDIAN, DcmDspRoutineSignalLength=8, DcmDspRoutineSignalPos=0, DcmDspRoutineSignalType=UINT8
          DcmDspStartRoutine: DcmDspStartRoutineCommonAuthorizationRef=DcmDspCheckMemoryCRCRoutineAuthorization
            DcmDspStartRoutineIn
              DcmDspStartRoutineInSignal: DcmDspRoutineSignalEndianness=LITTLE_ENDIAN, DcmDspRoutineSignalLength=8, DcmDspRoutineSignalPos=0, DcmDspRoutineSignalType=UINT8
            DcmDspStartRoutineOut
              DcmDspStartRoutineOutSignal: DcmDspRoutineSignalEndianness=LITTLE_ENDIAN, DcmDspRoutineSignalLength=8, DcmDspRoutineSignalPos=0, DcmDspRoutineSignalType=UINT8
          DcmDspStopRoutine: DcmDspStopRoutineCommonAuthorizationRef=DcmDspCheckMemoryCRCRoutineAuthorization
            DcmDspStopRoutineOut
              DcmDspStopRoutineOutSignal: DcmDspRoutineSignalEndianness=LITTLE_ENDIAN, DcmDspRoutineSignalLength=8, DcmDspRoutineSignalPos=0, DcmDspRoutineSignalType=UINT8
        DcmDspCheckMemoryCRCRoutineAuthorization (DcmDspCommonAuthorization): DcmDspCommonAuthorizationSessionRef=DcmDspSession/ExtendedDiagnosticSession, DcmDspCommonAuthorizationSecurityLevelRef=DCM_SEC_LEV_L1
      DcmPageBufferCfg: DcmPagedBufferEnabled=true, DcmPagedBufferTimeout=0.01
      DcmProcessingConditions
        DcmModeCondition_NRC22 (DcmModeCondition):
          DcmConditionType = DCM_EQUALS
          DcmSwcModeRef = RootSwCompositionPrototype.CPT_ASW_DCM.PPortPrototype_NRC22.MDGP_ModeDeclarationGroup_NRC22.ModeDeclaration_true
        DcmModeRule_NRC22 (DcmModeRule): DcmModeRuleNrcValue=34, DcmArgumentRef=DcmModeCondition_NRC22
        DcmModeCondition_NRC72 (DcmModeCondition):
          DcmConditionType = DCM_EQUALS
          DcmSwcModeRef = RootSwCompositionPrototype.CPT_ASW_DCM.PPortPrototype_NRC72.MDGP_ModeDeclarationGroup_NRC72.ModeDeclaration_true_72
        DcmModeRule_NRC72 (DcmModeRule): DcmModeRuleNrcValue=114, DcmArgumentRef=DcmModeCondition_NRC72
    DcmGeneral: DcmDevErrorDetect=true, DcmRespondAllRequest=false, DcmTaskTime=0.001, DcmVersionInfoApi=true, DcmVinRef=DcmDspDid_VIN
      DcmRbGeneral:
        DcmRbApplCallRequiredOnReqReception = false
        DcmRbApplTxConfirmationRequiredAlways = false
        DcmRbConfirmForDSDGeneratedNegRes = false
        DcmRbDiagAdaptSupport = false
        DcmRbOSTimerUse = CyclicCount
        DcmRbRestoringEnabled = true
        DcmRbRTEsupport = true
        DcmRbSignalDefaultValue = 0
        DcmRbStoringEnabled = true
        DcmRbQueuingOfRequestEnabled = false
        DcmRbRTEsupportsPRportFunctionality = true
