AUTOSAR XML (schema 4-2-2)
package /ETAS_Project/EcucModuleConfigurationValuess
  module config Dem: implementation-config-variant=VARIANT-PRE-COMPILE
    DemConfigSet
      DemComponent_0D01 (DemComponent): DemComponentIgnoresPriority=false, DemComponentFailedCallbackUsePort=true
      DemComponent_0D02 (DemComponent): DemComponentIgnoresPriority=false, DemComponentFailedCallbackUsePort=true
      DemDebounceCounterBasedClass_0D01 (DemDebounceCounterBasedClass):
        DemDebounceBehavior = DEM_DEBOUNCE_FREEZE
        DemDebounceCounterDecrementStepSize = 1
        DemDebounceCounterFailedThreshold = 2
        DemDebounceCounterIncrementStepSize = 1
        DemDebounceCounterPassedThreshold = -2
        DemDebounceCounterStorage = true
      4 x DemEventParameter, all with DemEventAvailable=true, DemEventFailureCycleCounterThreshold=1, DemFFPrestorageSupported=false, DemOperationCycleRef=DemOperationCycle_Power:
        DemEventParameter_0D01_SWC: DemEventKind=DEM_EVENT_KIND_SWC, DemComponentClassRef=DemComponent_0D01, DemDTCRef=DemDTC_0D01
          DemEventClassRB (DemRbEventClass): DemRbEventBufferTime=0
          DemDebounceAlgorithmClass
            DemDebounceCounterBased_LostComm_Sen (DemDebounceCounterBased): DemDebounceCounterBasedClassRef=DemDebounceCounterBasedClass_0D01
        DemEventParameter_0D02_SWC: DemEventKind=DEM_EVENT_KIND_SWC, DemComponentClassRef=DemComponent_0D02, DemDTCRef=DemDTC_0D02
          DemEventClassRB (DemRbEventClass): DemRbEventBufferTime=0
          DemDebounceAlgorithmClass
            DemDebounceCounterBased: DemDebounceCounterBasedClassRef=DemDebounceCounterBasedClass_0D02
        DemEventParameter_0D03_Wdg: DemEventKind=DEM_EVENT_KIND_BSW, DemComponentClassRef=DemComponent_0D03, DemDTCRef=DemDTC_0D03
          DemEventClassRB (DemRbEventClass): DemRbEventBufferTime=0
          DemDebounceAlgorithmClass
            DemDebounceCounterBased: DemDebounceCounterBasedClassRef=DemDebounceCounterBasedClass_0D03
        DemEventParameter_0D04_Busoff0: DemEventKind=DEM_EVENT_KIND_BSW, DemComponentClassRef=DemComponent_0D04, DemDTCRef=DemDTC_0D04
          DemEventClassRB (DemRbEventClass): DemRbEventBufferTime=0
          DemDebounceAlgorithmClass
            DemDebounceCounterBased: DemDebounceCounterBasedClassRef=DemDebounceCounterBasedClass_0D04
      3 x DemDTCAttributes, all with DemAgingAllowed=true, DemAgingCycleCounterThreshold=40, DemImmediateNvStorage=true, DemDTCSignificance=DEM_EVENT_SIGNIFICANCE_FAULT, DemAgingCycleRef=DemOperationCycle_Power, DemMemoryDestinationRef=DemPrimaryMemory, DemFreezeFrameClassRef=FreezeFrame_DTC_DidSet:
        DemDTCAttributes_0D01: DemDTCPriority=2, DemMaxNumberFreezeFrameRecords=5, DemExtendedDataClassRef=DemExtendedDataClass_DTC_0x0D01_Event, DemMemoryDestinationRef=DemMirrorMemory
        DemDTCAttributes_0D02: DemDTCPriority=3, DemMaxNumberFreezeFrameRecords=2, DemExtendedDataClassRef=DemExtendedDataClass_DTC_0x0D02_Event
        DemDTCAttributes_0D03: DemDTCPriority=4, DemMaxNumberFreezeFrameRecords=2
      DemComponent_0D03 (DemComponent): DemComponentIgnoresPriority=false, DemComponentFailedCallbackUsePort=true
      DemComponent_0D04 (DemComponent): DemComponentIgnoresPriority=false, DemComponentFailedCallbackUsePort=true
      3 x DemDebounceCounterBasedClass, all with DemDebounceCounterStorage=true, DemDebounceBehavior=DEM_DEBOUNCE_FREEZE, DemDebounceCounterDecrementStepSize=1, DemDebounceCounterIncrementStepSize=1:
        DemDebounceCounterBasedClass_0D02: DemDebounceCounterFailedThreshold=1, DemDebounceCounterPassedThreshold=-2
        DemDebounceCounterBasedClass_0D03: DemDebounceCounterFailedThreshold=127, DemDebounceCounterPassedThreshold=-128
        DemDebounceCounterBasedClass_0D04: DemDebounceCounterFailedThreshold=127, DemDebounceCounterPassedThreshold=-128
      DemDTCAttributes_0D04 (DemDTCAttributes):
        DemAgingAllowed = true
        DemAgingCycleCounterThreshold = 40
        DemDTCPriority = 5
        DemDTCSignificance = DEM_EVENT_SIGNIFICANCE_FAULT
        DemImmediateNvStorage = true
        DemMaxNumberFreezeFrameRecords = 2
        DemAgingCycleRef = DemOperationCycle_Power
        DemFreezeFrameClassRef = FreezeFrame_DTC_DidSet
        DemMemoryDestinationRef = DemPrimaryMemory
      4 x DemDTC, all with DemDTCSeverity=DEM_SEVERITY_CHECK_IMMEDIATELY:
        DemDTC_0D01: DemDtcValue=852225, DemDTCAttributesRef=DemDTCAttributes_0D01
        DemDTC_0D02: DemDtcValue=852481, DemDTCAttributesRef=DemDTCAttributes_0D02
        DemDTC_0D03: DemDtcValue=852807, DemDTCAttributesRef=DemDTCAttributes_0D03
        DemDTC_0D04: DemDtcValue=853128, DemDTCAttributesRef=DemDTCAttributes_0D04
      DemEventParameter_0D05_Busoff1 (DemEventParameter):
        DemEventAvailable = true
        DemEventFailureCycleCounterThreshold = 1
        DemEventKind = DEM_EVENT_KIND_BSW
        DemFFPrestorageSupported = false
        DemOperationCycleRef = DemOperationCycle_Power
        DemComponentClassRef = DemComponent_0D05
        DemDTCRef = DemDTC_0D05
        DemEventClassRB (DemRbEventClass): DemRbEventBufferTime=0
        DemDebounceAlgorithmClass
          DemDebounceCounterBased: DemDebounceCounterBasedClassRef=DemDebounceCounterBasedClass_0D05
      DemDTC_0D05 (DemDTC): DemDTCSeverity=DEM_SEVERITY_CHECK_IMMEDIATELY, DemDtcValue=853384, DemDTCAttributesRef=DemDTCAttributes_0D05
      DemDTCAttributes_0D05 (DemDTCAttributes):
        DemAgingAllowed = true
        DemAgingCycleCounterThreshold = 40
        DemDTCPriority = 6
        DemDTCSignificance = DEM_EVENT_SIGNIFICANCE_FAULT
        DemImmediateNvStorage = true
        DemMaxNumberFreezeFrameRecords = 2
        DemAgingCycleRef = DemOperationCycle_Power
        DemFreezeFrameClassRef = FreezeFrame_DTC_DidSet
        DemMemoryDestinationRef = DemPrimaryMemory
      DemComponent_0D05 (DemComponent): DemComponentIgnoresPriority=false, DemComponentFailedCallbackUsePort=true
      DemDebounceCounterBasedClass_0D05 (DemDebounceCounterBasedClass):
        DemDebounceCounterStorage = true
        DemDebounceBehavior = DEM_DEBOUNCE_FREEZE
        DemDebounceCounterDecrementStepSize = 1
        DemDebounceCounterFailedThreshold = 2
        DemDebounceCounterIncrementStepSize = 1
        DemDebounceCounterPassedThreshold = -2
      DemDTC_0D06 (DemDTC): DemDTCSeverity=DEM_SEVERITY_NO_SEVERITY, DemDtcValue=853515, DemDTCAttributesRef=DemDTCAttributes_0D06
      DemEventParameter_0D06_Comb0 (DemEventParameter):
        DemEventAvailable = true
        DemEventFailureCycleCounterThreshold = 1
        DemEventKind = DEM_EVENT_KIND_SWC
        DemFFPrestorageSupported = false
        DemOperationCycleRef = DemOperationCycle_Power
        DemComponentClassRef = DemComponent_0D06_Comb0
        DemDTCRef = DemDTC_0D06
        DemEventClassRB (DemRbEventClass): DemRbEventBufferTime=0
        DemDebounceAlgorithmClass
          DemDebounceCounterBased: DemDebounceCounterBasedClassRef=DemDebounceCounterBasedClass_0D06_Comb0
      DemEventParameter_0D06_Comb1 (DemEventParameter):
        DemEventAvailable = true
        DemEventFailureCycleCounterThreshold = 1
        DemEventKind = DEM_EVENT_KIND_SWC
        DemFFPrestorageSupported = false
        DemOperationCycleRef = DemOperationCycle_Power
        DemComponentClassRef = DemComponent_0D06_Comb1
        DemDTCRef = DemDTC_0D06
        DemEventClassRB (DemRbEventClass): DemRbEventBufferTime=0
        DemDebounceAlgorithmClass
          DemDebounceCounterBased: DemDebounceCounterBasedClassRef=DemDebounceCounterBasedClass_0D06_Comb1
      DemDebounceCounterBasedClass_0D06_Comb0 (DemDebounceCounterBasedClass):
        DemDebounceCounterStorage = true
        DemDebounceBehavior = DEM_DEBOUNCE_FREEZE
        DemDebounceCounterDecrementStepSize = 1
        DemDebounceCounterFailedThreshold = 2
        DemDebounceCounterIncrementStepSize = 1
        DemDebounceCounterPassedThreshold = -2
      DemDebounceCounterBasedClass_0D06_Comb1 (DemDebounceCounterBasedClass):
        DemDebounceCounterStorage = true
        DemDebounceBehavior = DEM_DEBOUNCE_FREEZE
        DemDebounceCounterDecrementStepSize = 1
        DemDebounceCounterFailedThreshold = 2
        DemDebounceCounterIncrementStepSize = 1
        DemDebounceCounterPassedThreshold = -2
      DemComponent_0D06_Comb0 (DemComponent): DemComponentIgnoresPriority=false, DemComponentFailedCallbackUsePort=true
      DemComponent_0D06_Comb1 (DemComponent): DemComponentIgnoresPriority=false, DemComponentFailedCallbackUsePort=true
      DemDTCAttributes_0D06 (DemDTCAttributes):
        DemAgingAllowed = true
        DemAgingCycleCounterThreshold = 40
        DemDTCPriority = 7
        DemDTCSignificance = DEM_EVENT_SIGNIFICANCE_FAULT
        DemImmediateNvStorage = true
        DemMaxNumberFreezeFrameRecords = 2
        DemAgingCycleRef = DemOperationCycle_Power
        DemFreezeFrameClassRef = FreezeFrame_DTC_DidSet
        DemMemoryDestinationRef = DemPrimaryMemory
    DemGeneral:
      DemAgingRequieresTestedCycle = false
      DemAvailabilitySupport = DEM_EVENT_AVAILABILITY
      DemBswErrorBufferSize = 10
      DemClearDTCBehavior = DEM_CLRRESP_VOLATILE
      DemClearDTCLimitation = DEM_ONLY_CLEAR_ALL_DTCS
      DemDataElementDefaultEndianness = BIG_ENDIAN
      DemDebounceCounterBasedSupport = true
      DemDebounceTimeBasedSupport = false
      DemDevErrorDetect = true
      DemDtcStatusAvailabilityMask = 255
      DemEventCombinationSupport = DEM_EVCOMB_ONRETRIEVAL
      DemEventDisplacementStrategy = DEM_DISPLACEMENT_FULL
      DemEventMemoryEntryStorageTrigger = DEM_TRIGGER_ON_CONFIRMED
      DemGeneralInterfaceSupport = false
      DemMaxNumberEventEntryPermanent = 6
      DemMaxNumberPrestoredFF = 5
      DemOccurrenceCounterProcessing = DEM_PROCESS_OCCCTR_TF
      DemResetConfirmedBitOnOverflow = true
      DemStatusBitHandlingTestFailedSinceLastClear = DEM_STATUS_BIT_NORMAL
      DemStatusBitStorageTestFailed = true
      DemSuppressionSupport = DEM_DTC_SUPPRESSION
      DemTaskTime = 0.001
      DemTriggerDcmReports = false
      DemTriggerDltReports = false
      DemTriggerFiMReports = false
      DemTriggerMonitorInitBeforeClearOk = false
      DemTypeOfDTCSupported = DEM_DTC_TRANSLATION_ISO14229_1
      DemTypeOfFreezeFrameRecordNumeration = DEM_FF_RECNUM_CALCULATED
      DemVersionInfoApi = false
      DemEnvironmentDataCapture = DEM_CAPTURE_SYNCHRONOUS_TO_REPORTING
      DemMaxNumberEventEntryEventBuffer = 10
      DemOperationCycleStatusStorage = true
      DemOBDSupport = DEM_OBD_NO_OBD_SUPPORT
      DemPrimaryMemory: DemMaxNumberEventEntryPrimary=10
      DemRbGeneral:
        DemRbAgingCounterType = COUNT_UP
        DemRbDebLimitRelevantForJumping = false
        DemRbDebounceTimeBasedTaskTime = 0.001
        DemRbDebugData = ON_32BIT
        DemRbDisturbanceMemoryCallbackOnDisturbance = false
        DemRbDisturbanceMemorySupported = false
        DemRbOccurrenceCounterType = AUTOSAR
        DemRbSupportEventCategory = false
        DemRbSupportFailureDependency = false
        DemRbSymbolicNamesAccordingAR402 = false
        DemRbEnableNvmBlockLengthChecks = true
        DemRbEnableDemNvmBlocksAutoConfiguration = true
        DemEventCategory_0 (DemRbEventCategory): DemRbEventCategoryId=254
        DemRbOptimization
      DemClient: DemClientFunctionality=DEM_CLIENT_USES_FULL_FUNCTIONALITY, DemClientUsesRte=false, DemRbClientPriority=1, DemEventMemorySetRef=DemEventMemorySet
      FreezeFrame_DTC_DidSet (DemFreezeFrameClass):
        DemDidClassRef = DemDidClass_SupplyVoltage
        DemDidClassRef = DemDidClass_OdometerReading
        DemDidClassRef = DemDidClass_PowerMode
        DemDidClassRef = DemDidClass_DataTime
      4 x DemDidClass:
        DemDidClass_SupplyVoltage: DemDidIdentifier=274, DemDidDataElementClassRef=DemDataElementClass_SupplyVoltage
        DemDidClass_OdometerReading: DemDidIdentifier=57601, DemDidDataElementClassRef=DemDataElementClass_OdometerReading
        DemDidClass_PowerMode: DemDidIdentifier=53249, DemDidDataElementClassRef=DemDataElementClass_PowerMode
        DemDidClass_DataTime: DemDidIdentifier=267, DemDidDataElementClassRef=DemDataElementClass_Year, DemDidDataElementClassRef=DemDataElementClass_Month, DemDidDataElementClassRef=DemDataElementClass_Day, DemDidDataElementClassRef=DemDataElementClass_Hour, DemDidDataElementClassRef=DemDataElementClass_Minute
      PowertrainDTCGroup (DemGroupOfDTC): DemGroupDTCs=851968
      DemExtendedDataClass_DTC_0x0D01_Event (DemExtendedDataClass): DemExtendedDataRecordClassRef=Record_ExtendedDataRecord
      Record_ExtendedDataRecord (DemExtendedDataRecordClass):
        DemExtendedDataRecordNumber = 1
        DemExtendedDataRecordTrigger = DEM_TRIGGER_ON_TEST_FAILED
        DemExtendedDataRecordUpdate = DEM_UPDATE_RECORD_NO
        DemDataElementClassRef = INTER_ExtendedDataRecord_Fault_occurrence_counter
        DemDataElementClassRef = CS_ExtendedDataRecord_Fault_pending_counter
        DemDataElementClassRef = CS_ExtendedDataRecord_Aged_counter
        DemDataElementClassRef = INTER_ExtendedDataRecord_Aging_counter
      DemExtendedDataClass_DTC_0x0D02_Event (DemExtendedDataClass): DemExtendedDataRecordClassRef=Record_ExtendedDataRecord
      12 x DemDataElementClass:
        DemDataElementClass_Year
          DemExternalCSDataElementClass_0 (DemExternalCSDataElementClass): DemDataElementDataSize=2, DemDataElementUsePort=true
        DemDataElementClass_Month
          DemExternalCSDataElementClass_0 (DemExternalCSDataElementClass): DemDataElementDataSize=1, DemDataElementUsePort=true
        DemDataElementClass_Day
          DemExternalCSDataElementClass_0 (DemExternalCSDataElementClass): DemDataElementDataSize=1, DemDataElementUsePort=true
        DemDataElementClass_Hour
          DemExternalCSDataElementClass_0 (DemExternalCSDataElementClass): DemDataElementDataSize=1, DemDataElementUsePort=true
        DemDataElementClass_Minute
          DemExternalCSDataElementClass_0 (DemExternalCSDataElementClass): DemDataElementDataSize=1, DemDataElementUsePort=true
        INTER_ExtendedDataRecord_Fault_occurrence_counter
          DemInternalDataElementClass: DemDataElementDataSize=1, DemInternalDataElement=DEM_OCCCTR
        INTER_ExtendedDataRecord_Aging_counter
          DemInternalDataElementClass: DemDataElementDataSize=1, DemInternalDataElement=DEM_AGINGCTR_UPCNT
        CS_ExtendedDataRecord_Fault_pending_counter
          DemExternalCSDataElementClass_0 (DemExternalCSDataElementClass): DemDataElementDataSize=1, DemDataElementUsePort=true
        CS_ExtendedDataRecord_Aged_counter
          DemExternalCSDataElementClass_0 (DemExternalCSDataElementClass): DemDataElementDataSize=1, DemDataElementUsePort=true
        DemDataElementClass_SupplyVoltage
          Dem_External_CSDataElementClass_SupplyVoltage (DemExternalCSDataElementClass): DemDataElementDataSize=1, DemDataElementUsePort=true
        DemDataElementClass_OdometerReading
          Dem_External_CSDataElementClass_OdometerReading (DemExternalCSDataElementClass): DemDataElementDataSize=3, DemDataElementUsePort=true
        DemDataElementClass_PowerMode
          Dem_External_CSDataElementClass_PowerMode (DemExternalCSDataElementClass): DemDataElementDataSize=1, DemDataElementUsePort=true
      DemExtendedDataClass_DTC_0x0D07_Event (DemExtendedDataClass): DemExtendedDataRecordClassRef=Record_ExtendedDataRecord
      DemMirrorMemory: DemMaxNumberEventEntryMirror=1
      DemUserDefinedMemory: DemMaxNumberEventEntryUserDefined=1, DemUserDefinedMemoryIdentifier=200
      DemOperationCycle_Power (DemOperationCycle): DemRbIsStartViaApiAllowed=false
