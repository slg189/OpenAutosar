AUTOSAR XML (schema 4-2-2)
package /ETAS_Project/EcucModuleConfigurationValuess
  module config Det
    DetGeneral: DetForwardToDlt=false, DetVersionInfoApi=false
      DetRbBuffer: DetRbErrorBufferSize=10, DetRbUseErrorBufferApi=0
