AUTOSAR XML (schema 4-2-2)
package /ETAS_Project/EcucModuleConfigurationValuess
  module config DoIP: implementation-config-variant=VARIANT-PRE-COMPILE
    DoIPConfigSet_0 (DoIPConfigSet): DoIPLogicalAddress=1, DoIPEid=1, DoIPGid=1
      DoIPChannel: DoIPChannelSARef=DoIPTester_0, DoIPChannelTARef=DoIPTargetAddress_0
        DoIPPduRRxPdu: DoIPPduRRxPduRef=RXFrame_Ethernet_DoIP2PduR
        DoIPPduRTxPdu: DoIPPduRTxPduRef=TXFrame_Ethernet_PduR2DoIP
      DoIPConnections
        DoIPTargetAddress_0 (DoIPTargetAddress): DoIPTargetAddressValue=65521
        DoIPTcpConnection_DATA (DoIPTcpConnection): DoIPRbRequestAddressAssignment=true
          DoIPSoAdRxPdu_TCP_DATA (DoIPSoAdRxPdu): DoIPSoAdRxPduRef=RXFrame_EthernetTCP_SoAd2DoIP
          DoIPSoAdTxPdu_TCP_DATA (DoIPSoAdTxPdu): DoIPSoAdTxPduRef=TXFrame_EthernetTCP_DoIP2SoAd
        DoIPUdpConnection_TEST_EQUIPMENT (DoIPUdpConnection): DoIPRbRequestAddressAssignment=true
          DoIPSoAdRxPdu_UDP_TEST_EQUIPMENT (DoIPSoAdRxPdu): DoIPSoAdRxPduRef=RXFrame_EthernetUDP_SoAd2DoIP
          DoIPSoAdTxPdu_UDP_TEST_EQUIPMENT (DoIPSoAdTxPdu): DoIPSoAdTxPduRef=TXFrame_EthernetUDP_DoIP2SoAd
        DoIPUdpConnection_DISCOVERY (DoIPUdpConnection): DoIPRbRequestAddressAssignment=false
          DoIPSoAdRxPdu_UDP_DISCOVERY (DoIPSoAdRxPdu): DoIPSoAdRxPduRef=RXFrame_EthernetUDP_Discovery
          DoIPSoAdTxPdu_UDP_DISCOVERY (DoIPSoAdTxPdu): DoIPSoAdTxPduRef=TXFrame_EthernetUDP_Discovery
      DoIPTester_0 (DoIPTester): DoIPNumByteDiagAckNack=1, DoIPTesterSA=2, DoIPRoutingActivationRef=DoIPRoutingActivation_0
      DoIPRoutingActivation_0 (DoIPRoutingActivation): DoIPRoutingActivationNumber=0, DoIPTargetAddressRef=DoIPTargetAddress_0
    DoIPGeneral:
      DoIPAliveCheckResponseTimeout = 0.5
      DoIPDevelopmentErrorDetect = true
      DoIPDhcpOptionVinUse = true
      DoIPEntityStatusMaxByteFieldUse = true
      DoIPGIDInvalidityPattern = 255
      DoIPGeneralInactivityTime = 300.0
      DoIPHostNameSizeMax = 125
      DoIPInitialInactivityTime = 2.0
      DoIPInitialVehicleAnnouncementTime = 0.0
      DoIPMainFunctionPeriod = 0.01
      DoIPMaxRequestBytes = 1024
      DoIPMaxTesterConnections = 10
      DoIPMaxUDPRequestPerMessage = 1
      DoIPNodeType = DOIP_NODE
      DoIPUseEIDasGID = false
      DoIPUseMacAddressForIdentification = false
      DoIPUseVehicleIdentificationSyncStatus = true
      DoIPVehicleAnnouncementInterval = 0.5
      DoIPVersionInfoApi = false
      DoIPVinGidMaster = true
      DoIPVinInvalidityPattern = 255
      DoIPVehicleAnnouncementRepetition = 3
      DoIPPowerModeCallback_0 (DoIPPowerModeCallback)
      DoIPRbGeneral_0 (DoIPRbGeneral): DoIPRbCheckApiConsistency=1, DoIPRbGenericHeaderIgnoreInvalidUDPType=1, DoIPRbFurtherActionByteIndependentFromRA=true
