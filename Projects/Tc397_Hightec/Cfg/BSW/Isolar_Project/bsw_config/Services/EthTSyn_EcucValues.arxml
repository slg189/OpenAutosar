AUTOSAR XML (schema 4-2-2)
package /ETAS_Project/EcucModuleConfigurationValuess
  module config EthTSyn
    EthTSynGeneral:
      EthTSynDestPhyAddr = 01:80:C2:00:00:0E
      EthTSynDevErrorDetect = true
      EthTSynGlobalTimeRxToUplinkSwitchResidenceTime = 0.0
      EthTSynGlobalTimeUplinkToTxSwitchResidenceTime = 0
      EthTSynHardwareTimestampSupport = true
      EthTSynMainFunctionPeriod = 0.01
      EthTSynMasterSlaveConflictDetection = true
      EthTSynMessageCompliance = false
      EthTSynSwitchMgmtRxMessageBufferCount = 10
      EthTSynVersionInfoApi = true
      EthTSynEthIfFrameType = EthIfFrameOwnerConfig_EthTsyn_88f7
    EthTSynGlobalTimeDomain: EthTSynGlobalTimeDomainId=0, EthTSynSynchronizedTimeBaseRef=StbMSynchronizedTimeBase_Eth
      EthTSynGlobalTimeFollowUpDataIDList
        16 x EthTSynGlobalTimeFollowUpDataIDListElement:
          EthTSynGlobalTimeFollowUpDataIDListElement_{0..15}: EthTSynGlobalTimeFollowUpDataIDListIndex={0..15}, EthTSynGlobalTimeFollowUpDataIDListValue={0..15}
      EthTSynPortConfig_0 (EthTSynPortConfig): EthTSynGlobalTimeDebounceTime=0.1, EthTSynGlobalTimeEthIfRef=EthernetCommunicationConnector
        EthTSynPdelayConfig_1111 (EthTSynPdelayConfig):
          EthTSynGlobalTimePdelayRespEnable = true
          EthTSynGlobalTimePropagationDelay = 0.0
          EthTSynGlobalTimeTxPdelayReqPeriod = 20.0
          EthTSynPdelayLatencyThreshold = 3.987542387
          EthTSynPdelayRespAndRespFollowUpTimeout = 0.0
        EthTSynPortRole
          EthTSynGlobalTimeMaster:
            EthTSynCyclicMsgResumeTime = 3.0
            EthTSynGlobalTimeTxCrcSecured = CRC_SUPPORTED
            EthTSynGlobalTimeTxPeriod = 1.0
            EthTSynImmediateTimeSync = true
            EthTSynIsSystemWideGlobalTimeMaster = false
            EthTSynTLVFollowUpOFSSubTLV = false
            EthTSynTLVFollowUpStatusSubTLV = true
            EthTSynTLVFollowUpTimeSubTLV = true
            EthTSynTLVFollowUpUserDataSubTLV = true
            EthTSynCrcTimeFlagsTxSecured:
              EthTSynCrcCorrectionField = true
              EthTSynCrcDomainNumber = true
              EthTSynCrcMessageLength = true
              EthTSynCrcPreciseOriginTimestamp = true
              EthTSynCrcSequenceId = true
              EthTSynCrcSourcePortIdentity = true
  module config StbM: implementation-config-variant=VARIANT-PRE-COMPILE
    StbMSynchronizedTimeBase_Eth (StbMSynchronizedTimeBase):
      StbMIsSystemWideGlobalTimeMaster = true
      StbMStoreTimebaseNonVolatile = NO_STORAGE
      StbMSynchronizedTimeBaseIdentifier = 0
      StbMAllowSystemWideGlobalTimeMaster = true
      StbMLocalTimeClock:
        StbMClockFrequency = 1000
        StbMClockPrescaler = 1
        StbMRbLocalTimeHardwareRefType = OS
        StbMRbExternalCounterRef = false
        StbMLocalTimeHardware = Rte_TickCounter
    StbMTriggeredCustomer_Eth (StbMTriggeredCustomer): StbMTriggeredCustomerPeriod=500000, StbMOSScheduleTableRef=Rte_ScheduleTable, StbMSynchronizedTimeBaseRef=StbMSynchronizedTimeBase_Eth
    StbMGeneral:
      StbMDevErrorDetect = true
      StbMVersionInfoApi = false
      StbMGetCurrentTimeExtendedAvailable = false
      StbMMainFunctionPeriod = 0.01
      StbMTimeRecordingSupport = false
  module config EthIf: implementation-config-variant=VARIANT-PRE-COMPILE
    EthIfConfigSet
      EthIfRxIndication_EthTsyn (EthIfRxIndicationConfig): EthIfRxIndicationFunction=EthTSyn_RxIndication
      EthIfFrameOwnerConfig_EthTsyn_88f7 (EthIfFrameOwnerConfig): EthIfFrameType=35063, EthIfRxIndicationRef=EthIfRxIndication_EthTsyn, EthIfTxConfirmationRef=EthIfTxConfirmationConfig_EthTSyn
      EthIfTxConfirmationConfig_EthTSyn (EthIfTxConfirmationConfig): EthIfTxConfirmationFunction=EthTSyn_TxConfirmation
  module config Mfl: implementation-config-variant=VARIANT-PRE-COMPILE
    MflGeneral: MflRbOptimizationMcuExtract=false, MflRbOptimization=NO_OPTIMIZATION, Mfl_VersionInfoAPI=OFF
    MflMemoryLocations (MflRbMemoryLocations):
      mflRbMemLocAbsf32 = NORMAL
      mflRbMemLocArcCosf32 = NORMAL
      mflRbMemLocArcSinf32 = NORMAL
      mflRbMemLocArcTanf32 = NORMAL
      mflRbMemLocArcTan2f32 = NORMAL
      mflRbMemLocArrayAveragef32f32 = NORMAL
      mflRbMemLocAveragef32f32 = NORMAL
      mflRbMemLocCalcTeQf32 = NORMAL
      mflRbMemLocCalcTeQAppf32 = NORMAL
      mflRbMemLocCeilf32 = NORMAL
      mflRbMemLocCosf32 = NORMAL
      mflRbMemLocCtrlSetLimit = NORMAL
      mflRbMemLocCvrtf32s16 = NORMAL
      mflRbMemLocCvrtf32s32 = NORMAL
      mflRbMemLocCvrtf32u16 = NORMAL
      mflRbMemLocCvrtf32u32 = NORMAL
      mflRbMemLocCvrts16f32 = NORMAL
      mflRbMemLocCvrts32f32 = NORMAL
      mflRbMemLocCvrtu16f32 = NORMAL
      mflRbMemLocCvrtu32f32 = NORMAL
      mflRbMemLocDeadTimef32f32 = NORMAL
      mflRbMemLocDebounceu8u8 = NORMAL
      mflRbMemLocDebounceInit = NORMAL
      mflRbMemLocDebounceSetParam = NORMAL
      mflRbMemLocDT1Typ1Calc = NORMAL
      mflRbMemLocDT1Typ1Outf32 = NORMAL
      mflRbMemLocDT1Typ1SetState = NORMAL
      mflRbMemLocDT1Typ2Calc = NORMAL
      mflRbMemLocDT1Typ2Outf32 = NORMAL
      mflRbMemLocDT1Typ2SetState = NORMAL
      mflRbMemLocExpf32 = NORMAL
      mflRbMemLocFloorf32 = NORMAL
      mflRbMemLocHypotf32f32f32 = NORMAL
      mflRbMemLocHystCenterHalfDeltaf32u8 = NORMAL
      mflRbMemLocHystDeltaRightf32u8 = NORMAL
      mflRbMemLocHystLeftDeltaf32u8 = NORMAL
      mflRbMemLocHystLeftRightf32u8 = NORMAL
      mflRbMemLocICalc = NORMAL
      mflRbMemLocILimCalc = NORMAL
      mflRbMemLocIOutf32 = NORMAL
      mflRbMemLocISetState = NORMAL
      mflRbMemLocLimitf32 = NORMAL
      mflRbMemLocLogf32 = NORMAL
      mflRbMemLocMaxf32 = NORMAL
      mflRbMemLocMedianSortf32f32 = NORMAL
      mflRbMemLocMinf32 = NORMAL
      mflRbMemLocPCalc = NORMAL
      mflRbMemLocPDCalc = NORMAL
      mflRbMemLocPDOutf32 = NORMAL
      mflRbMemLocPDSetParam = NORMAL
      mflRbMemLocPDSetState = NORMAL
      mflRbMemLocPIDOutf32 = NORMAL
      mflRbMemLocPIDSetParam = NORMAL
      mflRbMemLocPIDSetState = NORMAL
      mflRbMemLocPIDTyp1Calc = NORMAL
      mflRbMemLocPIDTyp1LimCalc = NORMAL
      mflRbMemLocPIDTyp2Calc = NORMAL
      mflRbMemLocPIDTyp2LimCalc = NORMAL
      mflRbMemLocPIOutf32 = NORMAL
      mflRbMemLocPISetParam = NORMAL
      mflRbMemLocPISetState = NORMAL
      mflRbMemLocPITyp1Calc = NORMAL
      mflRbMemLocPITyp1LimCalc = NORMAL
      mflRbMemLocPITyp2Calc = NORMAL
      mflRbMemLocPITyp2LimCalc = NORMAL
      mflRbMemLocPOutf32 = NORMAL
      mflRbMemLocPowf32 = NORMAL
      mflRbMemLocPT1Calc = NORMAL
      mflRbMemLocPT1Outf32 = NORMAL
      mflRbMemLocPT1SetState = NORMAL
      mflRbMemLocRampCalc = NORMAL
      mflRbMemLocRampCalcJump = NORMAL
      mflRbMemLocRampCalcSwitch = NORMAL
      mflRbMemLocRampCheckActivity = NORMAL
      mflRbMemLocRampGetSwitchPos = NORMAL
      mflRbMemLocRampInitState = NORMAL
      mflRbMemLocRampOutf32 = NORMAL
      mflRbMemLocRampSetParam = NORMAL
      mflRbMemLocRateLimiterf32 = NORMAL
      mflRbMemLocRoundf32 = NORMAL
      mflRbMemLocSignf32 = NORMAL
      mflRbMemLocSinf32 = NORMAL
      mflRbMemLocSortAscendf32 = NORMAL
      mflRbMemLocSortDescendf32 = NORMAL
      mflRbMemLocSqrtf32 = NORMAL
      mflRbMemLocTanf32 = NORMAL
      mflRbMemLocTruncf32 = NORMAL
      mflRbMemLocFloatToIntCvrtf32s16 = NORMAL
      mflRbMemLocFloatToIntCvrtf32s32 = NORMAL
      mflRbMemLocFloatToIntCvrtf32s8 = NORMAL
      mflRbMemLocFloatToIntCvrtf32u16 = NORMAL
      mflRbMemLocFloatToIntCvrtf32u32 = NORMAL
      mflRbMemLocFloatToIntCvrtf32u8 = NORMAL
      mflRbMemLocIntToFloatCvrts16f32 = NORMAL
      mflRbMemLocIntToFloatCvrts32f32 = NORMAL
      mflRbMemLocIntToFloatCvrts8f32 = NORMAL
      mflRbMemLocIntToFloatCvrtu16f32 = NORMAL
      mflRbMemLocIntToFloatCvrtu32f32 = NORMAL
      mflRbMemLocIntToFloatCvrtu8f32 = NORMAL
