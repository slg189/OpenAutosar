AUTOSAR XML (schema 4-2-2)
package /ModeDeclarationGroup_NRC22
  mode declaration group ModeDeclarationGroup_NRC22: initial-mode=ModeDeclaration_true
    mode ModeDeclaration_true: value=1
    mode ModeDeclaration_false: value=0
