AUTOSAR XML (schema 4-2-2)
package /ModeDeclarationGroup_NRC72
  mode declaration group ModeDeclarationGroup_NRC72: initial-mode=ModeDeclaration_true_72
    mode ModeDeclaration_false_72: value=0
    mode ModeDeclaration_true_72: value=1
