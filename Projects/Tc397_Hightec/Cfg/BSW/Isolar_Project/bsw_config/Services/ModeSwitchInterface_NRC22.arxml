AUTOSAR XML (schema 4-2-2)
package /ModeSwitchInterface_NRC22
  mode switch interface ModeSwitchInterface_NRC22: is-service=true
    mode group MDGP_ModeDeclarationGroup_NRC22: type=ModeDeclarationGroup_NRC22
