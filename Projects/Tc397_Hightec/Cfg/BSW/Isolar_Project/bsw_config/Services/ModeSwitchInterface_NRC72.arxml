AUTOSAR XML (schema 4-2-2)
package /ModeSwitchInterface_NRC72
  mode switch interface ModeSwitchInterface_NRC72: is-service=true
    mode group MDGP_ModeDeclarationGroup_NRC72: type=ModeDeclarationGroup_NRC72
