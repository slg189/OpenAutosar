AUTOSAR XML (schema 4-2-2)
package /RB/UBK/Project/EcucModuleConfigurationValuess
  module config WdgIf
    WdgIfDevice: WdgIfDeviceIndex=0, WdgIfDriverRef=WdgGeneral
    WdgIfGeneral: WdgIfDevErrorDetect=true, WdgIfVersionInfoApi=false
