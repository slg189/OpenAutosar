AUTOSAR XML (schema 4-2-2)
package /RB/UBK/Project/EcucModuleConfigurationValuess
  module config Wdg
    WdgGeneral: WdgDevErrorDetect=true, WdgVersionInfoApi=false, WdgMaxTimeout=10.0
    WdgPublishedInformation_0 (WdgPublishedInformation)
    WdgSettingsConfig_0 (WdgSettingsConfig)
