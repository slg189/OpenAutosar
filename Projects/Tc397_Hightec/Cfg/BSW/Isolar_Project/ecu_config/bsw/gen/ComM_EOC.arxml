AUTOSAR XML (schema 4-2-2)
package /AUTOSAR_ComM/TimingExtensions
  bsw module timing ComM_BswModuleTiming: behavior=BswInternalBehavior
    timing-requirements:
      execution order constraint EOC_EcuM_Init: execution-order-constraint-type=ORDINARY-EOC, is-event=false, permit-multiple-references-to-ee=false
        ordered-elements:
          eoc executable entity ref EOCEERef_CE_ComM_Init: bsw-module-instance=ComM, executable=CE_Init
      execution order constraint EOC_T_xxms: execution-order-constraint-type=ORDINARY-EOC, is-event=true
        ordered-elements:
          eoc event ref EOCEventRef_ComM_0: bsw-module-instance=ComM, event=EV_SE_MainFunction_ComMChannel_Can_Network_Channel, successor=EOCEventRef_ComM_1
          eoc event ref EOCEventRef_ComM_1: bsw-module-instance=ComM, event=EV_SE_MainFunction_ComMChannel_Can_Network_XCP_Channel, successor=EOCEventRef_ComM_2
          eoc event ref EOCEventRef_ComM_2: bsw-module-instance=ComM, event=EV_SE_MainFunction_Eth_Network_Channel_EthernetCluster
