AUTOSAR XML (schema 4-3-0)
package /AUTOSAR_EthIf/TimingExtensions
  bsw module timing EthIf: behavior=BswInternalBehavior
    timing-descriptions:
      td event bsw module EOC_EthIf_Init: bsw-module-description=EthIf, bsw-module-entry=EthIf_Init, td-event-bsw-module-type=BSW-M-ENTRY-CALLED
      td event bsw internal behavior EOC_T_xxmsRx0: bsw-module-entity=SE_MainFunctionRx_EthIfPhysCtrlRxMainFunctionPriorityProcessing
      td event bsw internal behavior EOC_T_xxmsTx: bsw-module-entity=SE_MainFunctionTx
      td event bsw internal behavior EOC_T_yyms: bsw-module-entity=SE_MainFunctionState
    timing-requirements:
      execution order constraint EOC_T_xxmsTx: execution-order-constraint-type=ORDINARY-EOC, is-event=true, permit-multiple-references-to-ee=false
        ordered-elements:
          eoc event ref EOCEventRef_EthIf_Tx_1: bsw-module-instance=EthIf, event=EV_SE_MainFunctionTx
      execution order constraint EOC_T_xxmsRx0: execution-order-constraint-type=ORDINARY-EOC, is-event=true, permit-multiple-references-to-ee=false
        ordered-elements:
          eoc event ref EOCEventRef_EthIf_Rx_0: bsw-module-instance=EthIf, event=EV_SE_MainFunctionRx_EthIfPhysCtrlRxMainFunctionPriorityProcessing
      execution order constraint EOC_T_yyms: execution-order-constraint-type=ORDINARY-EOC, is-event=true, permit-multiple-references-to-ee=false
        ordered-elements:
          eoc event ref EOCEventRef_EthIf_State_1: bsw-module-instance=EthIf, event=EV_SE_MainFunctionState, successor=EOCEventRef_EthIf_Rx_0
