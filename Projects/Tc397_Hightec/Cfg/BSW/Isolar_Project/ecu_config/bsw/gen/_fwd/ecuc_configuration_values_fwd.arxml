AUTOSAR XML (schema 4-2-2)
package /ETAS_Project/EcucModuleConfigurationValuess
  module config CanIf
    CanIfInitCfg
      9 x CanIfTxPduCfg:
        MCU_03_Can_Network_CANNODE_0: CanIfTxPduId=3
        MCU_01_Can_Network_CANNODE_0: CanIfTxPduId=1
        NM_VCU_Can_Network_CANNODE_0: CanIfTxPduId=4
        MCU_02_Can_Network_CANNODE_0: CanIfTxPduId=2
        Diag_Physical_response_Can_Network_CANNODE_0: CanIfTxPduId=0
        XCP_TX_DAQ0_Can_Network_CANNODE_1: CanIfTxPduId=5
        XCP_TX_DAQ1_Can_Network_CANNODE_1: CanIfTxPduId=6
        XCP_TX_DAQ2_Can_Network_CANNODE_1: CanIfTxPduId=7
        XCP_TX_RES_Can_Network_CANNODE_1: CanIfTxPduId=8
      7 x CanIfRxPduCfg:
        HCU_01_Can_Network_CANNODE_0: CanIfRxPduId=0
        Diag_Functional_request_Can_Network_CANNODE_0: CanIfRxPduId=1
        HCU_02_Can_Network_CANNODE_0: CanIfRxPduId=2
        NM_VCU_Rx_ETAS_Can_Network_CANNODE_0: CanIfRxPduId=3
        Diag_Physical_request_Can_Network_CANNODE_0: CanIfRxPduId=4
        XCP_RX_Broadcast_Can_Network_CANNODE_1: CanIfRxPduId=5
        XCP_RX_CMD_Can_Network_CANNODE_1: CanIfRxPduId=6
    CanIfCtrlDrvCfg
      Can_Network_CANNODE_0 (CanIfCtrlCfg): CanIfCtrlId=0
      Can_Network_CANNODE_1 (CanIfCtrlCfg): CanIfCtrlId=1
  module config ComM
    ComMConfigSet
      3 x ComMChannel:
        ComMChannel_Can_Network_Channel: ComMChannelId=0
        ComMChannel_Can_Network_XCP_Channel: ComMChannelId=1
        Eth_Network_Channel_EthernetCluster: ComMChannelId=2
  module config DoIP
    DoIPConfigSet_0 (DoIPConfigSet)
      DoIPConnections
        DoIPUdpConnection_DISCOVERY (DoIPUdpConnection)
          DoIPSoAdRxPdu_UDP_DISCOVERY (DoIPSoAdRxPdu): DoIPSoAdRxPduId=0
          DoIPSoAdTxPdu_UDP_DISCOVERY (DoIPSoAdTxPdu): DoIPSoAdTxPduId=0
        DoIPUdpConnection_TEST_EQUIPMENT (DoIPUdpConnection)
          DoIPSoAdRxPdu_UDP_TEST_EQUIPMENT (DoIPSoAdRxPdu): DoIPSoAdRxPduId=1
          DoIPSoAdTxPdu_UDP_TEST_EQUIPMENT (DoIPSoAdTxPdu): DoIPSoAdTxPduId=1
        DoIPTcpConnection_DATA (DoIPTcpConnection)
          DoIPSoAdRxPdu_TCP_DATA (DoIPSoAdRxPdu): DoIPSoAdRxPduId=2
          DoIPSoAdTxPdu_TCP_DATA (DoIPSoAdTxPdu): DoIPSoAdTxPduId=2
      DoIPChannel
        DoIPPduRTxPdu: DoIPPduRTxPduId=0
        DoIPPduRRxPdu: DoIPPduRRxPduId=0
  module config NvM
    15 x NvMBlockDescriptor, all with NvMBlockJobPriority=1, NvMBlockUseCrc=true, NvMBlockWriteProt=false, NvMMaxNumOfReadRetries=0, NvMMaxNumOfWriteRetries=0, NvMNvBlockNum=1, NvMNvramDeviceId=0, NvMRbGenRteServicePort=false, NvMRomBlockNum=0, NvMSelectBlockForReadAll=true, NvMSelectBlockForWriteAll=true, NvMStaticBlockIDCheck=false, NvMWriteVerification=false, NvMWriteVerificationDataSize=0:
      ECUM_CFG_NVM_BLOCK: NvMBlockManagementType=NVM_BLOCK_NATIVE, NvMBlockUseSyncMechanism=false, NvMBlockUseCRCCompMechanism=false, NvMCalcRamBlockCrc=false, NvMNvBlockLength=4, NvMBlockHeaderInclude=EcuM, NvMRamBlockDataAddress=EcuM_Rb_dataShutdownInfo_st, NvMResistantToChangedSw=false, NvMRomBlockDataAddress=NULL_PTR, NvMSingleBlockCallback=EcuM_Rb_NvMSingleBlockCallbackFunction, NvMWriteBlockOnce=false
      NVM_ID_EVT_STATUSBYTE: NvMBlockManagementType=NVM_BLOCK_NATIVE, NvMBlockUseSyncMechanism=true, NvMRbNvBlockLengthString=DEM_SIZEOF_VAR(Dem_AllEventsStatusByte), NvMReadRamBlockFromNvCallback=Dem_EventStatusByteReadRamBlockFromNvCallback, NvMResistantToChangedSw=true, NvMWriteBlockOnce=false, NvMBlockManagementType=NVM_BLOCK_NATIVE, NvMWriteBlockOnce=false, NvMWriteRamBlockToNvCallback=Dem_EventStatusByteWriteRamBlockToNvCallback
      NVM_ID_EVMEM_LOC_{0..11}: NvMBlockManagementType=NVM_BLOCK_NATIVE, NvMBlockUseSyncMechanism=true, NvMRbNvBlockLengthString=DEM_SIZEOF_TYPE(Dem_EvMemEventMemoryType), NvMReadRamBlockFromNvCallback=Dem_EvMemNvmReadRamBlockFromNvCallback{0..11}, NvMResistantToChangedSw=true, NvMWriteBlockOnce=false, NvMBlockManagementType=NVM_BLOCK_NATIVE, NvMWriteBlockOnce=false, NvMWriteRamBlockToNvCallback=Dem_EvMemNvMWriteRamBlockToNvCallback{0..11}
      NVM_ID_DEM_GENERIC_NV_DATA: NvMBlockManagementType=NVM_BLOCK_NATIVE, NvMBlockUseSyncMechanism=true, NvMRbNvBlockLengthString=DEM_SIZEOF_VAR(Dem_GenericNvData), NvMReadRamBlockFromNvCallback=Dem_GenericNVDataReadRamBlockFromNvCallback, NvMResistantToChangedSw=true, NvMWriteBlockOnce=false, NvMBlockManagementType=NVM_BLOCK_NATIVE, NvMWriteBlockOnce=false, NvMWriteRamBlockToNvCallback=Dem_GenericNVDataWriteRamBlockToNvCallback
  module config EcuM
    EcuMConfiguration_0 (EcuMConfiguration)
      EcuMCommonConfiguration
        12 x EcuMWakeupSource:
          ECUM_WKSOURCE_POWER
          ECUM_WKSOURCE_RESET
          ECUM_WKSOURCE_INTERNAL_RESET
          ECUM_WKSOURCE_INTERNAL_WDG
          ECUM_WKSOURCE_EXTERNAL_WDG
          ECUM_WKSOURCE_POWER: EcuMWakeupSourceId=0, EcuMValidationTimeout=0.0
          ECUM_WKSOURCE_RESET: EcuMWakeupSourceId=1, EcuMValidationTimeout=0.0
          ECUM_WKSOURCE_INTERNAL_RESET: EcuMWakeupSourceId=2, EcuMValidationTimeout=0.0
          ECUM_WKSOURCE_INTERNAL_WDG: EcuMWakeupSourceId=3, EcuMValidationTimeout=0.0
          ECUM_WKSOURCE_EXTERNAL_WDG: EcuMWakeupSourceId=4, EcuMValidationTimeout=0.0
          ECUM_WKSOURCE_CANMSG: EcuMWakeupSourceId=5
          ECUM_WKSOURCE_KL15: EcuMWakeupSourceId=6
      EcuMFlexConfiguration
        6 x EcuMResetMode:
          ECUM_RESET_MCU
          ECUM_RESET_WDGM
          ECUM_RESET_IO
          ECUM_RESET_MCU: EcuMResetModeId=0
          ECUM_RESET_WDGM: EcuMResetModeId=1
          ECUM_RESET_IO: EcuMResetModeId=2
        8 x EcuMShutdownCause:
          ECUM_CAUSE_UNKNOWN
          ECUM_CAUSE_ECU_STATE
          ECUM_CAUSE_WDGM
          ECUM_CAUSE_DCM
          ECUM_CAUSE_UNKNOWN: EcuMShutdownCauseId=0
          ECUM_CAUSE_ECU_STATE: EcuMShutdownCauseId=1
          ECUM_CAUSE_WDGM: EcuMShutdownCauseId=2
          ECUM_CAUSE_DCM: EcuMShutdownCauseId=3
  module config EthIf
    EthIfConfigSet
      EthernetCommunicationConnector (EthIfController): EthIfCtrlIdx=0
      EthIfPhysController_1 (EthIfPhysController): EthIfPhysControllerIdx=0
  module config Nm
    NmChannelConfig_Can_Network_Channel (NmChannelConfig): NmNodeDetectionEnabled=true, NmNodeIdEnabled=true, NmRepeatMsgIndEnabled=true, NmComUserDataSupport=false, NmPassiveModeEnabled=false
  module config TcpIp
    TcpIpConfig
      TcpIpLocalAddr_Uni_10_184_133_253 (TcpIpLocalAddr): TcpIpAddrId=0
  module config Xcp
    XcpConfig
      3 x XcpEventChannel:
        Event_10ms_Raster: XcpEventChannelNumber=0
        Event_100ms_Raster: XcpEventChannelNumber=1
        Event_50ms_Raster: XcpEventChannelNumber=2
      3 x XcpTransportLayer:
        XcpTransportLayer_CAN: XcpTransportLayerId=0
          XcpRxPdu_RX_CMD (XcpRxPdu): XcpRxPduId=0
          XcpRxPdu_RX_Broadcast (XcpRxPdu): XcpRxPduId=1
          4 x XcpTxPdu:
            XcpTxPdu_RES: XcpTxPduId=0
            XcpTxPdu_DAQ0: XcpTxPduId=1
            XcpTxPdu_DAQ1: XcpTxPduId=2
            XcpTxPdu_DAQ2: XcpTxPduId=3
        XcpTransportLayer_ETH_TCP: XcpTransportLayerId=1
          XcpRxPdu_TCP_RX (XcpRxPdu): XcpRxPduId=0
          XcpTxPdu_TCP_TX (XcpTxPdu): XcpTxPduId=0
        XcpTransportLayer_ETH_UDP: XcpTransportLayerId=2
          XcpRxPdu_UDP_RX (XcpRxPdu): XcpRxPduId=1
          XcpTxPdu_UDP_TX (XcpTxPdu): XcpTxPduId=1
  module config rba_MemLib
    rba_MemLibPublished:
      rba_MemLibPublishedEnablePrototype = false
      rba_MemLibPublishedEnableRte = true
      rba_MemLibPublishedEnableVecu = false
      rba_MemLibPublishedSwMajorVersion = 17
      rba_MemLibPublishedSwMinorVersion = 0
      rba_MemLibPublishedSwPatchVersion = 0
      rba_MemLibPublishedARMajorVersion = 4
      rba_MemLibPublishedARMinorVersion = 2
      rba_MemLibPublishedARRevisionVersion = 2
  module config CanNm
    CanNmGlobalConfig
      CanNmChannelConfig_NmConfig_CanNmCluster_0 (CanNmChannelConfig)
        CanNmRxPdu_NM_VCU_Rx_ETAS_Can_Network_CANNODE_0_CanIf2CanNm (CanNmRxPdu): CanNmRxPduId=0
        CanNmTxPdu_NM_VCU_Can_Network_CANNODE_0_CanNm2CanIf (CanNmTxPdu): CanNmTxConfirmationPduId=0
  module config CanSM
    CanSMConfiguration
      CanSMManagerNetwork_Can_Network (CanSMManagerNetwork): CanSMNetworkIndex=0
      CanSMManagerNetwork_Can_Network_XCP (CanSMManagerNetwork): CanSMNetworkIndex=1
  module config SoAd
    SoAdConfig
      7 x SoAdPduRoute:
        SoAdPduRoute_UDP_TX: SoAdTxPduId=0
        SoAdPduRoute_TCP_TX: SoAdTxPduId=1
        SoAdPduRoute_DoIP_UDP_TEST_EQUIPMENT: SoAdTxPduId=2
        SoAdPduRoute_DoIP_UDP_DISCOVERY: SoAdTxPduId=3
        SoAdPduRoute_DoIP_TCP: SoAdTxPduId=4
        SoAdPduRoute_XCP_UDP_TX: SoAdTxPduId=5
        SoAdPduRoute_XCP_TCP_TX: SoAdTxPduId=6
      7 x SoAdSocketRoute:
        SoAdSocketRoute_UDP
          SoAdSocketRouteDest: SoAdRxPduId=0
        SoAdSocketRoute_TCP
          SoAdSocketRouteDest: SoAdRxPduId=1
        SoAdSocketRoute_DoIP_UDP_TEST_EQUIPMENT
          SoAdSocketRouteDest: SoAdRxPduId=2
        SoAdSocketRoute_DoIP_UDP_DISCOVERY
          SoAdSocketRouteDest: SoAdRxPduId=3
        SoAdSocketRoute_DoIP_TCP
          SoAdSocketRouteDest: SoAdRxPduId=4
        SoAdSocketRoute_XCP_UDP_RX
          SoAdSocketRouteDest: SoAdRxPduId=5
        SoAdSocketRoute_XCP_TCP_RX
          SoAdSocketRouteDest: SoAdRxPduId=6
      6 x SoAdSocketConnectionGroup:
        SoAdSocketConnectionGroup_UDP: SoAdSocketConnectionGroupId=0
          SoAdSocketConnection_UDP (SoAdSocketConnection): SoAdSocketId=0
        SoAdSocketConnectionGroup_TCP: SoAdSocketConnectionGroupId=1
          SoAdSocketConnection_TCP (SoAdSocketConnection): SoAdSocketId=1
        SoAdSocketConnectionGroup_DoIP_UDP: SoAdSocketConnectionGroupId=2
          SoAdSocketConnection_DoIP_UDP_DISCOVERY (SoAdSocketConnection): SoAdSocketId=2
          SoAdSocketConnection_DoIP_UDP_TEST_EQUIPMENT (SoAdSocketConnection): SoAdSocketId=3
        SoAdSocketConnectionGroup_DoIP_TCP: SoAdSocketConnectionGroupId=3
          SoAdSocketConnection_DoIP_TCP (SoAdSocketConnection): SoAdSocketId=4
        SoAdSocketConnectionGroup_XCP_UDP: SoAdSocketConnectionGroupId=4
          SoAdSocketConnection_UDP_XCP (SoAdSocketConnection): SoAdSocketId=5
        SoAdSocketConnectionGroup_XCP_TCP: SoAdSocketConnectionGroupId=5
          SoAdSocketConnection_TCP_XCP (SoAdSocketConnection): SoAdSocketId=6
      6 x SoAdRoutingGroup:
        SoAdRoutingGroup_RX: SoAdRoutingGroupId=0
        SoAdRoutingGroup_TX: SoAdRoutingGroupId=1
        SoAdRoutingGroup_DoIP_UDP: SoAdRoutingGroupId=2
        SoAdRoutingGroup_DoIP_TCP: SoAdRoutingGroupId=3
        SoAdRoutingGroup_XCP_UDP: SoAdRoutingGroupId=4
        SoAdRoutingGroup_XCP_TCP: SoAdRoutingGroupId=5
  module config Dem
    DemConfigSet
      7 x DemEventParameter:
        DemEventParameter_0D01_SWC: DemEventId=1
        DemEventParameter_0D02_SWC: DemEventId=2
        DemEventParameter_0D03_Wdg: DemEventId=3
        DemEventParameter_0D04_Busoff0: DemEventId=4
        DemEventParameter_0D05_Busoff1: DemEventId=5
        DemEventParameter_0D06_Comb0: DemEventId=6
        DemEventParameter_0D06_Comb1: DemEventId=7
    DemGeneral
      DemOperationCycle_Power (DemOperationCycle): DemOperationCycleId=0
      DemClient: DemClientId=1, DemEventMemorySetRef=DemEventMemorySet
      INTER_ExtendedDataRecord_Fault_occurrence_counter (DemDataElementClass)
        DemInternalDataElementClass: DemDataElementDataSize=1
      INTER_ExtendedDataRecord_Aging_counter (DemDataElementClass)
        DemInternalDataElementClass: DemDataElementDataSize=1
      DemEventMemorySet: DemDtcStatusAvailabilityMask=255, DemMaxNumberEventEntryPermanent=6, DemTypeOfDTCSupported=DEM_DTC_TRANSLATION_ISO14229_1
        DemPrimaryMemory: DemMaxNumberEventEntryPrimary=10
        DemUserDefinedMemory: DemUserDefinedMemoryIdentifier=200, DemMaxNumberEventEntryUserDefined=1
        DemMirrorMemory: DemMaxNumberEventEntryMirror=1
      14 x DemNvRamBlockId:
        DEM_NVM_ID_EVT_STATUSBYTE: DemNvRamBlockIdRef=NvM/NVM_ID_EVT_STATUSBYTE
        DEM_NVM_ID_EVMEM_LOC_{0..11}: DemRbNvRamImmediateStoragePriority=10000, DemNvRamBlockIdRef=NvM/NVM_ID_EVMEM_LOC_{0..11}
        DEM_NVM_ID_DEM_GENERIC_NV_DATA: DemRbNvRamImmediateStoragePriority=10000, DemNvRamBlockIdRef=NvM/NVM_ID_DEM_GENERIC_NV_DATA
  module config Com
    ComGeneral: ComSupportedIPduGroups=2
    ComConfig_0 (ComConfig)
      9 x ComIPdu:
        ComIPdu_TCP_RX: ComIPduHandleId=0
        ComIPdu_UDP_RX: ComIPduHandleId=1
        HCU_01_Can_Network_CANNODE_0: ComIPduHandleId=2
        HCU_02_Can_Network_CANNODE_0: ComIPduHandleId=3
        MCU_01_Can_Network_CANNODE_0: ComIPduHandleId=0
        MCU_02_Can_Network_CANNODE_0: ComIPduHandleId=1
        MCU_03_Can_Network_CANNODE_0: ComIPduHandleId=2
        ComIPdu_TCP_TX: ComIPduHandleId=3
        ComIPdu_UDP_TX: ComIPduHandleId=4
      64 x ComSignal:
        ComSignal_TCP_RX: ComHandleId=0
        ComSignal_UDP_RX: ComHandleId=1
        HCU01_ActiveDischarge: ComHandleId=2
        HCU01_CheckSum: ComHandleId=3
        HCU01_Counter: ComHandleId=4
        HCU01_EmergShutDown: ComHandleId=5
        HCU01_EnaMCU: ComHandleId=6
        HCU01_McuModeCmd: ComHandleId=7
        HCU01_Shift: ComHandleId=8
        HCU01_SpeedCmd: ComHandleId=9
        HCU01_TqCmd: ComHandleId=10
        HCU02_Poweroff: ComHandleId=11
        MCU01_ActDischStatus: ComHandleId=0
        MCU01_CheckSum: ComHandleId=1
        MCU01_Counter: ComHandleId=2
        MCU01_CurCntTor: ComHandleId=3
        MCU01_EmergShutDown: ComHandleId=4
        MCU01_HighVolAllowed: ComHandleId=5
        MCU01_Motorspd: ComHandleId=6
        MCU01_Ready: ComHandleId=7
        MCU01_SelfCheck: ComHandleId=8
        MCU01_ShutDownAllowed: ComHandleId=9
        MCU01_Status: ComHandleId=10
        MCU02_IGBTTmp: ComHandleId=11
        MCU02_Idc: ComHandleId=12
        MCU02_MaxTor: ComHandleId=13
        MCU02_MinTor: ComHandleId=14
        MCU02_MotorTmp: ComHandleId=15
        MCU02_Vdc: ComHandleId=16
        MCU03_12VSupply: ComHandleId=17
        MCU03_LI_OverSpeed: ComHandleId=18
        MCU03_LI_OverTempEM: ComHandleId=19
        MCU03_LI_OverTempINV: ComHandleId=20
        MCU03_LI_UdcOver: ComHandleId=21
        MCU03_LI_UdcUnder: ComHandleId=22
        MCU03_NRF_5VSupply: ComHandleId=23
        MCU03_NRF_COMError: ComHandleId=24
        MCU03_NRF_DESAT: ComHandleId=25
        MCU03_NRF_EMTempSamp: ComHandleId=26
        MCU03_NRF_IdcSamp: ComHandleId=27
        MCU03_NRF_InvTempSamp: ComHandleId=28
        MCU03_NRF_PhASamp: ComHandleId=29
        MCU03_NRF_PhBSamp: ComHandleId=30
        MCU03_NRF_PhCSamp: ComHandleId=31
        MCU03_NRF_Resolver: ComHandleId=32
        MCU03_NRF_SysFailure: ComHandleId=33
        MCU03_NRF_UdcSamp: ComHandleId=34
        MCU03_RF_BusOff: ComHandleId=35
        MCU03_RF_HWOverCur: ComHandleId=36
        MCU03_RF_IdcOver: ComHandleId=37
        MCU03_RF_IntError: ComHandleId=38
        MCU03_RF_MsgTO: ComHandleId=39
        MCU03_RF_OverSpeed: ComHandleId=40
        MCU03_RF_OverTempEM: ComHandleId=41
        MCU03_RF_OverTempINV: ComHandleId=42
        MCU03_RF_PhAOver: ComHandleId=43
        MCU03_RF_PhBOver: ComHandleId=44
        MCU03_RF_PhCOver: ComHandleId=45
        MCU03_RF_PhaseImp: ComHandleId=46
        MCU03_RF_ToqError: ComHandleId=47
        MCU03_RF_UDCUnder: ComHandleId=48
        MCU03_RF_UdcOver: ComHandleId=49
        ComSignal_TCP_TX: ComHandleId=50
        ComSignal_UDP_TX: ComHandleId=51
      ComIPduGroup_Rx (ComIPduGroup): ComIPduGroupHandleId=0
      ComIPduGroup_Tx (ComIPduGroup): ComIPduGroupHandleId=1
  module config WdgM
    WdgMGeneral
      WdgMSupervisedEntity_Alive_Supervision_Entity1 (WdgMSupervisedEntity): WdgMSupervisedEntityId=0
        WdgMCheckpoint_Alive_Supervision_Entity1 (WdgMCheckpoint): WdgMCheckpointId=0
      WdgMSupervisedEntity_Deadline_Supervision_Entity1 (WdgMSupervisedEntity): WdgMSupervisedEntityId=1
        WdgMCheckpoint_Deadline_Supervision_Entity1 (WdgMCheckpoint): WdgMCheckpointId=0
        WdgMCheckpoint_Deadline_Supervision_Entity2 (WdgMCheckpoint): WdgMCheckpointId=1
      WdgMWatchdog: WdgMWatchdogName=WdgIfConf_WdgIfDevice_WdgIfDevice
    WdgMConfigSet
      WdgMMode_FastMode (WdgMMode): WdgMModeId=0
      WdgMMode_SlowMode (WdgMMode): WdgMModeId=1
  module config Dcm
    DcmConfigSet
      DcmDsl
        DcmDslProtocol
          DcmDslProtocolRow_UDSonCAN (DcmDslProtocolRow)
            DcmDslConnection_CAN (DcmDslConnection)
              DcmDslMainConnection
                Diag_Physical_request_Can_Network_CANNODE_0_Phys_PduR2Dcm (DcmDslProtocolRx): DcmDslProtocolRxPduId=0
                Diag_Functional_request_Can_Network_CANNODE_0_Phys_PduR2Dcm (DcmDslProtocolRx): DcmDslProtocolRxPduId=2
                Diag_Physical_response_Can_Network_CANNODE_0_Phys_Dcm2PduR (DcmDslProtocolTx): DcmDslTxConfirmationPduId=0
          DcmDslProtocolRow_UDSonIP (DcmDslProtocolRow)
            DcmDslConnection_ETHERNET (DcmDslConnection)
              DcmDslMainConnection
                DcmDslProtocolRx_DoIP_PduR2Dcm (DcmDslProtocolRx): DcmDslProtocolRxPduId=1
                DcmDslProtocolTx_DoIP_Dcm2PduR (DcmDslProtocolTx): DcmDslTxConfirmationPduId=1
      DcmDsd
        DcmDsdServiceTable_UDS (DcmDsdServiceTable): DcmDsdSidTabId=0
      DcmDsp
        DcmDspSession
          3 x DcmDspSessionRow:
            DefaultSession
            ProgrammingSession
            ExtendedDiagnosticSession
        5 x DcmDspData, all with DcmDspDataEndianness=BIG_ENDIAN:
          VacuumPumpPres
          VehicleSpeed
          SystemFaultRank
          EngineTemperature
          PowerMode
  module config MemIf
    MemIfGeneral:
      MemIfMainFunctionCycleTime = 0.01
      MemIfNumberOfDevices = 1
      MemIfRbFeeUsed = true
      MemIfRbMainFunctionScheduling = MEMIF_RB_MAINFUNC_SCHEDULING_RTE_TIMED
      MemIfRbNumberOfEADevices = 0
  module config Fee
    FeeGeneral: FeePollingMode=true
    28 x FeeBlockConfiguration, all with FeeImmediateData=false, FeeNumberOfWriteCycles=1, FeeRbCallbackEnd=NULL_PTR, FeeRbCallbackError=NULL_PTR, FeeRbDeviceIndex=0, FeeRbFirstReadDataMigration=false, FeeRbOrigin=NVM, FeeRbSecLevel=1, FeeRbSurvival=false, FeeRbVarBlockLength=false:
      ECUM_CFG_NVM_BLOCK: FeeBlockSize=4, FeeRbBlockPersistentId=62199, FeeRbBlockSizeString=, FeeRbNoFallback=false
      NVM_ID_DEM_GENERIC_NV_DATA: FeeBlockSize=1, FeeRbBlockPersistentId=19105, FeeRbBlockSizeString=DEM_SIZEOF_VAR(Dem_GenericNvData) + 0, FeeRbNoFallback=false
      NVM_ID_EVMEM_LOC_0: FeeBlockSize=1, FeeRbBlockPersistentId=9510, FeeRbBlockSizeString=DEM_SIZEOF_TYPE(Dem_EvMemEventMemoryType) + 0, FeeRbNoFallback=false
      NVM_ID_EVMEM_LOC_1: FeeBlockSize=1, FeeRbBlockPersistentId=9383, FeeRbBlockSizeString=DEM_SIZEOF_TYPE(Dem_EvMemEventMemoryType) + 0, FeeRbNoFallback=false
      NVM_ID_EVMEM_LOC_10: FeeBlockSize=1, FeeRbBlockPersistentId=34539, FeeRbBlockSizeString=DEM_SIZEOF_TYPE(Dem_EvMemEventMemoryType) + 0, FeeRbNoFallback=false
      NVM_ID_EVMEM_LOC_11: FeeBlockSize=1, FeeRbBlockPersistentId=38883, FeeRbBlockSizeString=DEM_SIZEOF_TYPE(Dem_EvMemEventMemoryType) + 0, FeeRbNoFallback=false
      NVM_ID_EVMEM_LOC_2: FeeBlockSize=1, FeeRbBlockPersistentId=13997, FeeRbBlockSizeString=DEM_SIZEOF_TYPE(Dem_EvMemEventMemoryType) + 0, FeeRbNoFallback=false
      NVM_ID_EVMEM_LOC_3: FeeBlockSize=1, FeeRbBlockPersistentId=14124, FeeRbBlockSizeString=DEM_SIZEOF_TYPE(Dem_EvMemEventMemoryType) + 0, FeeRbNoFallback=false
      NVM_ID_EVMEM_LOC_4: FeeBlockSize=1, FeeRbBlockPersistentId=560, FeeRbBlockSizeString=DEM_SIZEOF_TYPE(Dem_EvMemEventMemoryType) + 0, FeeRbNoFallback=false
      NVM_ID_EVMEM_LOC_5: FeeBlockSize=1, FeeRbBlockPersistentId=945, FeeRbBlockSizeString=DEM_SIZEOF_TYPE(Dem_EvMemEventMemoryType) + 0, FeeRbNoFallback=false
      NVM_ID_EVMEM_LOC_6: FeeBlockSize=1, FeeRbBlockPersistentId=4539, FeeRbBlockSizeString=DEM_SIZEOF_TYPE(Dem_EvMemEventMemoryType) + 0, FeeRbNoFallback=false
      NVM_ID_EVMEM_LOC_7: FeeBlockSize=1, FeeRbBlockPersistentId=4154, FeeRbBlockSizeString=DEM_SIZEOF_TYPE(Dem_EvMemEventMemoryType) + 0, FeeRbNoFallback=false
      NVM_ID_EVMEM_LOC_8: FeeBlockSize=1, FeeRbBlockPersistentId=27402, FeeRbBlockSizeString=DEM_SIZEOF_TYPE(Dem_EvMemEventMemoryType) + 0, FeeRbNoFallback=false
      NVM_ID_EVMEM_LOC_9: FeeBlockSize=1, FeeRbBlockPersistentId=27275, FeeRbBlockSizeString=DEM_SIZEOF_TYPE(Dem_EvMemEventMemoryType) + 0, FeeRbNoFallback=false
      NVM_ID_EVT_STATUSBYTE: FeeBlockSize=1, FeeRbBlockPersistentId=20742, FeeRbBlockSizeString=DEM_SIZEOF_VAR(Dem_AllEventsStatusByte) + 0, FeeRbNoFallback=false
      NV_CrcBlock: FeeBlockSize=8, FeeRbBlockPersistentId=21762, FeeRbBlockSizeString=, FeeRbNoFallback=false
      NV_ExternalReprogrammingRequestFlagBlock: FeeBlockSize=1, FeeRbBlockPersistentId=32702, FeeRbBlockSizeString=, FeeRbNoFallback=false
      NV_PartNumberBlock: FeeBlockSize=32, FeeRbBlockPersistentId=5793, FeeRbBlockSizeString=, FeeRbNoFallback=true
      NV_ProgrammingAttemptCounterBlock: FeeBlockSize=4, FeeRbBlockPersistentId=46837, FeeRbBlockSizeString=, FeeRbNoFallback=false
      NV_ProgrammingCounterBlock: FeeBlockSize=4, FeeRbBlockPersistentId=19119, FeeRbBlockSizeString=, FeeRbNoFallback=false
      NV_ResetResponseFlagBlock: FeeBlockSize=1, FeeRbBlockPersistentId=59481, FeeRbBlockSizeString=, FeeRbNoFallback=false
      NV_ValidityFlagsBlock: FeeBlockSize=1, FeeRbBlockPersistentId=3127, FeeRbBlockSizeString=, FeeRbNoFallback=false
      NvMBlockDescriptor_DID_IOControl: FeeBlockSize=17, FeeRbBlockPersistentId=40404, FeeRbBlockSizeString=, FeeRbNoFallback=false
      NvMBlockDescriptor_DID_SystemFaultRank: FeeBlockSize=4, FeeRbBlockPersistentId=16680, FeeRbBlockSizeString=, FeeRbNoFallback=false
      NvMBlockDescriptor_DID_VehicleSpeed: FeeBlockSize=17, FeeRbBlockPersistentId=45679, FeeRbBlockSizeString=, FeeRbNoFallback=false
      NvMBlockDescriptor_ReadWritebyAddress: FeeBlockSize=4, FeeRbBlockPersistentId=39806, FeeRbBlockSizeString=, FeeRbNoFallback=false
      NvM_NativeBlock_2: FeeBlockSize=1024, FeeRbBlockPersistentId=41675, FeeRbBlockSizeString=, FeeRbNoFallback=false
      NvM_NativeBlock_3: FeeBlockSize=1024, FeeRbBlockPersistentId=45890, FeeRbBlockSizeString=, FeeRbNoFallback=false
  module config rba_DiagLib
    8 x rba_DiagLib_DataStructure:
      Dem_Cfg_Dtc: rba_DiagLib_IndexType=Dem_DtcIdType
      Dem_Cfg_Dtc: rba_DiagLib_RangeCheckMacro=DEM_ASSERT_RANGECHECK, rba_DiagLib_InvalidIndex=true
        8 x rba_DiagLib_Attribute:
          Kind: rba_DiagLib_BitSize=2, rba_DiagLib_Type=Dem_DTCKindType, rba_DiagLib_RequiresAtomicAccess=false
          Severity: rba_DiagLib_BitSize=8, rba_DiagLib_Type=Dem_DTCSeverityType, rba_DiagLib_RequiresAtomicAccess=false
          Nv_Storage: rba_DiagLib_BitSize=1, rba_DiagLib_Type=boolean, rba_DiagLib_RequiresAtomicAccess=false
          Func_Unit: rba_DiagLib_BitSize=1, rba_DiagLib_Type=uint8, rba_DiagLib_RequiresAtomicAccess=false
          DtcCode_Is_Index: rba_DiagLib_BitSize=1, rba_DiagLib_Type=boolean, rba_DiagLib_RequiresAtomicAccess=false
          Obd_DtcCode: rba_DiagLib_BitSize=16, rba_DiagLib_Type=Dem_DtcCodeType, rba_DiagLib_RequiresAtomicAccess=false
          DtcCode: rba_DiagLib_BitSize=24, rba_DiagLib_Type=Dem_DtcCodeType, rba_DiagLib_RequiresAtomicAccess=false
          Obd_DtcCode: rba_DiagLib_ReturnValueIfDisabled=DEM_INVALID_DTC
        12 x rba_DiagLib_DataItem:
          DemDTC_0D01
          DemDTC_0D01
            7 x rba_DiagLib_AttributeValue:
              DemDTC_0D01__Kind: rba_DiagLib_Value=DEM_DTC_KIND_ALL_DTCS, rba_DiagLib_AttributeRef=Dem_Cfg_Dtc/Kind
              DemDTC_0D01__Severity: rba_DiagLib_Value=DEM_SEVERITY_CHECK_IMMEDIATELY, rba_DiagLib_AttributeRef=Dem_Cfg_Dtc/Severity
              DemDTC_0D01__Nv_Storage: rba_DiagLib_Value=TRUE, rba_DiagLib_AttributeRef=Dem_Cfg_Dtc/Nv_Storage
              DemDTC_0D01__Func_Unit: rba_DiagLib_Value=0x00u, rba_DiagLib_AttributeRef=Dem_Cfg_Dtc/Func_Unit
              DemDTC_0D01__DtcCode_Is_Index: rba_DiagLib_Value=FALSE, rba_DiagLib_AttributeRef=Dem_Cfg_Dtc/DtcCode_Is_Index
              DemDTC_0D01__Obd_DtcCode: rba_DiagLib_Value=0x00u, rba_DiagLib_AttributeRef=Dem_Cfg_Dtc/Obd_DtcCode
              DemDTC_0D01__DtcCode: rba_DiagLib_Value=0xD0101u, rba_DiagLib_AttributeRef=Dem_Cfg_Dtc/DtcCode
          DemDTC_0D02
          DemDTC_0D02
            7 x rba_DiagLib_AttributeValue:
              DemDTC_0D02__Kind: rba_DiagLib_Value=DEM_DTC_KIND_ALL_DTCS, rba_DiagLib_AttributeRef=Dem_Cfg_Dtc/Kind
              DemDTC_0D02__Severity: rba_DiagLib_Value=DEM_SEVERITY_CHECK_IMMEDIATELY, rba_DiagLib_AttributeRef=Dem_Cfg_Dtc/Severity
              DemDTC_0D02__Nv_Storage: rba_DiagLib_Value=TRUE, rba_DiagLib_AttributeRef=Dem_Cfg_Dtc/Nv_Storage
              DemDTC_0D02__Func_Unit: rba_DiagLib_Value=0x00u, rba_DiagLib_AttributeRef=Dem_Cfg_Dtc/Func_Unit
              DemDTC_0D02__DtcCode_Is_Index: rba_DiagLib_Value=FALSE, rba_DiagLib_AttributeRef=Dem_Cfg_Dtc/DtcCode_Is_Index
              DemDTC_0D02__Obd_DtcCode: rba_DiagLib_Value=0x00u, rba_DiagLib_AttributeRef=Dem_Cfg_Dtc/Obd_DtcCode
              DemDTC_0D02__DtcCode: rba_DiagLib_Value=0xD0201u, rba_DiagLib_AttributeRef=Dem_Cfg_Dtc/DtcCode
          DemDTC_0D03
          DemDTC_0D03
            7 x rba_DiagLib_AttributeValue:
              DemDTC_0D03__Kind: rba_DiagLib_Value=DEM_DTC_KIND_ALL_DTCS, rba_DiagLib_AttributeRef=Dem_Cfg_Dtc/Kind
              DemDTC_0D03__Severity: rba_DiagLib_Value=DEM_SEVERITY_CHECK_IMMEDIATELY, rba_DiagLib_AttributeRef=Dem_Cfg_Dtc/Severity
              DemDTC_0D03__Nv_Storage: rba_DiagLib_Value=TRUE, rba_DiagLib_AttributeRef=Dem_Cfg_Dtc/Nv_Storage
              DemDTC_0D03__Func_Unit: rba_DiagLib_Value=0x00u, rba_DiagLib_AttributeRef=Dem_Cfg_Dtc/Func_Unit
              DemDTC_0D03__DtcCode_Is_Index: rba_DiagLib_Value=FALSE, rba_DiagLib_AttributeRef=Dem_Cfg_Dtc/DtcCode_Is_Index
              DemDTC_0D03__Obd_DtcCode: rba_DiagLib_Value=0x00u, rba_DiagLib_AttributeRef=Dem_Cfg_Dtc/Obd_DtcCode
              DemDTC_0D03__DtcCode: rba_DiagLib_Value=0xD0347u, rba_DiagLib_AttributeRef=Dem_Cfg_Dtc/DtcCode
          DemDTC_0D04
          DemDTC_0D04
            7 x rba_DiagLib_AttributeValue:
              DemDTC_0D04__Kind: rba_DiagLib_Value=DEM_DTC_KIND_ALL_DTCS, rba_DiagLib_AttributeRef=Dem_Cfg_Dtc/Kind
              DemDTC_0D04__Severity: rba_DiagLib_Value=DEM_SEVERITY_CHECK_IMMEDIATELY, rba_DiagLib_AttributeRef=Dem_Cfg_Dtc/Severity
              DemDTC_0D04__Nv_Storage: rba_DiagLib_Value=TRUE, rba_DiagLib_AttributeRef=Dem_Cfg_Dtc/Nv_Storage
              DemDTC_0D04__Func_Unit: rba_DiagLib_Value=0x00u, rba_DiagLib_AttributeRef=Dem_Cfg_Dtc/Func_Unit
              DemDTC_0D04__DtcCode_Is_Index: rba_DiagLib_Value=FALSE, rba_DiagLib_AttributeRef=Dem_Cfg_Dtc/DtcCode_Is_Index
              DemDTC_0D04__Obd_DtcCode: rba_DiagLib_Value=0x00u, rba_DiagLib_AttributeRef=Dem_Cfg_Dtc/Obd_DtcCode
              DemDTC_0D04__DtcCode: rba_DiagLib_Value=0xD0488u, rba_DiagLib_AttributeRef=Dem_Cfg_Dtc/DtcCode
          DemDTC_0D05
          DemDTC_0D05
            7 x rba_DiagLib_AttributeValue:
              DemDTC_0D05__Kind: rba_DiagLib_Value=DEM_DTC_KIND_ALL_DTCS, rba_DiagLib_AttributeRef=Dem_Cfg_Dtc/Kind
              DemDTC_0D05__Severity: rba_DiagLib_Value=DEM_SEVERITY_CHECK_IMMEDIATELY, rba_DiagLib_AttributeRef=Dem_Cfg_Dtc/Severity
              DemDTC_0D05__Nv_Storage: rba_DiagLib_Value=TRUE, rba_DiagLib_AttributeRef=Dem_Cfg_Dtc/Nv_Storage
              DemDTC_0D05__Func_Unit: rba_DiagLib_Value=0x00u, rba_DiagLib_AttributeRef=Dem_Cfg_Dtc/Func_Unit
              DemDTC_0D05__DtcCode_Is_Index: rba_DiagLib_Value=FALSE, rba_DiagLib_AttributeRef=Dem_Cfg_Dtc/DtcCode_Is_Index
              DemDTC_0D05__Obd_DtcCode: rba_DiagLib_Value=0x00u, rba_DiagLib_AttributeRef=Dem_Cfg_Dtc/Obd_DtcCode
              DemDTC_0D05__DtcCode: rba_DiagLib_Value=0xD0588u, rba_DiagLib_AttributeRef=Dem_Cfg_Dtc/DtcCode
          DemDTC_0D06
          DemDTC_0D06
            7 x rba_DiagLib_AttributeValue:
              DemDTC_0D06__Kind: rba_DiagLib_Value=DEM_DTC_KIND_ALL_DTCS, rba_DiagLib_AttributeRef=Dem_Cfg_Dtc/Kind
              DemDTC_0D06__Severity: rba_DiagLib_Value=DEM_SEVERITY_NO_SEVERITY, rba_DiagLib_AttributeRef=Dem_Cfg_Dtc/Severity
              DemDTC_0D06__Nv_Storage: rba_DiagLib_Value=TRUE, rba_DiagLib_AttributeRef=Dem_Cfg_Dtc/Nv_Storage
              DemDTC_0D06__Func_Unit: rba_DiagLib_Value=0x00u, rba_DiagLib_AttributeRef=Dem_Cfg_Dtc/Func_Unit
              DemDTC_0D06__DtcCode_Is_Index: rba_DiagLib_Value=FALSE, rba_DiagLib_AttributeRef=Dem_Cfg_Dtc/DtcCode_Is_Index
              DemDTC_0D06__Obd_DtcCode: rba_DiagLib_Value=0x00u, rba_DiagLib_AttributeRef=Dem_Cfg_Dtc/Obd_DtcCode
              DemDTC_0D06__DtcCode: rba_DiagLib_Value=0xD060Bu, rba_DiagLib_AttributeRef=Dem_Cfg_Dtc/DtcCode
        data1 (rba_DiagLib_DataContainer): rba_DiagLib_TotalBitSize=32, rba_DiagLib_OccupiedBitSize=0
        DtcCode (rba_DiagLib_Attribute): rba_DiagLib_DataContainerRef=Dem_Cfg_Dtc/data1
        data1 (rba_DiagLib_DataContainer):
          rba_DiagLib_OccupiedBitSize = 24
          rba_DiagLib_OccupiedBitSize = {26..29}
        data2 (rba_DiagLib_DataContainer): rba_DiagLib_TotalBitSize=8, rba_DiagLib_OccupiedBitSize=0
        Severity (rba_DiagLib_Attribute): rba_DiagLib_DataContainerRef=Dem_Cfg_Dtc/data2
        data2 (rba_DiagLib_DataContainer): rba_DiagLib_OccupiedBitSize=8
        4 x rba_DiagLib_Attribute, all with rba_DiagLib_DataContainerRef=Dem_Cfg_Dtc/data1:
          Kind
          DtcCode_Is_Index
          Func_Unit
          Nv_Storage
      Dem_Cfg_OperationCycle: rba_DiagLib_IndexType=Dem_OperationCycleIdType
      Dem_Cfg_OperationCycle: rba_DiagLib_RangeCheckMacro=DEM_ASSERT_RANGECHECK
        DependentCycleMask (rba_DiagLib_Attribute): rba_DiagLib_BitSize=1, rba_DiagLib_Type=Dem_OperationCycleList, rba_DiagLib_RequiresAtomicAccess=false
        IsAllowedToBeStartedDirectly (rba_DiagLib_Attribute): rba_DiagLib_BitSize=1, rba_DiagLib_Type=boolean, rba_DiagLib_RequiresAtomicAccess=false
        DemOperationCycle_Power (rba_DiagLib_DataItem)
        DemOperationCycle_Power (rba_DiagLib_DataItem)
          DemOperationCycle_Power__DependentCycleMask (rba_DiagLib_AttributeValue): rba_DiagLib_Value=0x0, rba_DiagLib_AttributeRef=DependentCycleMask
          DemOperationCycle_Power__IsAllowedToBeStartedDirectly (rba_DiagLib_AttributeValue): rba_DiagLib_Value=TRUE, rba_DiagLib_AttributeRef=IsAllowedToBeStartedDirectly
      Dem_Cfg_ClientParams: rba_DiagLib_IndexType=uint8
      Dem_Cfg_ClientParams: rba_DiagLib_RangeCheckMacro=DEM_ASSERT_RANGECHECK, rba_DiagLib_InvalidIndex=true
        3 x rba_DiagLib_Attribute, all with rba_DiagLib_BitSize=8, rba_DiagLib_RequiresAtomicAccess=false:
          DTCStatusAvailabilityMask: rba_DiagLib_Type=Dem_UdsStatusByteType
          DTCTranslationFormat: rba_DiagLib_Type=Dem_DTCTranslationFormatType
          DTCSeverityAvailabilityMask: rba_DiagLib_Type=uint8
        DemClient (rba_DiagLib_DataItem)
        DemClient (rba_DiagLib_DataItem)
          3 x rba_DiagLib_AttributeValue:
            DemClient__DTCStatusAvailabilityMask: rba_DiagLib_Value=0xFF, rba_DiagLib_AttributeRef=Dem_Cfg_ClientParams/DTCStatusAvailabilityMask
            DemClient__DTCTranslationFormat: rba_DiagLib_Value=DEM_DTC_TRANSLATION_ISO14229_1, rba_DiagLib_AttributeRef=Dem_Cfg_ClientParams/DTCTranslationFormat
            DemClient__DTCSeverityAvailabilityMask: rba_DiagLib_Value=DEM_CFG_DTCSEVERITY_AVAILABILITY_MASK_CLIENTID_1, rba_DiagLib_AttributeRef=Dem_Cfg_ClientParams/DTCSeverityAvailabilityMask
        data1 (rba_DiagLib_DataContainer): rba_DiagLib_TotalBitSize=8, rba_DiagLib_OccupiedBitSize=0
        DTCSeverityAvailabilityMask (rba_DiagLib_Attribute): rba_DiagLib_DataContainerRef=Dem_Cfg_ClientParams/data1
        data1 (rba_DiagLib_DataContainer): rba_DiagLib_OccupiedBitSize=8
        data2 (rba_DiagLib_DataContainer): rba_DiagLib_TotalBitSize=8, rba_DiagLib_OccupiedBitSize=0
        DTCTranslationFormat (rba_DiagLib_Attribute): rba_DiagLib_DataContainerRef=Dem_Cfg_ClientParams/data2
        data2 (rba_DiagLib_DataContainer): rba_DiagLib_OccupiedBitSize=8
        data3 (rba_DiagLib_DataContainer): rba_DiagLib_TotalBitSize=8, rba_DiagLib_OccupiedBitSize=0
        DTCStatusAvailabilityMask (rba_DiagLib_Attribute): rba_DiagLib_DataContainerRef=Dem_Cfg_ClientParams/data3
        data3 (rba_DiagLib_DataContainer): rba_DiagLib_OccupiedBitSize=8
      Dem_EvtParam: rba_DiagLib_IndexType=Dem_EventIdType
      Dem_EvtParam: rba_DiagLib_RangeCheckMacro=DEM_ASSERT_RANGECHECK, rba_DiagLib_AssertIsLockedMacro=DEM_ASSERT_ISLOCKED, rba_DiagLib_InvalidIndex=true, rba_DiagLib_InvalidIndex=true
        42 x rba_DiagLib_Attribute:
          DebounceBehavior: rba_DiagLib_BitSize=1, rba_DiagLib_Type=uint8, rba_DiagLib_RequiresAtomicAccess=false
          IsRecoverable: rba_DiagLib_BitSize=1, rba_DiagLib_Type=boolean, rba_DiagLib_RequiresAtomicAccess=false
          StoreTestFailedToNextOC: rba_DiagLib_BitSize=1, rba_DiagLib_Type=boolean, rba_DiagLib_RequiresAtomicAccess=false
          RequestsWarningIndicator: rba_DiagLib_BitSize=1, rba_DiagLib_Type=boolean, rba_DiagLib_RequiresAtomicAccess=false
          Category: rba_DiagLib_BitSize=1, rba_DiagLib_Type=Dem_EventCategoryType, rba_DiagLib_RequiresAtomicAccess=false
          IsEventDestPrimary: rba_DiagLib_BitSize=1, rba_DiagLib_Type=boolean, rba_DiagLib_RequiresAtomicAccess=false
          IsEventDestSecondary: rba_DiagLib_BitSize=1, rba_DiagLib_Type=boolean, rba_DiagLib_RequiresAtomicAccess=false
          IsEventDestMirror: rba_DiagLib_BitSize=1, rba_DiagLib_Type=boolean, rba_DiagLib_RequiresAtomicAccess=false
          AgingAllowed: rba_DiagLib_BitSize=1, rba_DiagLib_Type=boolean, rba_DiagLib_RequiresAtomicAccess=false
          IsGlobalFDCCallbackConfigured: rba_DiagLib_BitSize=1, rba_DiagLib_Type=boolean, rba_DiagLib_RequiresAtomicAccess=false
          TriggersDataChangedCallback: rba_DiagLib_BitSize=1, rba_DiagLib_Type=boolean, rba_DiagLib_RequiresAtomicAccess=false
          Significance: rba_DiagLib_BitSize=1, rba_DiagLib_Type=uint8, rba_DiagLib_RequiresAtomicAccess=false
          OperationCycleID: rba_DiagLib_BitSize=1, rba_DiagLib_Type=uint8, rba_DiagLib_RequiresAtomicAccess=false
          AgingCycleID: rba_DiagLib_BitSize=1, rba_DiagLib_Type=uint8, rba_DiagLib_RequiresAtomicAccess=false
          FailureCycleID: rba_DiagLib_BitSize=1, rba_DiagLib_Type=uint8, rba_DiagLib_RequiresAtomicAccess=false
          InitialSuppressionStatus: rba_DiagLib_BitSize=1, rba_DiagLib_Type=boolean, rba_DiagLib_RequiresAtomicAccess=false
          DebounceMethodIndex: rba_DiagLib_BitSize=1, rba_DiagLib_Type=uint8, rba_DiagLib_RequiresAtomicAccess=false
          DebounceParamSettingIndex: rba_DiagLib_BitSize=3, rba_DiagLib_Type=uint16, rba_DiagLib_RequiresAtomicAccess=false
          BufferTimeSFB: rba_DiagLib_BitSize=1, rba_DiagLib_Type=uint8, rba_DiagLib_RequiresAtomicAccess=false
          AgingThreshold: rba_DiagLib_BitSize=8, rba_DiagLib_Type=uint8, rba_DiagLib_RequiresAtomicAccess=false
          AgingThresholdForTFSLC: rba_DiagLib_BitSize=1, rba_DiagLib_Type=uint8, rba_DiagLib_RequiresAtomicAccess=false
          FailureConfirmationThreshold: rba_DiagLib_BitSize=1, rba_DiagLib_Type=uint8, rba_DiagLib_RequiresAtomicAccess=false
          EventPriority: rba_DiagLib_BitSize=3, rba_DiagLib_Type=uint8, rba_DiagLib_RequiresAtomicAccess=false
          MaxNumberFreezeFrameRecords: rba_DiagLib_BitSize=3, rba_DiagLib_Type=uint8, rba_DiagLib_RequiresAtomicAccess=false
          StorageConditions: rba_DiagLib_BitSize=1, rba_DiagLib_Type=Dem_StoCoList, rba_DiagLib_RequiresAtomicAccess=false
          EnableConditions: rba_DiagLib_BitSize=1, rba_DiagLib_Type=Dem_EnCoList, rba_DiagLib_RequiresAtomicAccess=false
          CallbackEventStatusChangedIndex: rba_DiagLib_BitSize=1, rba_DiagLib_Type=uint8, rba_DiagLib_RequiresAtomicAccess=false
          CallbackClearAllowed: rba_DiagLib_BitSize=32, rba_DiagLib_Type=Dem_EvtClearAllowedFncType, rba_DiagLib_RequiresAtomicAccess=false
          ClearAllowedBehavior: rba_DiagLib_BitSize=1, rba_DiagLib_Type=uint8, rba_DiagLib_RequiresAtomicAccess=false
          IsFFPrestorageSupported: rba_DiagLib_BitSize=1, rba_DiagLib_Type=boolean, rba_DiagLib_RequiresAtomicAccess=false
          IsEventOBDRelevant: rba_DiagLib_BitSize=1, rba_DiagLib_Type=boolean, rba_DiagLib_RequiresAtomicAccess=false
          StoreTestFailedToNextOC: rba_DiagLib_ReturnValueIfDisabled=TRUE
          RequestsWarningIndicator: rba_DiagLib_ReturnValueIfDisabled=FALSE
          IsGlobalFDCCallbackConfigured: rba_DiagLib_ReturnValueIfDisabled=FALSE, rba_DiagLib_ReturnValueIfDisabled=FALSE
          TriggersDataChangedCallback: rba_DiagLib_ReturnValueIfDisabled=FALSE, rba_DiagLib_ReturnValueIfDisabled=FALSE
          Category: rba_DiagLib_ReturnValueIfDisabled=0
          BufferTimeSFB: rba_DiagLib_ReturnValueIfDisabled=0
          CallbackEventStatusChangedIndex: rba_DiagLib_ReturnValueIfDisabled=0u
          CallbackClearAllowed: rba_DiagLib_ReturnValueIfDisabled=NULL_PTR
          ClearAllowedBehavior: rba_DiagLib_ReturnValueIfDisabled=DEM_NO_STATUS_BYTE_CHANGE
          StorageConditions: rba_DiagLib_ReturnValueIfDisabled=0
          EnableConditions: rba_DiagLib_ReturnValueIfDisabled=0
        14 x rba_DiagLib_DataItem:
          DemEventParameter_0D01_SWC
          DemEventParameter_0D01_SWC
            31 x rba_DiagLib_AttributeValue:
              DemEventParameter_0D01_SWC__DebounceBehavior: rba_DiagLib_Value=DEM_DEBOUNCE_FREEZE, rba_DiagLib_AttributeRef=Dem_EvtParam/DebounceBehavior
              DemEventParameter_0D01_SWC__IsRecoverable: rba_DiagLib_Value=DEM_RECOV, rba_DiagLib_AttributeRef=Dem_EvtParam/IsRecoverable
              DemEventParameter_0D01_SWC__StoreTestFailedToNextOC: rba_DiagLib_Value=TRUE, rba_DiagLib_AttributeRef=Dem_EvtParam/StoreTestFailedToNextOC
              DemEventParameter_0D01_SWC__RequestsWarningIndicator: rba_DiagLib_Value=0u, rba_DiagLib_AttributeRef=Dem_EvtParam/RequestsWarningIndicator
              DemEventParameter_0D01_SWC__Category: rba_DiagLib_Value=DemConf_DemEventCategory_INVALIDCATEGORY, rba_DiagLib_AttributeRef=Dem_EvtParam/Category
              DemEventParameter_0D01_SWC__IsEventDestPrimary: rba_DiagLib_Value=TRUE, rba_DiagLib_AttributeRef=Dem_EvtParam/IsEventDestPrimary
              DemEventParameter_0D01_SWC__IsEventDestSecondary: rba_DiagLib_Value=FALSE, rba_DiagLib_AttributeRef=Dem_EvtParam/IsEventDestSecondary
              DemEventParameter_0D01_SWC__IsEventDestMirror: rba_DiagLib_Value=TRUE, rba_DiagLib_AttributeRef=Dem_EvtParam/IsEventDestMirror
              DemEventParameter_0D01_SWC__AgingAllowed: rba_DiagLib_Value=1u, rba_DiagLib_AttributeRef=Dem_EvtParam/AgingAllowed
              DemEventParameter_0D01_SWC__IsGlobalFDCCallbackConfigured: rba_DiagLib_Value=FALSE, rba_DiagLib_AttributeRef=Dem_EvtParam/IsGlobalFDCCallbackConfigured
              DemEventParameter_0D01_SWC__TriggersDataChangedCallback: rba_DiagLib_Value=FALSE, rba_DiagLib_AttributeRef=Dem_EvtParam/TriggersDataChangedCallback
              DemEventParameter_0D01_SWC__Significance: rba_DiagLib_Value=1u, rba_DiagLib_AttributeRef=Dem_EvtParam/Significance
              DemEventParameter_0D01_SWC__OperationCycleID: rba_DiagLib_Value=DemConf_DemOperationCycle_DemOperationCycle_Power, rba_DiagLib_AttributeRef=Dem_EvtParam/OperationCycleID
              DemEventParameter_0D01_SWC__AgingCycleID: rba_DiagLib_Value=DemConf_DemOperationCycle_DemOperationCycle_Power, rba_DiagLib_AttributeRef=Dem_EvtParam/AgingCycleID
              DemEventParameter_0D01_SWC__FailureCycleID: rba_DiagLib_Value=DemConf_DemOperationCycle_DemOperationCycle_Power, rba_DiagLib_AttributeRef=Dem_EvtParam/FailureCycleID
              DemEventParameter_0D01_SWC__InitialSuppressionStatus: rba_DiagLib_Value=0u, rba_DiagLib_AttributeRef=Dem_EvtParam/InitialSuppressionStatus
              DemEventParameter_0D01_SWC__DebounceMethodIndex: rba_DiagLib_Value=DEM_DEBMETH_IDX_ARCTRBASECLASS, rba_DiagLib_AttributeRef=Dem_EvtParam/DebounceMethodIndex
              DemEventParameter_0D01_SWC__DebounceParamSettingIndex: rba_DiagLib_Value=DEM_DEBPARAM_IDX_DEMEVENTPARAMETER_0D01_SWC, rba_DiagLib_AttributeRef=Dem_EvtParam/DebounceParamSettingIndex
              DemEventParameter_0D01_SWC__BufferTimeSFB: rba_DiagLib_Value=0u, rba_DiagLib_AttributeRef=Dem_EvtParam/BufferTimeSFB
              DemEventParameter_0D01_SWC__AgingThreshold: rba_DiagLib_Value=40u, rba_DiagLib_AttributeRef=Dem_EvtParam/AgingThreshold
              DemEventParameter_0D01_SWC__AgingThresholdForTFSLC: rba_DiagLib_Value=0u, rba_DiagLib_AttributeRef=Dem_EvtParam/AgingThresholdForTFSLC
              DemEventParameter_0D01_SWC__FailureConfirmationThreshold: rba_DiagLib_Value=1u, rba_DiagLib_AttributeRef=Dem_EvtParam/FailureConfirmationThreshold
              DemEventParameter_0D01_SWC__EventPriority: rba_DiagLib_Value=2u, rba_DiagLib_AttributeRef=Dem_EvtParam/EventPriority
              DemEventParameter_0D01_SWC__MaxNumberFreezeFrameRecords: rba_DiagLib_Value=5u, rba_DiagLib_AttributeRef=Dem_EvtParam/MaxNumberFreezeFrameRecords
              DemEventParameter_0D01_SWC__StorageConditions: rba_DiagLib_Value=DEM_STOCO_DemEventParameter_0D01_SWC, rba_DiagLib_AttributeRef=Dem_EvtParam/StorageConditions
              DemEventParameter_0D01_SWC__EnableConditions: rba_DiagLib_Value=DEM_ENCO_DemEventParameter_0D01_SWC, rba_DiagLib_AttributeRef=Dem_EvtParam/EnableConditions
              DemEventParameter_0D01_SWC__CallbackEventStatusChangedIndex: rba_DiagLib_Value=0u, rba_DiagLib_AttributeRef=Dem_EvtParam/CallbackEventStatusChangedIndex
              DemEventParameter_0D01_SWC__CallbackClearAllowed: rba_DiagLib_Value=NULL_PTR, rba_DiagLib_AttributeRef=Dem_EvtParam/CallbackClearAllowed
              DemEventParameter_0D01_SWC__ClearAllowedBehavior: rba_DiagLib_Value=DEM_NO_STATUS_BYTE_CHANGE, rba_DiagLib_AttributeRef=Dem_EvtParam/ClearAllowedBehavior
              DemEventParameter_0D01_SWC__IsFFPrestorageSupported: rba_DiagLib_Value=FALSE, rba_DiagLib_AttributeRef=Dem_EvtParam/IsFFPrestorageSupported
              DemEventParameter_0D01_SWC__IsEventOBDRelevant: rba_DiagLib_Value=0u, rba_DiagLib_AttributeRef=Dem_EvtParam/IsEventOBDRelevant
          DemEventParameter_0D02_SWC
          DemEventParameter_0D02_SWC
            31 x rba_DiagLib_AttributeValue:
              DemEventParameter_0D02_SWC__DebounceBehavior: rba_DiagLib_Value=DEM_DEBOUNCE_FREEZE, rba_DiagLib_AttributeRef=Dem_EvtParam/DebounceBehavior
              DemEventParameter_0D02_SWC__IsRecoverable: rba_DiagLib_Value=DEM_RECOV, rba_DiagLib_AttributeRef=Dem_EvtParam/IsRecoverable
              DemEventParameter_0D02_SWC__StoreTestFailedToNextOC: rba_DiagLib_Value=TRUE, rba_DiagLib_AttributeRef=Dem_EvtParam/StoreTestFailedToNextOC
              DemEventParameter_0D02_SWC__RequestsWarningIndicator: rba_DiagLib_Value=0u, rba_DiagLib_AttributeRef=Dem_EvtParam/RequestsWarningIndicator
              DemEventParameter_0D02_SWC__Category: rba_DiagLib_Value=DemConf_DemEventCategory_INVALIDCATEGORY, rba_DiagLib_AttributeRef=Dem_EvtParam/Category
              DemEventParameter_0D02_SWC__IsEventDestPrimary: rba_DiagLib_Value=TRUE, rba_DiagLib_AttributeRef=Dem_EvtParam/IsEventDestPrimary
              DemEventParameter_0D02_SWC__IsEventDestSecondary: rba_DiagLib_Value=FALSE, rba_DiagLib_AttributeRef=Dem_EvtParam/IsEventDestSecondary
              DemEventParameter_0D02_SWC__IsEventDestMirror: rba_DiagLib_Value=FALSE, rba_DiagLib_AttributeRef=Dem_EvtParam/IsEventDestMirror
              DemEventParameter_0D02_SWC__AgingAllowed: rba_DiagLib_Value=1u, rba_DiagLib_AttributeRef=Dem_EvtParam/AgingAllowed
              DemEventParameter_0D02_SWC__IsGlobalFDCCallbackConfigured: rba_DiagLib_Value=FALSE, rba_DiagLib_AttributeRef=Dem_EvtParam/IsGlobalFDCCallbackConfigured
              DemEventParameter_0D02_SWC__TriggersDataChangedCallback: rba_DiagLib_Value=FALSE, rba_DiagLib_AttributeRef=Dem_EvtParam/TriggersDataChangedCallback
              DemEventParameter_0D02_SWC__Significance: rba_DiagLib_Value=1u, rba_DiagLib_AttributeRef=Dem_EvtParam/Significance
              DemEventParameter_0D02_SWC__OperationCycleID: rba_DiagLib_Value=DemConf_DemOperationCycle_DemOperationCycle_Power, rba_DiagLib_AttributeRef=Dem_EvtParam/OperationCycleID
              DemEventParameter_0D02_SWC__AgingCycleID: rba_DiagLib_Value=DemConf_DemOperationCycle_DemOperationCycle_Power, rba_DiagLib_AttributeRef=Dem_EvtParam/AgingCycleID
              DemEventParameter_0D02_SWC__FailureCycleID: rba_DiagLib_Value=DemConf_DemOperationCycle_DemOperationCycle_Power, rba_DiagLib_AttributeRef=Dem_EvtParam/FailureCycleID
              DemEventParameter_0D02_SWC__InitialSuppressionStatus: rba_DiagLib_Value=0u, rba_DiagLib_AttributeRef=Dem_EvtParam/InitialSuppressionStatus
              DemEventParameter_0D02_SWC__DebounceMethodIndex: rba_DiagLib_Value=DEM_DEBMETH_IDX_ARCTRBASECLASS, rba_DiagLib_AttributeRef=Dem_EvtParam/DebounceMethodIndex
              DemEventParameter_0D02_SWC__DebounceParamSettingIndex: rba_DiagLib_Value=DEM_DEBPARAM_IDX_DEMEVENTPARAMETER_0D02_SWC, rba_DiagLib_AttributeRef=Dem_EvtParam/DebounceParamSettingIndex
              DemEventParameter_0D02_SWC__BufferTimeSFB: rba_DiagLib_Value=0u, rba_DiagLib_AttributeRef=Dem_EvtParam/BufferTimeSFB
              DemEventParameter_0D02_SWC__AgingThreshold: rba_DiagLib_Value=40u, rba_DiagLib_AttributeRef=Dem_EvtParam/AgingThreshold
              DemEventParameter_0D02_SWC__AgingThresholdForTFSLC: rba_DiagLib_Value=0u, rba_DiagLib_AttributeRef=Dem_EvtParam/AgingThresholdForTFSLC
              DemEventParameter_0D02_SWC__FailureConfirmationThreshold: rba_DiagLib_Value=1u, rba_DiagLib_AttributeRef=Dem_EvtParam/FailureConfirmationThreshold
              DemEventParameter_0D02_SWC__EventPriority: rba_DiagLib_Value=3u, rba_DiagLib_AttributeRef=Dem_EvtParam/EventPriority
              DemEventParameter_0D02_SWC__MaxNumberFreezeFrameRecords: rba_DiagLib_Value=2u, rba_DiagLib_AttributeRef=Dem_EvtParam/MaxNumberFreezeFrameRecords
              DemEventParameter_0D02_SWC__StorageConditions: rba_DiagLib_Value=DEM_STOCO_DemEventParameter_0D02_SWC, rba_DiagLib_AttributeRef=Dem_EvtParam/StorageConditions
              DemEventParameter_0D02_SWC__EnableConditions: rba_DiagLib_Value=DEM_ENCO_DemEventParameter_0D02_SWC, rba_DiagLib_AttributeRef=Dem_EvtParam/EnableConditions
              DemEventParameter_0D02_SWC__CallbackEventStatusChangedIndex: rba_DiagLib_Value=0u, rba_DiagLib_AttributeRef=Dem_EvtParam/CallbackEventStatusChangedIndex
              DemEventParameter_0D02_SWC__CallbackClearAllowed: rba_DiagLib_Value=NULL_PTR, rba_DiagLib_AttributeRef=Dem_EvtParam/CallbackClearAllowed
              DemEventParameter_0D02_SWC__ClearAllowedBehavior: rba_DiagLib_Value=DEM_NO_STATUS_BYTE_CHANGE, rba_DiagLib_AttributeRef=Dem_EvtParam/ClearAllowedBehavior
              DemEventParameter_0D02_SWC__IsFFPrestorageSupported: rba_DiagLib_Value=FALSE, rba_DiagLib_AttributeRef=Dem_EvtParam/IsFFPrestorageSupported
              DemEventParameter_0D02_SWC__IsEventOBDRelevant: rba_DiagLib_Value=0u, rba_DiagLib_AttributeRef=Dem_EvtParam/IsEventOBDRelevant
          DemEventParameter_0D03_Wdg
          DemEventParameter_0D03_Wdg
            31 x rba_DiagLib_AttributeValue:
              DemEventParameter_0D03_Wdg__DebounceBehavior: rba_DiagLib_Value=DEM_DEBOUNCE_FREEZE, rba_DiagLib_AttributeRef=Dem_EvtParam/DebounceBehavior
              DemEventParameter_0D03_Wdg__IsRecoverable: rba_DiagLib_Value=DEM_RECOV, rba_DiagLib_AttributeRef=Dem_EvtParam/IsRecoverable
              DemEventParameter_0D03_Wdg__StoreTestFailedToNextOC: rba_DiagLib_Value=TRUE, rba_DiagLib_AttributeRef=Dem_EvtParam/StoreTestFailedToNextOC
              DemEventParameter_0D03_Wdg__RequestsWarningIndicator: rba_DiagLib_Value=0u, rba_DiagLib_AttributeRef=Dem_EvtParam/RequestsWarningIndicator
              DemEventParameter_0D03_Wdg__Category: rba_DiagLib_Value=DemConf_DemEventCategory_INVALIDCATEGORY, rba_DiagLib_AttributeRef=Dem_EvtParam/Category
              DemEventParameter_0D03_Wdg__IsEventDestPrimary: rba_DiagLib_Value=TRUE, rba_DiagLib_AttributeRef=Dem_EvtParam/IsEventDestPrimary
              DemEventParameter_0D03_Wdg__IsEventDestSecondary: rba_DiagLib_Value=FALSE, rba_DiagLib_AttributeRef=Dem_EvtParam/IsEventDestSecondary
              DemEventParameter_0D03_Wdg__IsEventDestMirror: rba_DiagLib_Value=FALSE, rba_DiagLib_AttributeRef=Dem_EvtParam/IsEventDestMirror
              DemEventParameter_0D03_Wdg__AgingAllowed: rba_DiagLib_Value=1u, rba_DiagLib_AttributeRef=Dem_EvtParam/AgingAllowed
              DemEventParameter_0D03_Wdg__IsGlobalFDCCallbackConfigured: rba_DiagLib_Value=FALSE, rba_DiagLib_AttributeRef=Dem_EvtParam/IsGlobalFDCCallbackConfigured
              DemEventParameter_0D03_Wdg__TriggersDataChangedCallback: rba_DiagLib_Value=FALSE, rba_DiagLib_AttributeRef=Dem_EvtParam/TriggersDataChangedCallback
              DemEventParameter_0D03_Wdg__Significance: rba_DiagLib_Value=1u, rba_DiagLib_AttributeRef=Dem_EvtParam/Significance
              DemEventParameter_0D03_Wdg__OperationCycleID: rba_DiagLib_Value=DemConf_DemOperationCycle_DemOperationCycle_Power, rba_DiagLib_AttributeRef=Dem_EvtParam/OperationCycleID
              DemEventParameter_0D03_Wdg__AgingCycleID: rba_DiagLib_Value=DemConf_DemOperationCycle_DemOperationCycle_Power, rba_DiagLib_AttributeRef=Dem_EvtParam/AgingCycleID
              DemEventParameter_0D03_Wdg__FailureCycleID: rba_DiagLib_Value=DemConf_DemOperationCycle_DemOperationCycle_Power, rba_DiagLib_AttributeRef=Dem_EvtParam/FailureCycleID
              DemEventParameter_0D03_Wdg__InitialSuppressionStatus: rba_DiagLib_Value=0u, rba_DiagLib_AttributeRef=Dem_EvtParam/InitialSuppressionStatus
              DemEventParameter_0D03_Wdg__DebounceMethodIndex: rba_DiagLib_Value=DEM_DEBMETH_IDX_ARCTRBASECLASS, rba_DiagLib_AttributeRef=Dem_EvtParam/DebounceMethodIndex
              DemEventParameter_0D03_Wdg__DebounceParamSettingIndex: rba_DiagLib_Value=DEM_DEBPARAM_IDX_DEMEVENTPARAMETER_0D03_WDG, rba_DiagLib_AttributeRef=Dem_EvtParam/DebounceParamSettingIndex
              DemEventParameter_0D03_Wdg__BufferTimeSFB: rba_DiagLib_Value=0u, rba_DiagLib_AttributeRef=Dem_EvtParam/BufferTimeSFB
              DemEventParameter_0D03_Wdg__AgingThreshold: rba_DiagLib_Value=40u, rba_DiagLib_AttributeRef=Dem_EvtParam/AgingThreshold
              DemEventParameter_0D03_Wdg__AgingThresholdForTFSLC: rba_DiagLib_Value=0u, rba_DiagLib_AttributeRef=Dem_EvtParam/AgingThresholdForTFSLC
              DemEventParameter_0D03_Wdg__FailureConfirmationThreshold: rba_DiagLib_Value=1u, rba_DiagLib_AttributeRef=Dem_EvtParam/FailureConfirmationThreshold
              DemEventParameter_0D03_Wdg__EventPriority: rba_DiagLib_Value=4u, rba_DiagLib_AttributeRef=Dem_EvtParam/EventPriority
              DemEventParameter_0D03_Wdg__MaxNumberFreezeFrameRecords: rba_DiagLib_Value=2u, rba_DiagLib_AttributeRef=Dem_EvtParam/MaxNumberFreezeFrameRecords
              DemEventParameter_0D03_Wdg__StorageConditions: rba_DiagLib_Value=DEM_STOCO_DemEventParameter_0D03_Wdg, rba_DiagLib_AttributeRef=Dem_EvtParam/StorageConditions
              DemEventParameter_0D03_Wdg__EnableConditions: rba_DiagLib_Value=DEM_ENCO_DemEventParameter_0D03_Wdg, rba_DiagLib_AttributeRef=Dem_EvtParam/EnableConditions
              DemEventParameter_0D03_Wdg__CallbackEventStatusChangedIndex: rba_DiagLib_Value=0u, rba_DiagLib_AttributeRef=Dem_EvtParam/CallbackEventStatusChangedIndex
              DemEventParameter_0D03_Wdg__CallbackClearAllowed: rba_DiagLib_Value=NULL_PTR, rba_DiagLib_AttributeRef=Dem_EvtParam/CallbackClearAllowed
              DemEventParameter_0D03_Wdg__ClearAllowedBehavior: rba_DiagLib_Value=DEM_NO_STATUS_BYTE_CHANGE, rba_DiagLib_AttributeRef=Dem_EvtParam/ClearAllowedBehavior
              DemEventParameter_0D03_Wdg__IsFFPrestorageSupported: rba_DiagLib_Value=FALSE, rba_DiagLib_AttributeRef=Dem_EvtParam/IsFFPrestorageSupported
              DemEventParameter_0D03_Wdg__IsEventOBDRelevant: rba_DiagLib_Value=0u, rba_DiagLib_AttributeRef=Dem_EvtParam/IsEventOBDRelevant
          DemEventParameter_0D04_Busoff0
          DemEventParameter_0D04_Busoff0
            31 x rba_DiagLib_AttributeValue:
              DemEventParameter_0D04_Busoff0__DebounceBehavior: rba_DiagLib_Value=DEM_DEBOUNCE_FREEZE, rba_DiagLib_AttributeRef=Dem_EvtParam/DebounceBehavior
              DemEventParameter_0D04_Busoff0__IsRecoverable: rba_DiagLib_Value=DEM_RECOV, rba_DiagLib_AttributeRef=Dem_EvtParam/IsRecoverable
              DemEventParameter_0D04_Busoff0__StoreTestFailedToNextOC: rba_DiagLib_Value=TRUE, rba_DiagLib_AttributeRef=Dem_EvtParam/StoreTestFailedToNextOC
              DemEventParameter_0D04_Busoff0__RequestsWarningIndicator: rba_DiagLib_Value=0u, rba_DiagLib_AttributeRef=Dem_EvtParam/RequestsWarningIndicator
              DemEventParameter_0D04_Busoff0__Category: rba_DiagLib_Value=DemConf_DemEventCategory_INVALIDCATEGORY, rba_DiagLib_AttributeRef=Dem_EvtParam/Category
              DemEventParameter_0D04_Busoff0__IsEventDestPrimary: rba_DiagLib_Value=TRUE, rba_DiagLib_AttributeRef=Dem_EvtParam/IsEventDestPrimary
              DemEventParameter_0D04_Busoff0__IsEventDestSecondary: rba_DiagLib_Value=FALSE, rba_DiagLib_AttributeRef=Dem_EvtParam/IsEventDestSecondary
              DemEventParameter_0D04_Busoff0__IsEventDestMirror: rba_DiagLib_Value=FALSE, rba_DiagLib_AttributeRef=Dem_EvtParam/IsEventDestMirror
              DemEventParameter_0D04_Busoff0__AgingAllowed: rba_DiagLib_Value=1u, rba_DiagLib_AttributeRef=Dem_EvtParam/AgingAllowed
              DemEventParameter_0D04_Busoff0__IsGlobalFDCCallbackConfigured: rba_DiagLib_Value=FALSE, rba_DiagLib_AttributeRef=Dem_EvtParam/IsGlobalFDCCallbackConfigured
              DemEventParameter_0D04_Busoff0__TriggersDataChangedCallback: rba_DiagLib_Value=FALSE, rba_DiagLib_AttributeRef=Dem_EvtParam/TriggersDataChangedCallback
              DemEventParameter_0D04_Busoff0__Significance: rba_DiagLib_Value=1u, rba_DiagLib_AttributeRef=Dem_EvtParam/Significance
              DemEventParameter_0D04_Busoff0__OperationCycleID: rba_DiagLib_Value=DemConf_DemOperationCycle_DemOperationCycle_Power, rba_DiagLib_AttributeRef=Dem_EvtParam/OperationCycleID
              DemEventParameter_0D04_Busoff0__AgingCycleID: rba_DiagLib_Value=DemConf_DemOperationCycle_DemOperationCycle_Power, rba_DiagLib_AttributeRef=Dem_EvtParam/AgingCycleID
              DemEventParameter_0D04_Busoff0__FailureCycleID: rba_DiagLib_Value=DemConf_DemOperationCycle_DemOperationCycle_Power, rba_DiagLib_AttributeRef=Dem_EvtParam/FailureCycleID
              DemEventParameter_0D04_Busoff0__InitialSuppressionStatus: rba_DiagLib_Value=0u, rba_DiagLib_AttributeRef=Dem_EvtParam/InitialSuppressionStatus
              DemEventParameter_0D04_Busoff0__DebounceMethodIndex: rba_DiagLib_Value=DEM_DEBMETH_IDX_ARCTRBASECLASS, rba_DiagLib_AttributeRef=Dem_EvtParam/DebounceMethodIndex
              DemEventParameter_0D04_Busoff0__DebounceParamSettingIndex: rba_DiagLib_Value=DEM_DEBPARAM_IDX_DEMEVENTPARAMETER_0D04_BUSOFF0, rba_DiagLib_AttributeRef=Dem_EvtParam/DebounceParamSettingIndex
              DemEventParameter_0D04_Busoff0__BufferTimeSFB: rba_DiagLib_Value=0u, rba_DiagLib_AttributeRef=Dem_EvtParam/BufferTimeSFB
              DemEventParameter_0D04_Busoff0__AgingThreshold: rba_DiagLib_Value=40u, rba_DiagLib_AttributeRef=Dem_EvtParam/AgingThreshold
              DemEventParameter_0D04_Busoff0__AgingThresholdForTFSLC: rba_DiagLib_Value=0u, rba_DiagLib_AttributeRef=Dem_EvtParam/AgingThresholdForTFSLC
              DemEventParameter_0D04_Busoff0__FailureConfirmationThreshold: rba_DiagLib_Value=1u, rba_DiagLib_AttributeRef=Dem_EvtParam/FailureConfirmationThreshold
              DemEventParameter_0D04_Busoff0__EventPriority: rba_DiagLib_Value=5u, rba_DiagLib_AttributeRef=Dem_EvtParam/EventPriority
              DemEventParameter_0D04_Busoff0__MaxNumberFreezeFrameRecords: rba_DiagLib_Value=2u, rba_DiagLib_AttributeRef=Dem_EvtParam/MaxNumberFreezeFrameRecords
              DemEventParameter_0D04_Busoff0__StorageConditions: rba_DiagLib_Value=DEM_STOCO_DemEventParameter_0D04_Busoff0, rba_DiagLib_AttributeRef=Dem_EvtParam/StorageConditions
              DemEventParameter_0D04_Busoff0__EnableConditions: rba_DiagLib_Value=DEM_ENCO_DemEventParameter_0D04_Busoff0, rba_DiagLib_AttributeRef=Dem_EvtParam/EnableConditions
              DemEventParameter_0D04_Busoff0__CallbackEventStatusChangedIndex: rba_DiagLib_Value=0u, rba_DiagLib_AttributeRef=Dem_EvtParam/CallbackEventStatusChangedIndex
              DemEventParameter_0D04_Busoff0__CallbackClearAllowed: rba_DiagLib_Value=NULL_PTR, rba_DiagLib_AttributeRef=Dem_EvtParam/CallbackClearAllowed
              DemEventParameter_0D04_Busoff0__ClearAllowedBehavior: rba_DiagLib_Value=DEM_NO_STATUS_BYTE_CHANGE, rba_DiagLib_AttributeRef=Dem_EvtParam/ClearAllowedBehavior
              DemEventParameter_0D04_Busoff0__IsFFPrestorageSupported: rba_DiagLib_Value=FALSE, rba_DiagLib_AttributeRef=Dem_EvtParam/IsFFPrestorageSupported
              DemEventParameter_0D04_Busoff0__IsEventOBDRelevant: rba_DiagLib_Value=0u, rba_DiagLib_AttributeRef=Dem_EvtParam/IsEventOBDRelevant
          DemEventParameter_0D05_Busoff1
          DemEventParameter_0D05_Busoff1
            31 x rba_DiagLib_AttributeValue:
              DemEventParameter_0D05_Busoff1__DebounceBehavior: rba_DiagLib_Value=DEM_DEBOUNCE_FREEZE, rba_DiagLib_AttributeRef=Dem_EvtParam/DebounceBehavior
              DemEventParameter_0D05_Busoff1__IsRecoverable: rba_DiagLib_Value=DEM_RECOV, rba_DiagLib_AttributeRef=Dem_EvtParam/IsRecoverable
              DemEventParameter_0D05_Busoff1__StoreTestFailedToNextOC: rba_DiagLib_Value=TRUE, rba_DiagLib_AttributeRef=Dem_EvtParam/StoreTestFailedToNextOC
              DemEventParameter_0D05_Busoff1__RequestsWarningIndicator: rba_DiagLib_Value=0u, rba_DiagLib_AttributeRef=Dem_EvtParam/RequestsWarningIndicator
              DemEventParameter_0D05_Busoff1__Category: rba_DiagLib_Value=DemConf_DemEventCategory_INVALIDCATEGORY, rba_DiagLib_AttributeRef=Dem_EvtParam/Category
              DemEventParameter_0D05_Busoff1__IsEventDestPrimary: rba_DiagLib_Value=TRUE, rba_DiagLib_AttributeRef=Dem_EvtParam/IsEventDestPrimary
              DemEventParameter_0D05_Busoff1__IsEventDestSecondary: rba_DiagLib_Value=FALSE, rba_DiagLib_AttributeRef=Dem_EvtParam/IsEventDestSecondary
              DemEventParameter_0D05_Busoff1__IsEventDestMirror: rba_DiagLib_Value=FALSE, rba_DiagLib_AttributeRef=Dem_EvtParam/IsEventDestMirror
              DemEventParameter_0D05_Busoff1__AgingAllowed: rba_DiagLib_Value=1u, rba_DiagLib_AttributeRef=Dem_EvtParam/AgingAllowed
              DemEventParameter_0D05_Busoff1__IsGlobalFDCCallbackConfigured: rba_DiagLib_Value=FALSE, rba_DiagLib_AttributeRef=Dem_EvtParam/IsGlobalFDCCallbackConfigured
              DemEventParameter_0D05_Busoff1__TriggersDataChangedCallback: rba_DiagLib_Value=FALSE, rba_DiagLib_AttributeRef=Dem_EvtParam/TriggersDataChangedCallback
              DemEventParameter_0D05_Busoff1__Significance: rba_DiagLib_Value=1u, rba_DiagLib_AttributeRef=Dem_EvtParam/Significance
              DemEventParameter_0D05_Busoff1__OperationCycleID: rba_DiagLib_Value=DemConf_DemOperationCycle_DemOperationCycle_Power, rba_DiagLib_AttributeRef=Dem_EvtParam/OperationCycleID
              DemEventParameter_0D05_Busoff1__AgingCycleID: rba_DiagLib_Value=DemConf_DemOperationCycle_DemOperationCycle_Power, rba_DiagLib_AttributeRef=Dem_EvtParam/AgingCycleID
              DemEventParameter_0D05_Busoff1__FailureCycleID: rba_DiagLib_Value=DemConf_DemOperationCycle_DemOperationCycle_Power, rba_DiagLib_AttributeRef=Dem_EvtParam/FailureCycleID
              DemEventParameter_0D05_Busoff1__InitialSuppressionStatus: rba_DiagLib_Value=0u, rba_DiagLib_AttributeRef=Dem_EvtParam/InitialSuppressionStatus
              DemEventParameter_0D05_Busoff1__DebounceMethodIndex: rba_DiagLib_Value=DEM_DEBMETH_IDX_ARCTRBASECLASS, rba_DiagLib_AttributeRef=Dem_EvtParam/DebounceMethodIndex
              DemEventParameter_0D05_Busoff1__DebounceParamSettingIndex: rba_DiagLib_Value=DEM_DEBPARAM_IDX_DEMEVENTPARAMETER_0D05_BUSOFF1, rba_DiagLib_AttributeRef=Dem_EvtParam/DebounceParamSettingIndex
              DemEventParameter_0D05_Busoff1__BufferTimeSFB: rba_DiagLib_Value=0u, rba_DiagLib_AttributeRef=Dem_EvtParam/BufferTimeSFB
              DemEventParameter_0D05_Busoff1__AgingThreshold: rba_DiagLib_Value=40u, rba_DiagLib_AttributeRef=Dem_EvtParam/AgingThreshold
              DemEventParameter_0D05_Busoff1__AgingThresholdForTFSLC: rba_DiagLib_Value=0u, rba_DiagLib_AttributeRef=Dem_EvtParam/AgingThresholdForTFSLC
              DemEventParameter_0D05_Busoff1__FailureConfirmationThreshold: rba_DiagLib_Value=1u, rba_DiagLib_AttributeRef=Dem_EvtParam/FailureConfirmationThreshold
              DemEventParameter_0D05_Busoff1__EventPriority: rba_DiagLib_Value=6u, rba_DiagLib_AttributeRef=Dem_EvtParam/EventPriority
              DemEventParameter_0D05_Busoff1__MaxNumberFreezeFrameRecords: rba_DiagLib_Value=2u, rba_DiagLib_AttributeRef=Dem_EvtParam/MaxNumberFreezeFrameRecords
              DemEventParameter_0D05_Busoff1__StorageConditions: rba_DiagLib_Value=DEM_STOCO_DemEventParameter_0D05_Busoff1, rba_DiagLib_AttributeRef=Dem_EvtParam/StorageConditions
              DemEventParameter_0D05_Busoff1__EnableConditions: rba_DiagLib_Value=DEM_ENCO_DemEventParameter_0D05_Busoff1, rba_DiagLib_AttributeRef=Dem_EvtParam/EnableConditions
              DemEventParameter_0D05_Busoff1__CallbackEventStatusChangedIndex: rba_DiagLib_Value=0u, rba_DiagLib_AttributeRef=Dem_EvtParam/CallbackEventStatusChangedIndex
              DemEventParameter_0D05_Busoff1__CallbackClearAllowed: rba_DiagLib_Value=NULL_PTR, rba_DiagLib_AttributeRef=Dem_EvtParam/CallbackClearAllowed
              DemEventParameter_0D05_Busoff1__ClearAllowedBehavior: rba_DiagLib_Value=DEM_NO_STATUS_BYTE_CHANGE, rba_DiagLib_AttributeRef=Dem_EvtParam/ClearAllowedBehavior
              DemEventParameter_0D05_Busoff1__IsFFPrestorageSupported: rba_DiagLib_Value=FALSE, rba_DiagLib_AttributeRef=Dem_EvtParam/IsFFPrestorageSupported
              DemEventParameter_0D05_Busoff1__IsEventOBDRelevant: rba_DiagLib_Value=0u, rba_DiagLib_AttributeRef=Dem_EvtParam/IsEventOBDRelevant
          DemEventParameter_0D06_Comb0
          DemEventParameter_0D06_Comb0
            31 x rba_DiagLib_AttributeValue:
              DemEventParameter_0D06_Comb0__DebounceBehavior: rba_DiagLib_Value=DEM_DEBOUNCE_FREEZE, rba_DiagLib_AttributeRef=Dem_EvtParam/DebounceBehavior
              DemEventParameter_0D06_Comb0__IsRecoverable: rba_DiagLib_Value=DEM_RECOV, rba_DiagLib_AttributeRef=Dem_EvtParam/IsRecoverable
              DemEventParameter_0D06_Comb0__StoreTestFailedToNextOC: rba_DiagLib_Value=TRUE, rba_DiagLib_AttributeRef=Dem_EvtParam/StoreTestFailedToNextOC
              DemEventParameter_0D06_Comb0__RequestsWarningIndicator: rba_DiagLib_Value=0u, rba_DiagLib_AttributeRef=Dem_EvtParam/RequestsWarningIndicator
              DemEventParameter_0D06_Comb0__Category: rba_DiagLib_Value=DemConf_DemEventCategory_INVALIDCATEGORY, rba_DiagLib_AttributeRef=Dem_EvtParam/Category
              DemEventParameter_0D06_Comb0__IsEventDestPrimary: rba_DiagLib_Value=TRUE, rba_DiagLib_AttributeRef=Dem_EvtParam/IsEventDestPrimary
              DemEventParameter_0D06_Comb0__IsEventDestSecondary: rba_DiagLib_Value=FALSE, rba_DiagLib_AttributeRef=Dem_EvtParam/IsEventDestSecondary
              DemEventParameter_0D06_Comb0__IsEventDestMirror: rba_DiagLib_Value=FALSE, rba_DiagLib_AttributeRef=Dem_EvtParam/IsEventDestMirror
              DemEventParameter_0D06_Comb0__AgingAllowed: rba_DiagLib_Value=1u, rba_DiagLib_AttributeRef=Dem_EvtParam/AgingAllowed
              DemEventParameter_0D06_Comb0__IsGlobalFDCCallbackConfigured: rba_DiagLib_Value=FALSE, rba_DiagLib_AttributeRef=Dem_EvtParam/IsGlobalFDCCallbackConfigured
              DemEventParameter_0D06_Comb0__TriggersDataChangedCallback: rba_DiagLib_Value=FALSE, rba_DiagLib_AttributeRef=Dem_EvtParam/TriggersDataChangedCallback
              DemEventParameter_0D06_Comb0__Significance: rba_DiagLib_Value=1u, rba_DiagLib_AttributeRef=Dem_EvtParam/Significance
              DemEventParameter_0D06_Comb0__OperationCycleID: rba_DiagLib_Value=DemConf_DemOperationCycle_DemOperationCycle_Power, rba_DiagLib_AttributeRef=Dem_EvtParam/OperationCycleID
              DemEventParameter_0D06_Comb0__AgingCycleID: rba_DiagLib_Value=DemConf_DemOperationCycle_DemOperationCycle_Power, rba_DiagLib_AttributeRef=Dem_EvtParam/AgingCycleID
              DemEventParameter_0D06_Comb0__FailureCycleID: rba_DiagLib_Value=DemConf_DemOperationCycle_DemOperationCycle_Power, rba_DiagLib_AttributeRef=Dem_EvtParam/FailureCycleID
              DemEventParameter_0D06_Comb0__InitialSuppressionStatus: rba_DiagLib_Value=0u, rba_DiagLib_AttributeRef=Dem_EvtParam/InitialSuppressionStatus
              DemEventParameter_0D06_Comb0__DebounceMethodIndex: rba_DiagLib_Value=DEM_DEBMETH_IDX_ARCTRBASECLASS, rba_DiagLib_AttributeRef=Dem_EvtParam/DebounceMethodIndex
              DemEventParameter_0D06_Comb0__DebounceParamSettingIndex: rba_DiagLib_Value=DEM_DEBPARAM_IDX_DEMEVENTPARAMETER_0D06_COMB0, rba_DiagLib_AttributeRef=Dem_EvtParam/DebounceParamSettingIndex
              DemEventParameter_0D06_Comb0__BufferTimeSFB: rba_DiagLib_Value=0u, rba_DiagLib_AttributeRef=Dem_EvtParam/BufferTimeSFB
              DemEventParameter_0D06_Comb0__AgingThreshold: rba_DiagLib_Value=40u, rba_DiagLib_AttributeRef=Dem_EvtParam/AgingThreshold
              DemEventParameter_0D06_Comb0__AgingThresholdForTFSLC: rba_DiagLib_Value=0u, rba_DiagLib_AttributeRef=Dem_EvtParam/AgingThresholdForTFSLC
              DemEventParameter_0D06_Comb0__FailureConfirmationThreshold: rba_DiagLib_Value=1u, rba_DiagLib_AttributeRef=Dem_EvtParam/FailureConfirmationThreshold
              DemEventParameter_0D06_Comb0__EventPriority: rba_DiagLib_Value=7u, rba_DiagLib_AttributeRef=Dem_EvtParam/EventPriority
              DemEventParameter_0D06_Comb0__MaxNumberFreezeFrameRecords: rba_DiagLib_Value=2u, rba_DiagLib_AttributeRef=Dem_EvtParam/MaxNumberFreezeFrameRecords
              DemEventParameter_0D06_Comb0__StorageConditions: rba_DiagLib_Value=DEM_STOCO_DemEventParameter_0D06_Comb0, rba_DiagLib_AttributeRef=Dem_EvtParam/StorageConditions
              DemEventParameter_0D06_Comb0__EnableConditions: rba_DiagLib_Value=DEM_ENCO_DemEventParameter_0D06_Comb0, rba_DiagLib_AttributeRef=Dem_EvtParam/EnableConditions
              DemEventParameter_0D06_Comb0__CallbackEventStatusChangedIndex: rba_DiagLib_Value=0u, rba_DiagLib_AttributeRef=Dem_EvtParam/CallbackEventStatusChangedIndex
              DemEventParameter_0D06_Comb0__CallbackClearAllowed: rba_DiagLib_Value=NULL_PTR, rba_DiagLib_AttributeRef=Dem_EvtParam/CallbackClearAllowed
              DemEventParameter_0D06_Comb0__ClearAllowedBehavior: rba_DiagLib_Value=DEM_NO_STATUS_BYTE_CHANGE, rba_DiagLib_AttributeRef=Dem_EvtParam/ClearAllowedBehavior
              DemEventParameter_0D06_Comb0__IsFFPrestorageSupported: rba_DiagLib_Value=FALSE, rba_DiagLib_AttributeRef=Dem_EvtParam/IsFFPrestorageSupported
              DemEventParameter_0D06_Comb0__IsEventOBDRelevant: rba_DiagLib_Value=0u, rba_DiagLib_AttributeRef=Dem_EvtParam/IsEventOBDRelevant
          DemEventParameter_0D06_Comb1
          DemEventParameter_0D06_Comb1
            31 x rba_DiagLib_AttributeValue:
              DemEventParameter_0D06_Comb1__DebounceBehavior: rba_DiagLib_Value=DEM_DEBOUNCE_FREEZE, rba_DiagLib_AttributeRef=Dem_EvtParam/DebounceBehavior
              DemEventParameter_0D06_Comb1__IsRecoverable: rba_DiagLib_Value=DEM_RECOV, rba_DiagLib_AttributeRef=Dem_EvtParam/IsRecoverable
              DemEventParameter_0D06_Comb1__StoreTestFailedToNextOC: rba_DiagLib_Value=TRUE, rba_DiagLib_AttributeRef=Dem_EvtParam/StoreTestFailedToNextOC
              DemEventParameter_0D06_Comb1__RequestsWarningIndicator: rba_DiagLib_Value=0u, rba_DiagLib_AttributeRef=Dem_EvtParam/RequestsWarningIndicator
              DemEventParameter_0D06_Comb1__Category: rba_DiagLib_Value=DemConf_DemEventCategory_INVALIDCATEGORY, rba_DiagLib_AttributeRef=Dem_EvtParam/Category
              DemEventParameter_0D06_Comb1__IsEventDestPrimary: rba_DiagLib_Value=TRUE, rba_DiagLib_AttributeRef=Dem_EvtParam/IsEventDestPrimary
              DemEventParameter_0D06_Comb1__IsEventDestSecondary: rba_DiagLib_Value=FALSE, rba_DiagLib_AttributeRef=Dem_EvtParam/IsEventDestSecondary
              DemEventParameter_0D06_Comb1__IsEventDestMirror: rba_DiagLib_Value=FALSE, rba_DiagLib_AttributeRef=Dem_EvtParam/IsEventDestMirror
              DemEventParameter_0D06_Comb1__AgingAllowed: rba_DiagLib_Value=1u, rba_DiagLib_AttributeRef=Dem_EvtParam/AgingAllowed
              DemEventParameter_0D06_Comb1__IsGlobalFDCCallbackConfigured: rba_DiagLib_Value=FALSE, rba_DiagLib_AttributeRef=Dem_EvtParam/IsGlobalFDCCallbackConfigured
              DemEventParameter_0D06_Comb1__TriggersDataChangedCallback: rba_DiagLib_Value=FALSE, rba_DiagLib_AttributeRef=Dem_EvtParam/TriggersDataChangedCallback
              DemEventParameter_0D06_Comb1__Significance: rba_DiagLib_Value=1u, rba_DiagLib_AttributeRef=Dem_EvtParam/Significance
              DemEventParameter_0D06_Comb1__OperationCycleID: rba_DiagLib_Value=DemConf_DemOperationCycle_DemOperationCycle_Power, rba_DiagLib_AttributeRef=Dem_EvtParam/OperationCycleID
              DemEventParameter_0D06_Comb1__AgingCycleID: rba_DiagLib_Value=DemConf_DemOperationCycle_DemOperationCycle_Power, rba_DiagLib_AttributeRef=Dem_EvtParam/AgingCycleID
              DemEventParameter_0D06_Comb1__FailureCycleID: rba_DiagLib_Value=DemConf_DemOperationCycle_DemOperationCycle_Power, rba_DiagLib_AttributeRef=Dem_EvtParam/FailureCycleID
              DemEventParameter_0D06_Comb1__InitialSuppressionStatus: rba_DiagLib_Value=0u, rba_DiagLib_AttributeRef=Dem_EvtParam/InitialSuppressionStatus
              DemEventParameter_0D06_Comb1__DebounceMethodIndex: rba_DiagLib_Value=DEM_DEBMETH_IDX_ARCTRBASECLASS, rba_DiagLib_AttributeRef=Dem_EvtParam/DebounceMethodIndex
              DemEventParameter_0D06_Comb1__DebounceParamSettingIndex: rba_DiagLib_Value=DEM_DEBPARAM_IDX_DEMEVENTPARAMETER_0D06_COMB1, rba_DiagLib_AttributeRef=Dem_EvtParam/DebounceParamSettingIndex
              DemEventParameter_0D06_Comb1__BufferTimeSFB: rba_DiagLib_Value=0u, rba_DiagLib_AttributeRef=Dem_EvtParam/BufferTimeSFB
              DemEventParameter_0D06_Comb1__AgingThreshold: rba_DiagLib_Value=40u, rba_DiagLib_AttributeRef=Dem_EvtParam/AgingThreshold
              DemEventParameter_0D06_Comb1__AgingThresholdForTFSLC: rba_DiagLib_Value=0u, rba_DiagLib_AttributeRef=Dem_EvtParam/AgingThresholdForTFSLC
              DemEventParameter_0D06_Comb1__FailureConfirmationThreshold: rba_DiagLib_Value=1u, rba_DiagLib_AttributeRef=Dem_EvtParam/FailureConfirmationThreshold
              DemEventParameter_0D06_Comb1__EventPriority: rba_DiagLib_Value=7u, rba_DiagLib_AttributeRef=Dem_EvtParam/EventPriority
              DemEventParameter_0D06_Comb1__MaxNumberFreezeFrameRecords: rba_DiagLib_Value=2u, rba_DiagLib_AttributeRef=Dem_EvtParam/MaxNumberFreezeFrameRecords
              DemEventParameter_0D06_Comb1__StorageConditions: rba_DiagLib_Value=DEM_STOCO_DemEventParameter_0D06_Comb1, rba_DiagLib_AttributeRef=Dem_EvtParam/StorageConditions
              DemEventParameter_0D06_Comb1__EnableConditions: rba_DiagLib_Value=DEM_ENCO_DemEventParameter_0D06_Comb1, rba_DiagLib_AttributeRef=Dem_EvtParam/EnableConditions
              DemEventParameter_0D06_Comb1__CallbackEventStatusChangedIndex: rba_DiagLib_Value=0u, rba_DiagLib_AttributeRef=Dem_EvtParam/CallbackEventStatusChangedIndex
              DemEventParameter_0D06_Comb1__CallbackClearAllowed: rba_DiagLib_Value=NULL_PTR, rba_DiagLib_AttributeRef=Dem_EvtParam/CallbackClearAllowed
              DemEventParameter_0D06_Comb1__ClearAllowedBehavior: rba_DiagLib_Value=DEM_NO_STATUS_BYTE_CHANGE, rba_DiagLib_AttributeRef=Dem_EvtParam/ClearAllowedBehavior
              DemEventParameter_0D06_Comb1__IsFFPrestorageSupported: rba_DiagLib_Value=FALSE, rba_DiagLib_AttributeRef=Dem_EvtParam/IsFFPrestorageSupported
              DemEventParameter_0D06_Comb1__IsEventOBDRelevant: rba_DiagLib_Value=0u, rba_DiagLib_AttributeRef=Dem_EvtParam/IsEventOBDRelevant
        data1 (rba_DiagLib_DataContainer): rba_DiagLib_TotalBitSize=8, rba_DiagLib_OccupiedBitSize=0
        AgingThreshold (rba_DiagLib_Attribute): rba_DiagLib_DataContainerRef=Dem_EvtParam/data1
        data1 (rba_DiagLib_DataContainer): rba_DiagLib_OccupiedBitSize=8
        data2 (rba_DiagLib_DataContainer): rba_DiagLib_TotalBitSize=32, rba_DiagLib_OccupiedBitSize=0
        MaxNumberFreezeFrameRecords (rba_DiagLib_Attribute): rba_DiagLib_DataContainerRef=Dem_EvtParam/data2
        data2 (rba_DiagLib_DataContainer):
          rba_DiagLib_OccupiedBitSize = 3
          rba_DiagLib_OccupiedBitSize = 6
          rba_DiagLib_OccupiedBitSize = {9..25}
        18 x rba_DiagLib_Attribute, all with rba_DiagLib_DataContainerRef=Dem_EvtParam/data2:
          EventPriority
          DebounceParamSettingIndex
          IsEventOBDRelevant
          IsFFPrestorageSupported
          FailureConfirmationThreshold
          AgingThresholdForTFSLC
          DebounceMethodIndex
          InitialSuppressionStatus
          FailureCycleID
          AgingCycleID
          OperationCycleID
          Significance
          AgingAllowed
          IsEventDestMirror
          IsEventDestSecondary
          IsEventDestPrimary
          IsRecoverable
          DebounceBehavior
  module config PduR
    PduRRoutingTables
      PduRRoutingTable
        14 x PduRRoutingPath:
          HCU_01_Can_Network_CANNODE_0_CanIf2Com
            HCU_01_Can_Network_CANNODE_0_CanIf2PduR (PduRSrcPdu): PduRSourcePduHandleId=0
            HCU_01_Can_Network_CANNODE_0_PduR2Com (PduRDestPdu): PduRDestPduHandleId=0
          HCU_02_Can_Network_CANNODE_0_CanIf2Com
            HCU_02_Can_Network_CANNODE_0_CanIf2PduR (PduRSrcPdu): PduRSourcePduHandleId=1
            HCU_02_Can_Network_CANNODE_0_PduR2Com (PduRDestPdu): PduRDestPduHandleId=1
          MCU_01_Can_Network_CANNODE_0_Com2CanIf
            MCU_01_Can_Network_CANNODE_0_PduR2CanIf (PduRDestPdu): PduRDestPduHandleId=0
            MCU_01_Can_Network_CANNODE_0_Com2PduR (PduRSrcPdu): PduRSourcePduHandleId=0
          MCU_02_Can_Network_CANNODE_0_Com2CanIf
            MCU_02_Can_Network_CANNODE_0_PduR2CanIf (PduRDestPdu): PduRDestPduHandleId=1
            MCU_02_Can_Network_CANNODE_0_Com2PduR (PduRSrcPdu): PduRSourcePduHandleId=1
          MCU_03_Can_Network_CANNODE_0_Com2CanIf
            MCU_03_Can_Network_CANNODE_0_PduR2CanIf (PduRDestPdu): PduRDestPduHandleId=2
            MCU_03_Can_Network_CANNODE_0_Com2PduR (PduRSrcPdu): PduRSourcePduHandleId=2
          Diag_Functional_request_Can_Network_CANNODE_0_CanTp2Dcm
            Diag_Functional_request_Can_Network_CANNODE_0_CanTp2PduR (PduRSrcPdu): PduRSourcePduHandleId=0
            Diag_Functional_request_Can_Network_CANNODE_0_PduR2Dcm (PduRDestPdu): PduRDestPduHandleId=0
          Diag_Physical_request_Can_Network_CANNODE_0_CanTp2Dcm
            Diag_Physical_request_Can_Network_CANNODE_0_CanTp2PduR (PduRSrcPdu): PduRSourcePduHandleId=1
            Diag_Physical_request_Can_Network_CANNODE_0_PduR2Dcm (PduRDestPdu): PduRDestPduHandleId=1
          Diag_Physical_response_Can_Network_CANNODE_0_Dcm2CanTp
            Diag_Physical_response_Can_Network_CANNODE_0_Phys_PduR2CanTp (PduRDestPdu): PduRDestPduHandleId=0
            Diag_Physical_response_Can_Network_CANNODE_0_Phys_Dcm2PduR (PduRSrcPdu): PduRSourcePduHandleId=0
          PduRRoutingPath_TCP_ComTX
            TXFrame_EthernetTCP_Com2PduR_Src (PduRSrcPdu): PduRSourcePduHandleId=3
            TXFrame_EthernetTCP_PduR2SoAd_Dest (PduRDestPdu): PduRDestPduHandleId=0
          PduRRoutingPath_UDP_ComTX
            TXFrame_EthernetUDP_Com2PduR_Src (PduRSrcPdu): PduRSourcePduHandleId=4
            TXFrame_EthernetUDP_PduR2SoAd_Dest (PduRDestPdu): PduRDestPduHandleId=1
          PduRRoutingPath_TCP_ComRX
            RXFrame_EthernetTCP_PduR2Com_Dest (PduRDestPdu): PduRDestPduHandleId=2
            RXFrame_EthernetTCP_SoAd2PduR_Src (PduRSrcPdu): PduRSourcePduHandleId=0
          PduRRoutingPath_UDP_ComRX
            RXFrame_EthernetUDP_PduR2Com_Dest (PduRDestPdu): PduRDestPduHandleId=3
            RXFrame_EthernetUDP_SoAd2PduR_Src (PduRSrcPdu): PduRSourcePduHandleId=1
          PduRRoutingPath_DoIP_Dcm2DoIP
            PduRSrcPdu_DoIP_Dcm2PduR (PduRSrcPdu): PduRSourcePduHandleId=1
            PduRDestPdu_DoIP_PduR2DoIP (PduRDestPdu): PduRDestPduHandleId=0
          PduRRoutingPath_DoIP_DoIP2Dcm
            PduRDestPdu_DoIP_PduR2Dcm (PduRDestPdu): PduRDestPduHandleId=2
            PduRSrcPdu_DoIP_DoIP2PduR (PduRSrcPdu): PduRSourcePduHandleId=0
package /CanTp_EcucValues
  module config CanTp
    CanTpConfig
      CanTpChannel_UDS (CanTpChannel)
        Diag_Functional_request_Can_Network_CANNODE_0_Phys_CanTp2PduR (CanTpRxNSdu): CanTpRxNSduId=0
          Diag_Functional_request_Can_Network_CANNODE_0_Phys_CanIf2CanTp (CanTpRxNPdu): CanTpRxNPduId=0
        Diag_Physical_request_Can_Network_CANNODE_0_Func_CanTp2PduR (CanTpRxNSdu): CanTpRxNSduId=1
          Diag_Physical_request_Can_Network_CANNODE_0_Phys_CanIf2CanTp (CanTpRxNPdu): CanTpRxNPduId=1
          Diag_Physical_response_Can_Network_CANNODE_0_Phys_CanTp2CanIf (CanTpTxFcNPdu): CanTpTxFcNPduConfirmationPduId=0
        Diag_Physical_response_Can_Network_CANNODE_0_Phys_PduR2CanTp (CanTpTxNSdu): CanTpTxNSduId=0
          Diag_Physical_request_Can_Network_CANNODE_0_Phys_CanIf2CanTp (CanTpRxFcNPdu): CanTpRxFcNPduId=1
          Diag_Physical_response_Can_Network_CANNODE_0_Phys_CanTp2CanIf (CanTpTxNPdu): CanTpTxNPduConfirmationPduId=0
    CanTpGeneral: CanTpRbValidationDone=true
package /RB/UBK/Project/EcucModuleConfigurationValuess
  module config rba_ArxmlGen
    18 x rba_ArxmlGen_Comp:
      EthTSyn: rba_ArxmlGen_CompVersionSw=10.0.0, rba_ArxmlGen_CompVersionAr=4.2.2
        SE_MainFunction (rba_ArxmlGen_ExecEntity): rba_ArxmlGen_ExecEntityPeriod=0.01
      EthIf: rba_ArxmlGen_CompVersionSw=10.0.0, rba_ArxmlGen_CompVersionAr=4.3.0
        3 x rba_ArxmlGen_ExecEntity:
          SE_MainFunctionState: rba_ArxmlGen_ExecEntityPeriod=0.005
          SE_MainFunctionTx: rba_ArxmlGen_ExecEntityPeriod=0.001
          SE_MainFunctionRx_EthIfPhysCtrlRxMainFunctionPriorityProcessing: rba_ArxmlGen_ExecEntityCategory=Schedulable, rba_ArxmlGen_ExecEntityPeriod=0.01, rba_ArxmlGen_ExecEntityImplEntryRef=EthIf_MainFunctionRx_EthIfPhysCtrlRxMainFunctionPriorityProcessing
      EthSM: rba_ArxmlGen_CompVersionSw=10.0.0, rba_ArxmlGen_CompVersionAr=4.2.2
        EthSM_NetworkModeStateType_au8_app (rba_ArxmlGen_ApplDataType): rba_ArxmlGen_ApplDataTypeNumElements=1
        EthSM_NetworkModeStateType_au8_impl (rba_ArxmlGen_ImplDataType): rba_ArxmlGen_ImplDataTypeNumElements=1
        SE_MainFunction (rba_ArxmlGen_ExecEntity): rba_ArxmlGen_ExecEntityPeriod=0.01
      TcpIp: rba_ArxmlGen_CompVersionSw=10.0.0, rba_ArxmlGen_CompVersionAr=4.2.2
        TcpIp_StateType_au8_app (rba_ArxmlGen_ApplDataType): rba_ArxmlGen_ApplDataTypeNumElements=1
        TcpIp_StateType_au8_impl (rba_ArxmlGen_ImplDataType): rba_ArxmlGen_ImplDataTypeNumElements=1
        SE_MainFunction (rba_ArxmlGen_ExecEntity): rba_ArxmlGen_ExecEntityPeriod=0.001
      rba_EthArp: rba_ArxmlGen_CompVersionSw=10.0.0, rba_ArxmlGen_CompVersionAr=4.2.2
      rba_EthAutoIp: rba_ArxmlGen_CompVersionSw=10.0.0, rba_ArxmlGen_CompVersionAr=4.2.2
      rba_EthDHCP: rba_ArxmlGen_CompVersionSw=10.0.0, rba_ArxmlGen_CompVersionAr=4.2.2
      rba_EthIPv4: rba_ArxmlGen_CompVersionSw=10.0.0, rba_ArxmlGen_CompVersionAr=4.2.2
      rba_EthICMP: rba_ArxmlGen_CompVersionSw=10.0.0, rba_ArxmlGen_CompVersionAr=4.2.2
      rba_EthUdp: rba_ArxmlGen_CompVersionSw=10.0.0, rba_ArxmlGen_CompVersionAr=4.2.2
      CanNm
        SE_MainFunction (rba_ArxmlGen_ExecEntity): rba_ArxmlGen_ExecEntityPeriod=0.01
      CanSM
        CanSM_Au8_app (rba_ArxmlGen_ApplDataType): rba_ArxmlGen_ApplDataTypeNumElements=2
        CanSM_Au8_impl (rba_ArxmlGen_ImplDataType): rba_ArxmlGen_ImplDataTypeNumElements=2
        CanSM_Aboolean_app (rba_ArxmlGen_ApplDataType): rba_ArxmlGen_ApplDataTypeNumElements=2
        CanSM_Aboolean_impl (rba_ArxmlGen_ImplDataType): rba_ArxmlGen_ImplDataTypeNumElements=2
        CanSM_currBOR_State_a_Aenum_app (rba_ArxmlGen_ApplDataType): rba_ArxmlGen_ApplDataTypeNumElements=2
        CanSM_currBOR_State_a_Aenum_impl (rba_ArxmlGen_ImplDataType): rba_ArxmlGen_ImplDataTypeNumElements=2
        CanSM_currComM_Mode_a_Aenum_app (rba_ArxmlGen_ApplDataType): rba_ArxmlGen_ApplDataTypeNumElements=2
        CanSM_currComM_Mode_a_Aenum_impl (rba_ArxmlGen_ImplDataType): rba_ArxmlGen_ImplDataTypeNumElements=2
        CanSM_TimerConfig_ast_Astruct_app (rba_ArxmlGen_ApplDataType): rba_ArxmlGen_ApplDataTypeNumElements=2
        CanSM_TimerConfig_ast_Astruct_impl (rba_ArxmlGen_ImplDataType): rba_ArxmlGen_ImplDataTypeNumElements=2
        SE_MainFunction (rba_ArxmlGen_ExecEntity): rba_ArxmlGen_ExecEntityPeriod=0.001
      ComM
        ComM_UserStruct_Array_App (rba_ArxmlGen_ApplDataType): rba_ArxmlGen_ApplDataTypeNumElements=3
        ComM_UserStruct_Array_Impl (rba_ArxmlGen_ImplDataType): rba_ArxmlGen_ImplDataTypeNumElements=3
        ComM_ChannelStruct_Array_App (rba_ArxmlGen_ApplDataType): rba_ArxmlGen_ApplDataTypeNumElements=3
        ComM_ChannelStruct_Array_Impl (rba_ArxmlGen_ImplDataType): rba_ArxmlGen_ImplDataTypeNumElements=3
        3 x rba_ArxmlGen_ExecEntity, all with rba_ArxmlGen_ExecEntityCategory=Schedulable, rba_ArxmlGen_ExecEntityPeriod=0.01:
          SE_MainFunction_ComMChannel_Can_Network_Channel: rba_ArxmlGen_ExecEntityImplEntryRef=ComM_MainFunction_ComMChannel_Can_Network_Channel
          SE_MainFunction_ComMChannel_Can_Network_XCP_Channel: rba_ArxmlGen_ExecEntityImplEntryRef=ComM_MainFunction_ComMChannel_Can_Network_XCP_Channel
          SE_MainFunction_Eth_Network_Channel_EthernetCluster: rba_ArxmlGen_ExecEntityImplEntryRef=ComM_MainFunction_Eth_Network_Channel_EthernetCluster
      SoAd: rba_ArxmlGen_CompVersionSw=10.0.0, rba_ArxmlGen_CompVersionAr=4.2.2
        SE_MainFunction (rba_ArxmlGen_ExecEntity): rba_ArxmlGen_ExecEntityPeriod=0.001
      Xcp: rba_ArxmlGen_CompVersionSw=10.0.0
        6 x rba_ArxmlGen_ExecEntity:
          CE_Init: rba_ArxmlGen_ExecEntityCategory=Called, rba_ArxmlGen_ExecEntityImplEntryRef=Xcp_Init
          SE_MainFunction: rba_ArxmlGen_ExecEntityCategory=Schedulable, rba_ArxmlGen_ExecEntityPeriod=0.01, rba_ArxmlGen_ExecEntityImplEntryRef=Xcp_MainFunction
          SE_EthMainFunctionTx: rba_ArxmlGen_ExecEntityCategory=Schedulable, rba_ArxmlGen_ExecEntityPeriod=0.001, rba_ArxmlGen_ExecEntityImplEntryRef=Xcp_EthMainFunctionTx
          SE_EventChannel_10ms: rba_ArxmlGen_ExecEntityCategory=Schedulable, rba_ArxmlGen_ExecEntityPeriod=0.01, rba_ArxmlGen_ExecEntityImplEntryRef=Xcp_EventChannel_10ms
          SE_EventChannel_100ms: rba_ArxmlGen_ExecEntityCategory=Schedulable, rba_ArxmlGen_ExecEntityPeriod=0.1, rba_ArxmlGen_ExecEntityImplEntryRef=Xcp_EventChannel_100ms
          SE_EventChannel_50ms: rba_ArxmlGen_ExecEntityCategory=Schedulable, rba_ArxmlGen_ExecEntityPeriod=0.05, rba_ArxmlGen_ExecEntityImplEntryRef=Xcp_EventChannel_50ms
      CanIf
        CanIf_ControllerState_Astruct_impl (rba_ArxmlGen_ImplDataType): rba_ArxmlGen_ImplDataTypeCategory=Array, rba_ArxmlGen_ImplDataTypeLongName=Implementation datatype for array of struct
          CanIf_struct_impl (rba_ArxmlGen_ImplDataTypeSub): rba_ArxmlGen_ImplDataTypeSubOwnRef=CanIf_ControllerStateType_struct_impl
        CanIf_ControllerState_Astruct_app (rba_ArxmlGen_ApplDataType):
          rba_ArxmlGen_ApplDataTypeCategory = Array
          rba_ArxmlGen_ApplDataTypeLongName = Structure datatype in CanIf
          rba_ArxmlGen_ApplDataTypeImplOwnRef = CanIf/CanIf_ControllerState_Astruct_impl
          CanIf_ControllerStateType (rba_ArxmlGen_ApplDataTypeSub): rba_ArxmlGen_ApplDataTypeSubOwnRef=CanIf_ControllerStateType_struct_app
        CanIf_ControllerState_Astruct_app (rba_ArxmlGen_ApplDataType): rba_ArxmlGen_ApplDataTypeNumElements=2
        CanIf_ControllerState_Astruct_impl (rba_ArxmlGen_ImplDataType): rba_ArxmlGen_ImplDataTypeNumElements=2
        CanIf_Prv_ControllerState_ast (rba_ArxmlGen_Measurement):
          rba_ArxmlGen_MeasCategory = Array
          rba_ArxmlGen_MeasDispFormat = %5.0f
          rba_ArxmlGen_MeasLongName = Can Interface controller State
          rba_ArxmlGen_MeasAddrMethodRef = INTERNAL_VAR_CLEARED
          rba_ArxmlGen_MeasApplDataTypeOwnRef = CanIf/CanIf_ControllerState_Astruct_app
        CanIf_NotifStatusType_Aenum_impl (rba_ArxmlGen_ImplDataType): rba_ArxmlGen_ImplDataTypeCategory=Array, rba_ArxmlGen_ImplDataTypeLongName=implementation data type for array of enum
          CanIf_Enum_impl (rba_ArxmlGen_ImplDataTypeSub): rba_ArxmlGen_ImplDataTypeSubOwnRef=CanIf_NotifStatusType_Enum_impl
        CanIf_NotifStatusType_Aenum_app (rba_ArxmlGen_ApplDataType):
          rba_ArxmlGen_ApplDataTypeCategory = Array
          rba_ArxmlGen_ApplDataTypeLongName = application data type for array of enum
          rba_ArxmlGen_ApplDataTypeImplOwnRef = CanIf/CanIf_NotifStatusType_Aenum_impl
          CanIf_NotifStatusType (rba_ArxmlGen_ApplDataTypeSub): rba_ArxmlGen_ApplDataTypeSubOwnRef=CanIf_NotifStatusType_Enum_app
        CanIf_NotifStatusType_Aenum_app (rba_ArxmlGen_ApplDataType): rba_ArxmlGen_ApplDataTypeNumElements=9
        CanIf_NotifStatusType_Aenum_impl (rba_ArxmlGen_ImplDataType): rba_ArxmlGen_ImplDataTypeNumElements=9
        CanIf_Prv_TxNotification_aen (rba_ArxmlGen_Measurement):
          rba_ArxmlGen_MeasCategory = Array
          rba_ArxmlGen_MeasDispFormat = %5.0f
          rba_ArxmlGen_MeasLongName = Can Interface Transmit Notification
          rba_ArxmlGen_MeasAddrMethodRef = INTERNAL_VAR_CLEARED
          rba_ArxmlGen_MeasApplDataTypeOwnRef = CanIf/CanIf_NotifStatusType_Aenum_app
      NvM: rba_ArxmlGen_CompCategory=BswModule, rba_ArxmlGen_CompId=20, rba_ArxmlGen_CompIsConfigurable=true, rba_ArxmlGen_CompIsStandalone=false, rba_ArxmlGen_CompIsStandardized=true, rba_ArxmlGen_CompLongName=NVRAM Manager, rba_ArxmlGen_CompVersionSw=17.0.0, rba_ArxmlGen_CompSwcBswMappingRef=NvM
        4 x rba_ArxmlGen_CompuMethod, all with rba_ArxmlGen_CompuMethodCategory=TextTable:
          NvM_Rb_StatusType: rba_ArxmlGen_CompuMethodLongName=Computation method for the type of the current overall status of the NVRAM manager.
            3 x rba_ArxmlGen_CompuMethodTextEntry, all with rba_ArxmlGen_CompuMethodTENumVals=1:
              NVM_RB_STATUS_UNINIT: rba_ArxmlGen_CompuMethodTEIntVal=0, rba_ArxmlGen_CompuMethodTEText=NVM_RB_STATUS_UNINIT
              NVM_RB_STATUS_IDLE: rba_ArxmlGen_CompuMethodTEIntVal=1, rba_ArxmlGen_CompuMethodTEText=NVM_RB_STATUS_IDLE
              NVM_RB_STATUS_BUSY: rba_ArxmlGen_CompuMethodTEIntVal=2, rba_ArxmlGen_CompuMethodTEText=NVM_RB_STATUS_BUSY
          NvM_RequestResultType: rba_ArxmlGen_CompuMethodLongName=Computation method for the type of the block request result.
            9 x rba_ArxmlGen_CompuMethodTextEntry, all with rba_ArxmlGen_CompuMethodTENumVals=1:
              NVM_REQ_OK: rba_ArxmlGen_CompuMethodTEIntVal=0, rba_ArxmlGen_CompuMethodTEText=NVM_REQ_OK
              NVM_REQ_NOT_OK: rba_ArxmlGen_CompuMethodTEIntVal=1, rba_ArxmlGen_CompuMethodTEText=NVM_REQ_NOT_OK
              NVM_REQ_PENDING: rba_ArxmlGen_CompuMethodTEIntVal=2, rba_ArxmlGen_CompuMethodTEText=NVM_REQ_PENDING
              NVM_REQ_INTEGRITY_FAILED: rba_ArxmlGen_CompuMethodTEIntVal=3, rba_ArxmlGen_CompuMethodTEText=NVM_REQ_INTEGRITY_FAILED
              NVM_REQ_BLOCK_SKIPPED: rba_ArxmlGen_CompuMethodTEIntVal=4, rba_ArxmlGen_CompuMethodTEText=NVM_REQ_BLOCK_SKIPPED
              NVM_REQ_NV_INVALIDATED: rba_ArxmlGen_CompuMethodTEIntVal=5, rba_ArxmlGen_CompuMethodTEText=NVM_REQ_NV_INVALIDATED
              NVM_REQ_CANCELED: rba_ArxmlGen_CompuMethodTEIntVal=6, rba_ArxmlGen_CompuMethodTEText=NVM_REQ_CANCELED
              NVM_REQ_REDUNDANCY_FAILED: rba_ArxmlGen_CompuMethodTEIntVal=7, rba_ArxmlGen_CompuMethodTEText=NVM_REQ_REDUNDANCY_FAILED
              NVM_REQ_RESTORED_FROM_ROM: rba_ArxmlGen_CompuMethodTEIntVal=8, rba_ArxmlGen_CompuMethodTEText=NVM_REQ_RESTORED_FROM_ROM
          NvM_Rb_MigrationResult_ten: rba_ArxmlGen_CompuMethodLongName=Computation method for the type of the the migration result.
            6 x rba_ArxmlGen_CompuMethodTextEntry, all with rba_ArxmlGen_CompuMethodTENumVals=1:
              NVM_RB_MIGRATION_RESULT_INIT_E: rba_ArxmlGen_CompuMethodTEIntVal=0, rba_ArxmlGen_CompuMethodTEText=NVM_RB_MIGRATION_RESULT_INIT_E
              NVM_RB_MIGRATION_RESULT_NOT_NECESSARY_E: rba_ArxmlGen_CompuMethodTEIntVal=1, rba_ArxmlGen_CompuMethodTEText=NVM_RB_MIGRATION_RESULT_NOT_NECESSARY_E
              NVM_RB_MIGRATION_RESULT_TO_SMALLER_SIZE_E: rba_ArxmlGen_CompuMethodTEIntVal=2, rba_ArxmlGen_CompuMethodTEText=NVM_RB_MIGRATION_RESULT_TO_SMALLER_SIZE_E
              NVM_RB_MIGRATION_RESULT_TO_BIGGER_SIZE_E: rba_ArxmlGen_CompuMethodTEIntVal=3, rba_ArxmlGen_CompuMethodTEText=NVM_RB_MIGRATION_RESULT_TO_BIGGER_SIZE_E
              NVM_RB_MIGRATION_RESULT_NOT_DONE_E: rba_ArxmlGen_CompuMethodTEIntVal=4, rba_ArxmlGen_CompuMethodTEText=NVM_RB_MIGRATION_RESULT_NOT_DONE_E
              NVM_RB_MIGRATION_RESULT_DEACTIVATED_E: rba_ArxmlGen_CompuMethodTEIntVal=5, rba_ArxmlGen_CompuMethodTEText=NVM_RB_MIGRATION_RESULT_DEACTIVATED_E
          NvM_Rb_RequestType_ten: rba_ArxmlGen_CompuMethodLongName=Computation method for the type of the currently active user block request.
            3 x rba_ArxmlGen_CompuMethodTextEntry, all with rba_ArxmlGen_CompuMethodTENumVals=1:
              NvM_Rb_RequestType_NA_e: rba_ArxmlGen_CompuMethodTEIntVal=0, rba_ArxmlGen_CompuMethodTEText=NvM_Rb_RequestType_NA_e
              NvM_Rb_RequestType_Multi_e: rba_ArxmlGen_CompuMethodTEIntVal=1, rba_ArxmlGen_CompuMethodTEText=NvM_Rb_RequestType_Multi_e
              NvM_Rb_RequestType_Single_e: rba_ArxmlGen_CompuMethodTEIntVal=2, rba_ArxmlGen_CompuMethodTEText=NvM_Rb_RequestType_Single_e
        3 x rba_ArxmlGen_DataConstraint, all with rba_ArxmlGen_DataConstraintCategory=Physical, rba_ArxmlGen_DataConstraintLower=0, rba_ArxmlGen_DataConstraintUnitRef=Mem_NoUnit:
          NvM_Constr_NoUnit_u32: rba_ArxmlGen_DataConstraintUpper=4294967295
          NvM_Constr_NoUnit_u16: rba_ArxmlGen_DataConstraintUpper=65535
          NvM_Constr_NoUnit_u8: rba_ArxmlGen_DataConstraintUpper=255
        30 x rba_ArxmlGen_ExecEntity:
          CE_CancelWriteAll: rba_ArxmlGen_ExecEntityCategory=Called, rba_ArxmlGen_ExecEntityImplEntryRef=NvM_CancelWriteAll
          CE_EraseNvBlock: rba_ArxmlGen_ExecEntityCategory=Called, rba_ArxmlGen_ExecEntityImplEntryRef=NvM_EraseNvBlock
          CE_GetDataIndex: rba_ArxmlGen_ExecEntityCategory=Called, rba_ArxmlGen_ExecEntityImplEntryRef=NvM_GetDataIndex
          CE_GetErrorStatus: rba_ArxmlGen_ExecEntityCategory=Called, rba_ArxmlGen_ExecEntityImplEntryRef=NvM_GetErrorStatus
          CE_Init: rba_ArxmlGen_ExecEntityCategory=Called, rba_ArxmlGen_ExecEntityImplEntryRef=NvM_Init
          CE_InvalidateNvBlock: rba_ArxmlGen_ExecEntityCategory=Called, rba_ArxmlGen_ExecEntityImplEntryRef=NvM_InvalidateNvBlock
          SE_MainFunction: rba_ArxmlGen_ExecEntityCategory=Schedulable, rba_ArxmlGen_ExecEntityPeriod=0.01, rba_ArxmlGen_ExecEntityImplEntryRef=NvM_MainFunction
          CE_Rb_ClrWriteMonCntrs: rba_ArxmlGen_ExecEntityCategory=Called, rba_ArxmlGen_ExecEntityImplEntryRef=NvM_Rb_ClrWriteMonCntrs
          CE_Rb_FirstInitAll: rba_ArxmlGen_ExecEntityCategory=Called, rba_ArxmlGen_ExecEntityImplEntryRef=NvM_Rb_FirstInitAll
          CE_Rb_GetActiveService: rba_ArxmlGen_ExecEntityCategory=Called, rba_ArxmlGen_ExecEntityImplEntryRef=NvM_Rb_GetActiveService
          CE_Rb_GetBlockId: rba_ArxmlGen_ExecEntityCategory=Called, rba_ArxmlGen_ExecEntityImplEntryRef=NvM_Rb_GetBlockId
          CE_Rb_GetMigrationResult: rba_ArxmlGen_ExecEntityCategory=Called, rba_ArxmlGen_ExecEntityImplEntryRef=NvM_Rb_GetMigrationResult
          CE_Rb_GetNvBlockLength: rba_ArxmlGen_ExecEntityCategory=Called, rba_ArxmlGen_ExecEntityImplEntryRef=NvM_Rb_GetNvBlockLength
          CE_Rb_GetRequestType: rba_ArxmlGen_ExecEntityCategory=Called, rba_ArxmlGen_ExecEntityImplEntryRef=NvM_Rb_GetRequestType
          CE_Rb_GetStatus: rba_ArxmlGen_ExecEntityCategory=Called, rba_ArxmlGen_ExecEntityImplEntryRef=NvM_Rb_GetStatus
          CE_Rb_GetWriteCounter: rba_ArxmlGen_ExecEntityCategory=Called, rba_ArxmlGen_ExecEntityImplEntryRef=NvM_Rb_GetWriteCounter
          CE_ReadAll: rba_ArxmlGen_ExecEntityCategory=Called, rba_ArxmlGen_ExecEntityImplEntryRef=NvM_ReadAll
          CE_ReadBlock: rba_ArxmlGen_ExecEntityCategory=Called, rba_ArxmlGen_ExecEntityImplEntryRef=NvM_ReadBlock
          CE_ReadPRAMBlock: rba_ArxmlGen_ExecEntityCategory=Called, rba_ArxmlGen_ExecEntityImplEntryRef=NvM_ReadPRAMBlock
          CE_RestoreBlockDefaults: rba_ArxmlGen_ExecEntityCategory=Called, rba_ArxmlGen_ExecEntityImplEntryRef=NvM_RestoreBlockDefaults
          CE_RestorePRAMBlockDefaults: rba_ArxmlGen_ExecEntityCategory=Called, rba_ArxmlGen_ExecEntityImplEntryRef=NvM_RestorePRAMBlockDefaults
          CE_SetBlockLockStatus: rba_ArxmlGen_ExecEntityCategory=Called, rba_ArxmlGen_ExecEntityImplEntryRef=NvM_SetBlockLockStatus
          CE_SetBlockProtection: rba_ArxmlGen_ExecEntityCategory=Called, rba_ArxmlGen_ExecEntityImplEntryRef=NvM_SetBlockProtection
          CE_SetDataIndex: rba_ArxmlGen_ExecEntityCategory=Called, rba_ArxmlGen_ExecEntityImplEntryRef=NvM_SetDataIndex
          CE_SetRamBlockStatus: rba_ArxmlGen_ExecEntityCategory=Called, rba_ArxmlGen_ExecEntityImplEntryRef=NvM_SetRamBlockStatus
          CE_SetWriteAllTrigger: rba_ArxmlGen_ExecEntityCategory=Called, rba_ArxmlGen_ExecEntityImplEntryRef=NvM_Rb_SetWriteAllTrigger
          CE_ValidateAll: rba_ArxmlGen_ExecEntityCategory=Called, rba_ArxmlGen_ExecEntityImplEntryRef=NvM_ValidateAll
          CE_WriteAll: rba_ArxmlGen_ExecEntityCategory=Called, rba_ArxmlGen_ExecEntityImplEntryRef=NvM_WriteAll
          CE_WriteBlock: rba_ArxmlGen_ExecEntityCategory=Called, rba_ArxmlGen_ExecEntityImplEntryRef=NvM_WriteBlock
          CE_WritePRAMBlock: rba_ArxmlGen_ExecEntityCategory=Called, rba_ArxmlGen_ExecEntityImplEntryRef=NvM_WritePRAMBlock
      Com: rba_ArxmlGen_CompVersionSw=10.0.0, rba_ArxmlGen_CompVersionAr=4.2.2
        Com_SigBuf_au8_impl (rba_ArxmlGen_ImplDataType):
          rba_ArxmlGen_ImplDataTypeCategory = Array
          rba_ArxmlGen_ImplDataTypeNumElements = 8
          rba_ArxmlGen_ImplDataTypeLongName = Implementation data type for Signals of type - uint8,sint8,boolean,uint8_n
          Com_Subimpl_u8 (rba_ArxmlGen_ImplDataTypeSub): rba_ArxmlGen_ImplDataTypeSubOwnRef=Com_impl_u8
        Com_SigBuf_au8 (rba_ArxmlGen_ApplDataType):
          rba_ArxmlGen_ApplDataTypeCategory = Array
          rba_ArxmlGen_ApplDataTypeNumElements = 8
          rba_ArxmlGen_ApplDataTypeLongName = Application data type for Signals of type - uint8,sint8,boolean,uint8_n
          rba_ArxmlGen_ApplDataTypeImplOwnRef = Com_SigBuf_au8_impl
          Com_Subapp_u8 (rba_ArxmlGen_ApplDataTypeSub): rba_ArxmlGen_ApplDataTypeSubOwnRef=Com_uint8
        Com_SigBuf_au16_impl (rba_ArxmlGen_ImplDataType):
          rba_ArxmlGen_ImplDataTypeCategory = Array
          rba_ArxmlGen_ImplDataTypeNumElements = 2
          rba_ArxmlGen_ImplDataTypeLongName = Implementation data type for Signals of type - uint16,sint16
          Com_Subimpl_u16 (rba_ArxmlGen_ImplDataTypeSub): rba_ArxmlGen_ImplDataTypeSubOwnRef=Com_impl_u16
        Com_SigBuf_au16 (rba_ArxmlGen_ApplDataType):
          rba_ArxmlGen_ApplDataTypeCategory = Array
          rba_ArxmlGen_ApplDataTypeNumElements = 2
          rba_ArxmlGen_ApplDataTypeLongName = Application data type for Signals of type - uint16,sint16
          rba_ArxmlGen_ApplDataTypeImplOwnRef = Com_SigBuf_au16_impl
          Com_Subapp_u16 (rba_ArxmlGen_ApplDataTypeSub): rba_ArxmlGen_ApplDataTypeSubOwnRef=Com_uint16
        Com_SigBuf_au32_impl (rba_ArxmlGen_ImplDataType):
          rba_ArxmlGen_ImplDataTypeCategory = Array
          rba_ArxmlGen_ImplDataTypeNumElements = 2
          rba_ArxmlGen_ImplDataTypeLongName = Implementation data type for Signals of type - uint32,sint32
          Com_Subimpl_u32 (rba_ArxmlGen_ImplDataTypeSub): rba_ArxmlGen_ImplDataTypeSubOwnRef=Com_impl_u32
        Com_SigBuf_au32 (rba_ArxmlGen_ApplDataType):
          rba_ArxmlGen_ApplDataTypeCategory = Array
          rba_ArxmlGen_ApplDataTypeNumElements = 2
          rba_ArxmlGen_ApplDataTypeLongName = Application data type for Signals of type - uint32,sint32
          rba_ArxmlGen_ApplDataTypeImplOwnRef = Com_SigBuf_au32_impl
          Com_Subapp_u32 (rba_ArxmlGen_ApplDataTypeSub): rba_ArxmlGen_ApplDataTypeSubOwnRef=Com_uint32
        3 x rba_ArxmlGen_Measurement, all with rba_ArxmlGen_MeasCategory=Array, rba_ArxmlGen_MeasDispFormat=%5.0f, rba_ArxmlGen_MeasAddrMethodRef=INTERNAL_VAR_CLEARED:
          Com_SigType_au8: rba_ArxmlGen_MeasLongName=Measurement variable for Signals of type - uint8,sint8,boolean,uint8_n. To refer Individual element in the Buffer array, Fetch Buffer Index from Com_PBcfg.c for each signal., rba_ArxmlGen_MeasApplDataTypeOwnRef=Com_SigBuf_au8
          Com_SigType_au16: rba_ArxmlGen_MeasLongName=Measurement variable for Signals of type - uint16,sint16. To refer Individual element in the Buffer array, Fetch Buffer Index from Com_PBcfg.c for each signal., rba_ArxmlGen_MeasApplDataTypeOwnRef=Com_SigBuf_au16
          Com_SigType_au32: rba_ArxmlGen_MeasLongName=Measurement variable for Signals of type - uint32,sint32. To refer Individual element in the Buffer array, Fetch Buffer Index from Com_PBcfg.c for each signal., rba_ArxmlGen_MeasApplDataTypeOwnRef=Com_SigBuf_au32
        5 x rba_ArxmlGen_ImplDataType, all with rba_ArxmlGen_ImplDataTypeCategory=Array:
          Com_implDataType_au8_Size1: rba_ArxmlGen_ImplDataTypeLongName=Implementation data type for Ipdu buffer of Size1, rba_ArxmlGen_ImplDataTypeNumElements=1
            Com_Subimpl1 (rba_ArxmlGen_ImplDataTypeSub): rba_ArxmlGen_ImplDataTypeSubOwnRef=Com_impl_u8
          Com_implDataType_au8_Size4: rba_ArxmlGen_ImplDataTypeLongName=Implementation data type for Ipdu buffer of Size4, rba_ArxmlGen_ImplDataTypeNumElements=4
            Com_Subimpl4 (rba_ArxmlGen_ImplDataTypeSub): rba_ArxmlGen_ImplDataTypeSubOwnRef=Com_impl_u8
          Com_implDataType_au8_Size7: rba_ArxmlGen_ImplDataTypeLongName=Implementation data type for Ipdu buffer of Size7, rba_ArxmlGen_ImplDataTypeNumElements=7
            Com_Subimpl7 (rba_ArxmlGen_ImplDataTypeSub): rba_ArxmlGen_ImplDataTypeSubOwnRef=Com_impl_u8
          Com_implDataType_au8_Size8: rba_ArxmlGen_ImplDataTypeLongName=Implementation data type for Ipdu buffer of Size8, rba_ArxmlGen_ImplDataTypeNumElements=8
            Com_Subimpl8 (rba_ArxmlGen_ImplDataTypeSub): rba_ArxmlGen_ImplDataTypeSubOwnRef=Com_impl_u8
          Com_implDataType_au8_Size534: rba_ArxmlGen_ImplDataTypeLongName=Implementation data type for Ipdu buffer of Size534, rba_ArxmlGen_ImplDataTypeNumElements=534
            Com_Subimpl534 (rba_ArxmlGen_ImplDataTypeSub): rba_ArxmlGen_ImplDataTypeSubOwnRef=Com_impl_u8
        5 x rba_ArxmlGen_ApplDataType, all with rba_ArxmlGen_ApplDataTypeCategory=Array:
          Com_applDataType_au8_Size1: rba_ArxmlGen_ApplDataTypeLongName=Application data type for Ipdu buffer of Size1, rba_ArxmlGen_ApplDataTypeNumElements=1, rba_ArxmlGen_ApplDataTypeImplOwnRef=Com_implDataType_au8_Size1
            Com_Subapp1 (rba_ArxmlGen_ApplDataTypeSub): rba_ArxmlGen_ApplDataTypeSubOwnRef=Com_uint8
          Com_applDataType_au8_Size4: rba_ArxmlGen_ApplDataTypeLongName=Application data type for Ipdu buffer of Size4, rba_ArxmlGen_ApplDataTypeNumElements=4, rba_ArxmlGen_ApplDataTypeImplOwnRef=Com_implDataType_au8_Size4
            Com_Subapp4 (rba_ArxmlGen_ApplDataTypeSub): rba_ArxmlGen_ApplDataTypeSubOwnRef=Com_uint8
          Com_applDataType_au8_Size7: rba_ArxmlGen_ApplDataTypeLongName=Application data type for Ipdu buffer of Size7, rba_ArxmlGen_ApplDataTypeNumElements=7, rba_ArxmlGen_ApplDataTypeImplOwnRef=Com_implDataType_au8_Size7
            Com_Subapp7 (rba_ArxmlGen_ApplDataTypeSub): rba_ArxmlGen_ApplDataTypeSubOwnRef=Com_uint8
          Com_applDataType_au8_Size8: rba_ArxmlGen_ApplDataTypeLongName=Application data type for Ipdu buffer of Size8, rba_ArxmlGen_ApplDataTypeNumElements=8, rba_ArxmlGen_ApplDataTypeImplOwnRef=Com_implDataType_au8_Size8
            Com_Subapp8 (rba_ArxmlGen_ApplDataTypeSub): rba_ArxmlGen_ApplDataTypeSubOwnRef=Com_uint8
          Com_applDataType_au8_Size534: rba_ArxmlGen_ApplDataTypeLongName=Application data type for Ipdu buffer of Size534, rba_ArxmlGen_ApplDataTypeNumElements=534, rba_ArxmlGen_ApplDataTypeImplOwnRef=Com_implDataType_au8_Size534
            Com_Subapp534 (rba_ArxmlGen_ApplDataTypeSub): rba_ArxmlGen_ApplDataTypeSubOwnRef=Com_uint8
        9 x rba_ArxmlGen_Measurement, all with rba_ArxmlGen_MeasCategory=Array, rba_ArxmlGen_MeasDispFormat=%5.0f, rba_ArxmlGen_MeasAddrMethodRef=INTERNAL_VAR_CLEARED:
          Com_dComIPdu_TCP_TXByte: rba_ArxmlGen_MeasLongName=Tx Ipdu buffer of IPdu -ComIPdu_TCP_TX- as a Measurement parameter, rba_ArxmlGen_MeasApplDataTypeOwnRef=Com_applDataType_au8_Size4
          Com_dComIPdu_UDP_TXByte: rba_ArxmlGen_MeasLongName=Tx Ipdu buffer of IPdu -ComIPdu_UDP_TX- as a Measurement parameter, rba_ArxmlGen_MeasApplDataTypeOwnRef=Com_applDataType_au8_Size534
          Com_dMCU_01_Can_Network_CANNODE_0Byte: rba_ArxmlGen_MeasLongName=Tx Ipdu buffer of IPdu -MCU_01_Can_Network_CANNODE_0- as a Measurement parameter, rba_ArxmlGen_MeasApplDataTypeOwnRef=Com_applDataType_au8_Size8
          Com_dMCU_02_Can_Network_CANNODE_0Byte: rba_ArxmlGen_MeasLongName=Tx Ipdu buffer of IPdu -MCU_02_Can_Network_CANNODE_0- as a Measurement parameter, rba_ArxmlGen_MeasApplDataTypeOwnRef=Com_applDataType_au8_Size7
          Com_dMCU_03_Can_Network_CANNODE_0Byte: rba_ArxmlGen_MeasLongName=Tx Ipdu buffer of IPdu -MCU_03_Can_Network_CANNODE_0- as a Measurement parameter, rba_ArxmlGen_MeasApplDataTypeOwnRef=Com_applDataType_au8_Size8
          Com_dComIPdu_TCP_RXByte: rba_ArxmlGen_MeasLongName=Rx Local Ipdu buffer of IPdu -ComIPdu_TCP_RX- as a Measurement parameter, rba_ArxmlGen_MeasApplDataTypeOwnRef=Com_applDataType_au8_Size4
          Com_dComIPdu_UDP_RXByte: rba_ArxmlGen_MeasLongName=Rx Local Ipdu buffer of IPdu -ComIPdu_UDP_RX- as a Measurement parameter, rba_ArxmlGen_MeasApplDataTypeOwnRef=Com_applDataType_au8_Size534
          Com_dHCU_01_Can_Network_CANNODE_0Byte: rba_ArxmlGen_MeasLongName=Rx Local Ipdu buffer of IPdu -HCU_01_Can_Network_CANNODE_0- as a Measurement parameter, rba_ArxmlGen_MeasApplDataTypeOwnRef=Com_applDataType_au8_Size8
          Com_dHCU_02_Can_Network_CANNODE_0Byte: rba_ArxmlGen_MeasLongName=Rx Local Ipdu buffer of IPdu -HCU_02_Can_Network_CANNODE_0- as a Measurement parameter, rba_ArxmlGen_MeasApplDataTypeOwnRef=Com_applDataType_au8_Size1
        SE_MainFunctionRx (rba_ArxmlGen_ExecEntity): rba_ArxmlGen_ExecEntityPeriod=0.01
        SE_MainFunctionTx (rba_ArxmlGen_ExecEntity): rba_ArxmlGen_ExecEntityPeriod=0.01
        4 x rba_ArxmlGen_Memsection:
          CODE: rba_ArxmlGen_MemsectionAddrMethodRef=CODE
          CONST: rba_ArxmlGen_MemsectionDatatype_UNSPECIFIED=true, rba_ArxmlGen_MemsectionAddrMethodRef=CONST
          CONFIG_DATA: rba_ArxmlGen_MemsectionDatatype_32=true, rba_ArxmlGen_MemsectionDatatype_UNSPECIFIED=true, rba_ArxmlGen_MemsectionAddrMethodRef=CONFIG_DATA
          VAR_CLEARED: rba_ArxmlGen_MemsectionDatatype_08=true, rba_ArxmlGen_MemsectionDatatype_16=true, rba_ArxmlGen_MemsectionDatatype_32=true, rba_ArxmlGen_MemsectionDatatype_64=true, rba_ArxmlGen_MemsectionDatatype_UNSPECIFIED=true, rba_ArxmlGen_MemsectionAddrMethodRef=VAR_CLEARED
  module config WdgIf
    WdgIfDevice: WdgIfDeviceIndex=0
