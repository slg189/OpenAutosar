AUTOSAR XML (schema 4-0-3)
package /AUTOSAR_ComM/BswModuleEntrys
  4 x bsw module entry, all with is-reentrant=false, is-synchronous=true, sw-service-impl-policy=STANDARD:
    ComM_Init: call-type=REGULAR, execution-context=UNSPECIFIED
    ComM_MainFunction_ComMChannel_Can_Network_Channel: call-type=SCHEDULED, execution-context=TASK
    ComM_MainFunction_ComMChannel_Can_Network_XCP_Channel: call-type=SCHEDULED, execution-context=TASK
    ComM_MainFunction_Eth_Network_Channel_EthernetCluster: call-type=SCHEDULED, execution-context=TASK
