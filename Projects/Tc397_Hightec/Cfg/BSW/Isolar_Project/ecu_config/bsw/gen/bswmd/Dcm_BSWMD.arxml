AUTOSAR XML (schema 4-2-2)
package /AUTOSAR_Dcm/ModeDeclarationGroups
  5 x mode declaration group, all with category=ALPHABETIC_ORDER:
    DcmDiagnosticSessionControl: initial-mode=DEFAULT_SESSION
      5 x mode:
        DEFAULT_SESSION
        PROGRAMMING_SESSION
        EXTENDED_DIAGNOSTIC_SESSION
        DevelopmentSession
        SupplierDiagnosticSession
    DcmEcuReset: initial-mode=NONE
      7 x mode:
        NONE
        HARD
        KEYONOFF
        SOFT
        JUMPTOBOOTLOADER
        JUMPTOSYSSUPPLIERBOOTLOADER
        EXECUTE
    DcmControlDTCSetting: initial-mode=ENABLEDTCSETTING
      mode ENABLEDTCSETTING
      mode DISABLEDTCSETTING
    DcmCommunicationControl_ComMChannel_Can_Network_Channel: initial-mode=DcmCommunicationControl_ComMChannel_Can_Network_Channel/DCM_ENABLE_RX_TX_NORM_NM
      12 x mode:
        DCM_ENABLE_RX_TX_NORM
        DCM_ENABLE_RX_DISABLE_TX_NORM
        DCM_DISABLE_RX_ENABLE_TX_NORM
        DCM_DISABLE_RX_TX_NORM
        DCM_ENABLE_RX_TX_NM
        DCM_ENABLE_RX_DISABLE_TX_NM
        DCM_DISABLE_RX_ENABLE_TX_NM
        DCM_DISABLE_RX_TX_NM
        DCM_ENABLE_RX_TX_NORM_NM
        DCM_ENABLE_RX_DISABLE_TX_NORM_NM
        DCM_DISABLE_RX_ENABLE_TX_NORM_NM
        DCM_DISABLE_RX_TX_NORM_NM
    DcmCommunicationControl_Eth_Network_Channel_EthernetCluster: initial-mode=DcmCommunicationControl_Eth_Network_Channel_EthernetCluster/DCM_ENABLE_RX_TX_NORM_NM
      12 x mode:
        DCM_ENABLE_RX_TX_NORM
        DCM_ENABLE_RX_DISABLE_TX_NORM
        DCM_DISABLE_RX_ENABLE_TX_NORM
        DCM_DISABLE_RX_TX_NORM
        DCM_ENABLE_RX_TX_NM
        DCM_ENABLE_RX_DISABLE_TX_NM
        DCM_DISABLE_RX_ENABLE_TX_NM
        DCM_DISABLE_RX_TX_NM
        DCM_ENABLE_RX_TX_NORM_NM
        DCM_ENABLE_RX_DISABLE_TX_NORM_NM
        DCM_DISABLE_RX_ENABLE_TX_NORM_NM
        DCM_DISABLE_RX_TX_NORM_NM
package /AUTOSAR_Dcm/ImplementationDataTypes
  impl type Dcm_Struct_Dcm_ConfigType: category=STRUCTURE, type-emitter=HEADER_FILE  # This is Dcm implementation specific internal type, i.e. it is declared in the Dcm Library and not in the XML.
    element ConfigSetId: implementation-data-type=uint8
package /AUTOSAR_Dcm/BswModuleEntrys
  18 x bsw module entry, all with is-synchronous=true, execution-context=TASK, sw-service-impl-policy=STANDARD:
    Dcm_MainFunction: service-id=37, is-reentrant=false, call-type=SCHEDULED
    Dcm_Init: service-id=0x01, is-reentrant=false, call-type=REGULAR  # This function initializes the Dcm module.
      sw service arg ConfigPtr: category=DATA_REFERENCE, direction=IN, sw-pointer-target-props={target-category=STRUCTURE, implementation-data-type=Dcm_Struct_Dcm_ConfigType, sw-impl-policy=CONST}  # (In)Pointer to configuration set in Variant Post-Build. This parameter is not relevant for Pre-compile configuration. "NULL_PTR" can be passed in case of Pre-compile configuration.
    Dcm_GetVersionInfo: service-id=0x24, is-reentrant=true, call-type=REGULAR  # This function returns the version information of the Dcm module.
      sw service arg versioninfo: category=DATA_REFERENCE, direction=OUT, sw-pointer-target-props={target-category=STRUCTURE, implementation-data-type=Std_VersionInfoType}  # Indicator as to where to store the version information of this module.
    Dcm_GetVin: service-id=0x07, is-reentrant=true, call-type=REGULAR  # Function to get the VIN (as defined in SAE J1979-DA).
      return type ReturnValue: direction=OUT, implementation-data-type=Std_ReturnType  # E_OK: The Data pointer has been filled with valid VIN E_NOT_OK: The default VIN will be used in the DoIP
      sw service arg Data: category=DATA_REFERENCE, direction=OUT, sw-pointer-target-props={target-category=VALUE, implementation-data-type=uint8}  # Indicator as to where to store the VIN.
    Dcm_GetSecurityLevel: service-id=0x0d, is-reentrant=true, call-type=REGULAR
      return type ReturnValue: direction=OUT, implementation-data-type=Std_ReturnType  # E_OK: This value is always returned.
      sw service arg SecLevel: category=DATA_REFERENCE, direction=OUT, sw-pointer-target-props={target-category=VALUE, implementation-data-type=Dcm_SecLevelType}  # Active Security Level value .
    Dcm_GetSesCtrlType: service-id=0x06, is-reentrant=true, call-type=REGULAR  # This function provides the active session control type value..
      return type ReturnValue: direction=OUT, implementation-data-type=Std_ReturnType  # E_OK: This value is always returned.
      sw service arg SesCtrlType: category=DATA_REFERENCE, direction=OUT, sw-pointer-target-props={target-category=VALUE, implementation-data-type=Dcm_SesCtrlType}  # Active Session Control Type value.
    Dcm_GetActiveProtocol: service-id=0x0f, is-reentrant=true, call-type=REGULAR  # This function returns the active UDS protocol details.
      return type ReturnValue: direction=OUT, implementation-data-type=Std_ReturnType  # E_OK: This value is always returned.
      sw service arg ActiveProtocolType: category=DATA_REFERENCE, direction=OUT, sw-pointer-target-props={target-category=VALUE, implementation-data-type=Dcm_ProtocolType}  # Active protocol type value.
      sw service arg ConnectionId: category=DATA_REFERENCE, direction=OUT, sw-pointer-target-props={target-category=VALUE, implementation-data-type=uint16}  # Unique connection identifier.
      sw service arg TesterSourceAddress: category=DATA_REFERENCE, direction=OUT, sw-pointer-target-props={target-category=VALUE, implementation-data-type=uint16}  # Source address of the tester.
    Dcm_ResetToDefaultSession: service-id=0x2a, is-reentrant=true, call-type=REGULAR  # The call to this function allows the application to reset the current session to Default session.
      return type ReturnValue: direction=OUT, implementation-data-type=Std_ReturnType  # E_OK: This value is always returned.
    Dcm_SetActiveDiagnostic: service-id=0x56, is-reentrant=true, call-type=REGULAR  # Allows to activate and deactivate the call of ComM_DCM_ActiveDiagnostic() function.
      return type ReturnValue: direction=OUT, implementation-data-type=Std_ReturnType  # E_OK: this value is always returned.
      sw service arg active: direction=IN, implementation-data-type=boolean  # If false Dcm shall not call ComM_DCM_ActiveDiagnostic(). If true Dcm will call ComM_DCM_ActiveDiagnostic().
    Dcm_StartOfReception: service-id=0x46, is-reentrant=true, call-type=CALLBACK  # This function is called at the start of receiving an N-SDU. The N-SDU might be fragmented into multiple N-PDUs (FF with one or more following CFs) or might consist of a single N-PDU (SF). The service shall provide the currently available maximum buffer size when invoked with TpSdu-Length equal to 0.
      return type ReturnValue: direction=OUT, implementation-data-type=BufReq_ReturnType  # BUFREQ_OK: Connection has been accepted. BUFREQ_E_NOT_OK: Connection has been rejected BUFREQ_E_OVFL: No buffer of the required length can be provided.
      4 x sw service arg:
        id: direction=IN, implementation-data-type=PduIdType  # ID of the received I-PDU.
        info: category=DATA_REFERENCE, direction=IN, sw-pointer-target-props={target-category=STRUCTURE, implementation-data-type=PduInfoType, sw-impl-policy=CONST}  # Contains the length (SduLength) of the received I-PDU and a pointer to a buffer (SduDataPtr) containing the I-PDU.
        TpSduLength: direction=IN, implementation-data-type=PduLengthType  # Total length of the N-SDU to be received.
        bufferSizePtr: category=DATA_REFERENCE, direction=OUT, sw-pointer-target-props={target-category=VALUE, implementation-data-type=PduLengthType}  # Available receive buffer in the receiving module.This parameter will be used to compute the Block Size (BS) in the transport protocol module.
    Dcm_CopyRxData: service-id=0x44, is-reentrant=true, call-type=CALLBACK  # This function is called to provide the received data of an I-PDU segment (N-PDU) to the upper layer. Each call to this function provides the next part of the I-PDU data. The size of the remaining buffer is written to the position indicated by bufferSizePtr.
      return type ReturnValue: direction=OUT, implementation-data-type=BufReq_ReturnType  # BUFREQ_OK: Connection has been accepted. BUFREQ_E_NOT_OK: Connection has been rejected.
      sw service arg id: direction=IN, implementation-data-type=PduIdType  # ID of the received I-PDU.
      sw service arg info: category=DATA_REFERENCE, direction=IN, sw-pointer-target-props={target-category=STRUCTURE, implementation-data-type=PduInfoType, sw-impl-policy=CONST}  # Contains the length (SduLength) of the received I-PDU and a pointer to a buffer (SduDataPtr) containing the I-PDU.
      sw service arg bufferSizePtr: category=DATA_REFERENCE, direction=OUT, sw-pointer-target-props={target-category=VALUE, implementation-data-type=PduLengthType}  # Available receive buffer after data has been copied.
    Dcm_TpRxIndication: service-id=0x45, is-reentrant=true, call-type=CALLBACK  # Called after an I-PDU has been received via the TP API, the result indicates whether the transmission was successful or not.
      sw service arg id: direction=IN, implementation-data-type=PduIdType  # ID of the received I-PDU.
      sw service arg result: direction=IN, implementation-data-type=Std_ReturnType  # Result of the reception.
    Dcm_CopyTxData: service-id=0x43, is-reentrant=true, call-type=CALLBACK  # This function is called to acquire the transmit data of an I-PDU segment (N-PDU). Each call to this function provides the next part of the I-PDU data unless retry->TpDataState is TP_DATARETRY. In this case the function restarts to copy the data beginning at the offset from the current position indicated by retry->TxTpDataCnt. The size of the remaining data is written to the position indicated by availableDataPtr.
      return type ReturnValue: direction=OUT, implementation-data-type=BufReq_ReturnType  # BUFREQ_OK: Data has been copied to the transmit buffer completely as requested. BUFREQ_E_NOT_OK: Data has not been copied. Request failed. BUFREQ_E_BUSY: Request could not be fulfilled, because the required amount of Tx data is not available.The lower layer module may retry this call later on. No data has been copied.
      4 x sw service arg:
        id: direction=IN, implementation-data-type=PduIdType  # ID of the received I-PDU.
        info: category=DATA_REFERENCE, direction=IN, sw-pointer-target-props={target-category=STRUCTURE, implementation-data-type=PduInfoType, sw-impl-policy=CONST}  # Contains the length (SduLength) of the received I-PDU and a pointer to a buffer (SduDataPtr) containing the I-PDU.
        retry: category=DATA_REFERENCE, direction=IN, sw-pointer-target-props={target-category=STRUCTURE, implementation-data-type=RetryInfoType, sw-impl-policy=CONST}  # This parameter is used to acknowledge transmitted data or to retransmit data after transmission problems.
        availableDataPtr: category=DATA_REFERENCE, direction=OUT, sw-pointer-target-props={target-category=VALUE, implementation-data-type=PduLengthType}  # Indicates the remaining number of bytes that are available in the upper layer modules Tx buffer.
    Dcm_TpTxConfirmation: service-id=0x48, is-reentrant=true, call-type=CALLBACK  # Called after an I-PDU has been transmitted via the TP API, the result indicates whether the transmission was successful or not.
      sw service arg id: direction=IN, implementation-data-type=PduIdType  # ID of the received I-PDU.
      sw service arg result: direction=IN, implementation-data-type=Std_ReturnType  # Result of the reception.
    Dcm_TxConfirmation: service-id=0x40, is-reentrant=true, call-type=CALLBACK  # The lower layer communication interface module confirms the transmission of a PDU, or the failure to transmit a PDU.
      sw service arg TxPduId: direction=IN, implementation-data-type=PduIdType  # ID of the PDU that has been transmitted.
      sw service arg result: direction=IN, implementation-data-type=Std_ReturnType  # E_OK: The PDU was transmitted. E_NOT_OK: Transmission of the PDU failed.
    Dcm_ComM_NoComModeEntered: service-id=0x21, is-reentrant=true, call-type=CALLBACK  # This call informs the Dcm module about a ComM mode change to COMM_NO_COMMUNICATION.
      sw service arg NetworkId: direction=IN, implementation-data-type=uint8  # Identifier of the network concerned by the mode change.
    Dcm_ComM_SilentComModeEntered: service-id=0x22, is-reentrant=true, call-type=CALLBACK  # This call informs the Dcm module about a ComM mode change to COMM_SILENT_COMMUNICATION.
      sw service arg NetworkId: direction=IN, implementation-data-type=uint8  # Identifier of the network concerned by the mode change.
    Dcm_ComM_FullComModeEntered: service-id=0x23, is-reentrant=true, call-type=CALLBACK  # This call informs the Dcm module about a ComM mode change to COMM_FULL_COMMUNICATION.
      sw service arg NetworkId: direction=IN, implementation-data-type=uint8  # Identifier of the network concerned by the mode change.
package /AUTOSAR_Dcm/BswModuleDescriptions
  bsw module description Dcm: category=BSW_MODULE, module-id=53, provided-entrys=Dcm_MainFunction
    provided-mode-groups:
      5 x mode declaration group prototype:
        DcmDiagnosticSessionControl: type=DcmDiagnosticSessionControl
        DcmEcuReset: type=DcmEcuReset
        DcmControlDTCSetting: type=DcmControlDTCSetting
        DcmCommunicationControl_ComMChannel_Can_Network_Channel: type=DcmCommunicationControl_ComMChannel_Can_Network_Channel
        DcmCommunicationControl_Eth_Network_Channel_EthernetCluster: type=DcmCommunicationControl_Eth_Network_Channel_EthernetCluster
    required-mode-groups:
      mode declaration group prototype R_DcmCommunicationControl_ComMChannel_Can_Network_Channel: type=DcmCommunicationControl_ComMChannel_Can_Network_Channel
      mode declaration group prototype R_DcmCommunicationControl_Eth_Network_Channel_EthernetCluster: type=DcmCommunicationControl_Eth_Network_Channel_EthernetCluster
    bsw internal behavior BswInternalBehavior: data-type-mapping=[DTS_DcmDiagnosticSessionControl, DTS_DcmEcuReset, DTS_DcmControlDTCSetting, DTS_DcmCommunicationControl_ComMChannel_Can_Network_Channel, DTS_DcmCommunicationControl_Eth_Network_Channel_EthernetCluster]
      17 x bsw called entity:
        CE_Dcm_Init: implemented-entry=Dcm_Init
        CE_Dcm_GetVersionInfo: implemented-entry=Dcm_GetVersionInfo
        CE_Dcm_GetVin: implemented-entry=Dcm_GetVin
        CE_Dcm_GetSecurityLevel: implemented-entry=Dcm_GetSecurityLevel
        CE_Dcm_GetSesCtrlType: implemented-entry=Dcm_GetSesCtrlType
        CE_Dcm_GetActiveProtocol: implemented-entry=Dcm_GetActiveProtocol
        CE_Dcm_ResetToDefaultSession: implemented-entry=Dcm_ResetToDefaultSession
        CE_Dcm_SetActiveDiagnostic: implemented-entry=Dcm_SetActiveDiagnostic
        CE_Dcm_StartOfReception: implemented-entry=Dcm_StartOfReception
        CE_Dcm_CopyRxData: implemented-entry=Dcm_CopyRxData
        CE_Dcm_TpRxIndication: implemented-entry=Dcm_TpRxIndication
        CE_Dcm_CopyTxData: implemented-entry=Dcm_CopyTxData
        CE_Dcm_TxConfirmation: implemented-entry=Dcm_TxConfirmation
        CE_Dcm_TpTxConfirmation: implemented-entry=Dcm_TpTxConfirmation
        CE_Dcm_ComM_NoComModeEntered: implemented-entry=Dcm_ComM_NoComModeEntered
        CE_Dcm_ComM_SilentComModeEntered: implemented-entry=Dcm_ComM_SilentComModeEntered
        CE_Dcm_ComM_FullComModeEntered: implemented-entry=Dcm_ComM_FullComModeEntered
      bsw schedulable entity BSWSE_DcmMainFunction: implemented-entry=Dcm_MainFunction
        accessed-mode-groups:
          R_DcmCommunicationControl_ComMChannel_Can_Network_Channel
          R_DcmCommunicationControl_Eth_Network_Channel_EthernetCluster
        managed-mode-groups:
          DcmDiagnosticSessionControl
          DcmEcuReset
          DcmControlDTCSetting
          DcmCommunicationControl_ComMChannel_Can_Network_Channel
          DcmCommunicationControl_Eth_Network_Channel_EthernetCluster
      mode-sender-policys:
        provided-mode-group=DcmDiagnosticSessionControl, queue-length=1
        provided-mode-group=DcmEcuReset, queue-length=1
        provided-mode-group=DcmControlDTCSetting, queue-length=1
        provided-mode-group=DcmCommunicationControl_ComMChannel_Can_Network_Channel, queue-length=1
        provided-mode-group=DcmCommunicationControl_Eth_Network_Channel_EthernetCluster, queue-length=1
package /AUTOSAR_Dcm/BswImplementations
  bsw implementation Dcm: programming-language=C, swc-bsw-mapping=SwcBswMappings, ar-release-version=4.2.2, behavior=BswInternalBehavior
    code-descriptors:
      code CodeDescriptor: artifact-descriptors=autosar-engineering-object={short-label=ArEngObject, category=SWSRC}
    resource consumption Dcm_ResourceConsumption
      21 x memory section:
        DCM_CODE: prefix=DCM, sw-addrmethod=CODE, symbol=CODE
        DCM_CONST_UNSPECIFIED: prefix=DCM, sw-addrmethod=CONST, symbol=CONST_UNSPECIFIED
        DCM_CONST_8: prefix=DCM, sw-addrmethod=CONST, symbol=CONST_8
        DCM_CONST_16: prefix=DCM, sw-addrmethod=CONST, symbol=CONST_16
        DCM_CONST_32: prefix=DCM, sw-addrmethod=CONST, symbol=CONST_32
        DCM_VAR_INIT_8: prefix=DCM, sw-addrmethod=VAR_INIT, symbol=VAR_INIT_8
        DCM_VAR_INIT_16: prefix=DCM, sw-addrmethod=VAR_INIT, symbol=VAR_INIT_16
        DCM_VAR_INIT_32: prefix=DCM, sw-addrmethod=VAR_INIT, symbol=VAR_INIT_32
        DCM_VAR_INIT_BOOLEAN: prefix=DCM, sw-addrmethod=VAR_INIT, symbol=VAR_INIT_BOOLEAN
        DCM_VAR_CLEARED_UNSPECIFIED: prefix=DCM, sw-addrmethod=VAR_CLEARED, symbol=VAR_CLEARED_UNSPECIFIED
        DCM_VAR_CLEARED_BOOLEAN: prefix=DCM, sw-addrmethod=VAR_CLEARED, symbol=VAR_CLEARED_BOOLEAN
        DCM_VAR_CLEARED_8: prefix=DCM, sw-addrmethod=VAR_CLEARED, symbol=VAR_CLEARED_8
        DCM_VAR_CLEARED_16: prefix=DCM, sw-addrmethod=VAR_CLEARED, symbol=VAR_CLEARED_16
        DCM_VAR_CLEARED_32: prefix=DCM, sw-addrmethod=VAR_CLEARED, symbol=VAR_CLEARED_32
        DCM_VAR_POWER_ON_CLEARED_UNSPECIFIED: prefix=DCM, sw-addrmethod=VAR_POWER_ON_CLEARED, symbol=VAR_POWER_ON_CLEARED_UNSPECIFIED
        DCM_VAR_POWER_ON_CLEARED_BOOLEAN: prefix=DCM, sw-addrmethod=VAR_POWER_ON_CLEARED, symbol=VAR_POWER_ON_CLEARED_BOOLEAN
        DCM_VAR_POWER_ON_CLEARED_8: prefix=DCM, sw-addrmethod=VAR_POWER_ON_CLEARED, symbol=VAR_POWER_ON_CLEARED_8
        DCM_VAR_POWER_ON_CLEARED_16: prefix=DCM, sw-addrmethod=VAR_POWER_ON_CLEARED, symbol=VAR_POWER_ON_CLEARED_16
        DCM_VAR_POWER_ON_CLEARED_32: prefix=DCM, sw-addrmethod=VAR_POWER_ON_CLEARED, symbol=VAR_POWER_ON_CLEARED_32
        DCM_VAR_INIT_UNSPECIFIED: prefix=DCM, sw-addrmethod=VAR_INIT, symbol=VAR_INIT_UNSPECIFIED
        Dcm_CODE: prefix=Dcm, sw-addrmethod=CODE, symbol=CODE
      section name prefix DCM
      section name prefix Dcm
