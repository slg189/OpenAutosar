AUTOSAR XML (schema 4-2-2)
package /AUTOSAR_Dcm/BswModuleDescriptions
  bsw module description Dcm
    bsw internal behavior BswInternalBehavior
      bsw timing event EV_Dcm_MainFunction: starts-on-event=BSWSE_DcmMainFunction, period=0.001
