AUTOSAR XML (schema 4-2-2)
package /AUTOSAR_Dem/BswImplementations
  bsw implementation Dem: programming-language=C, sw-version=9.0.0, swc-bsw-mapping=SwcBswMappings, vendor-id=6, ar-release-version=4.2.2, behavior=IB_Dem
    code-descriptors:
      code CodeDescriptor: artifact-descriptors=autosar-engineering-object={short-label=ArEngObject, category=SWSRC}
    resource consumption Dem_ResourceConsumption
      6 x memory section:
        DEM_VAR_CLEARED: prefix=DEM, sw-addrmethod=VAR_CLEARED, symbol=VAR_CLEARED
        DEM_VAR_INIT: prefix=DEM, sw-addrmethod=VAR_INIT, symbol=VAR_INIT
        DEM_CONST: prefix=DEM, sw-addrmethod=CONST, symbol=CONST
        DEM_CODE: prefix=DEM, sw-addrmethod=CODE, symbol=CODE
        Dem_CODE: prefix=Dem, sw-addrmethod=CODE, symbol=CODE
        DEM_VAR_SAVED_ZONE: prefix=DEM, sw-addrmethod=VAR_SAVED_ZONE, symbol=VAR_SAVED_ZONE
      section name prefix DEM
      section name prefix Dem
package /AUTOSAR_Dem/BswModuleDescriptions
  bsw module description Dem: category=BSW_MODULE, module-id=54, provided-entrys=Dem_MainFunction
    bsw internal behavior IB_Dem
      bsw schedulable entity BSWSE_DemMainFunction: implemented-entry=Dem_MainFunction
      bsw timing event EV_MainFunction: starts-on-event=BSWSE_DemMainFunction, period=0.001
package /AUTOSAR_Dem/BswModuleEntrys
  bsw module entry Dem_MainFunction: is-reentrant=false, is-synchronous=true, call-type=SCHEDULED, execution-context=TASK, sw-service-impl-policy=STANDARD
