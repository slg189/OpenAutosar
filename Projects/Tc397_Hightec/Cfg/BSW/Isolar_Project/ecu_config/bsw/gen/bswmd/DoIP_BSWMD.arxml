AUTOSAR XML (schema 4-2-2)
package /AUTOSAR_DoIP/BswModuleEntrys
  17 x bsw module entry:
    DoIP_GetVersionInfo  # Returns the version information of this module.
    DoIP_IfCancelTransmit  # Requests cancellation of an ongoing transmission of an I-PDU in a lower layer communication interface module.
    DoIP_IfTransmit  # Requests transmission of an I-PDU.
    DoIP_Init  # This service initializes all global variables of the DoIP module. After return of this service the DoIP module is operational.
    DoIP_LocalIpAddrAssignmentChg  # This function gets called by the SoAd if an IP address assignment related to a socket connection changes (i.e. new address assigned or assigned address becomes invalid).
    DoIP_MainFunction: is-reentrant=false, is-synchronous=true, call-type=SCHEDULED, execution-context=TASK, sw-service-impl-policy=STANDARD  # Schedules the Diagnostic over IP module. (Entry point for scheduling)
    DoIP_SoAdIfRxIndication  # Indication of a received I-PDU from a lower layer communication interface module.
    DoIP_SoAdIfTxConfirmation  # The lower layer communication interface module confirms the transmission of an I-PDU.
    DoIP_SoAdTpCopyRxData  # This function is called to provide the received data of an I-PDU segment (N-PDU) to the upper layer. Each call to this function provides the next part of the I-PDU data. The size of the remaining data is written to the position indicated by bufferSizePtr.
    DoIP_SoAdTpCopyTxData  # This function is called to acquire the transmit data of an I-PDU segment (N-PDU). Each call to this function provides the next part of the I-PDU data unless retry->TpDataState is TP_DATARETRY. In this case the function restarts to copy the data beginning at the offset from the current position indicated by retry->TxTpDataCnt. The size of the remaining data is written to the position indicated by availableDataPtr.
    DoIP_SoAdTpRxIndication  # Called after an I-PDU has been received via the TP API, the result indicates whether the transmission was successful or not.
    DoIP_SoAdTpStartOfReception  # This function is called at the start of receiving an N-SDU. The N-SDU might be fragmented into multiple N-PDUs (FF with one or more following CFs) or might consist of a single N-PDU (SF).
    DoIP_SoAdTpTxConfirmation  # This function is called after the I-PDU has been transmitted on its network, the result indicates whether the transmission was successful or not.
    DoIP_SoConModeChg  # Notification about a SoAd socket connection state change, e.g. socket connection gets online
    DoIP_TpCancelReceive  # By calling this API with the corresponding DoIPPduRRxId the currently ongoing data reception is terminated immediately. When the function returns, no reception is in progress anymore with the given DoIPPduRRxId identifier.
    DoIP_TpCancelTransmit  # This service primitive is used to cancel the transfer of pending DoIPPduRTxIds. The connection is identified by DoIPPduRTxId. When the function returns, no transmission is in progress anymore with the given DoIPPduRTxId identifier.
    DoIP_TpTransmit  # This service is called to request the transfer data from the PduRouter to the SoAd. It is used to indicate the transmission which will be performed in the DoIP_Mainfunction. | Within the provided DoIPPduRTxInfoPtr only SduLength is valid (no data)!If this function returns E_OK then the DoIP module will raise a subsequent call to PduR_DoIPCopyTxData in order to get the data to send.
package /AUTOSAR_DoIP/BswModuleDescriptions
  bsw module description DoIP: category=BSW_MODULE, module-id=173, provided-entrys=DoIP_MainFunction
    bsw internal behavior IB_DoIP
      bsw schedulable entity BSWSE_DoIPMainFunction: implemented-entry=DoIP_MainFunction
package /AUTOSAR_DoIP/BswImplementations
  bsw implementation DoIP: programming-language=C, sw-version=9.0.0, vendor-id=6, ar-release-version=4.2.2, behavior=IB_DoIP
    code-descriptors:
      code CodeDescriptor: artifact-descriptors=autosar-engineering-object={short-label=ArEngObject, category=SWSRC}
    resource consumption DoIP_ResourceConsumption
      8 x memory section:
        DOIP_VAR_CLEARED: prefix=DOIP, sw-addrmethod=VAR_CLEARED, symbol=VAR_CLEARED
        DOIP_VAR_INIT: prefix=DOIP, sw-addrmethod=VAR_INIT, symbol=VAR_INIT
        DOIP_CONST: prefix=DOIP, sw-addrmethod=CONST, symbol=CONST
        DOIP_CODE: prefix=DOIP, sw-addrmethod=CODE, symbol=CODE
        DoIP_CODE: prefix=DoIP, sw-addrmethod=CODE, symbol=CODE
        DOIP_CONFIG_CODE_POSTBUILD: prefix=DOIP, sw-addrmethod=CODE, symbol=CONFIG_CODE_POSTBUILD
        DOIP_CONFIG_DATA_POSTBUILD_UNSPECIFIED: prefix=DOIP, sw-addrmethod=CONFIG_DATA_POSTBUILD, symbol=CONFIG_DATA_POSTBUILD_UNSPECIFIED
        DOIP_CONFIG_DATA_UNSPECIFIED: prefix=DOIP, sw-addrmethod=CONFIG_DATA, symbol=CONFIG_DATA_UNSPECIFIED
      section name prefix DOIP
      section name prefix DoIP
