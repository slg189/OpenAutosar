AUTOSAR XML (schema 4-2-2)
package /AUTOSAR_DoIP/BswModuleDescriptions
  bsw module description DoIP
    bsw internal behavior IB_DoIP
      bsw timing event EV_DoIP_MainFunction: starts-on-event=BSWSE_DoIPMainFunction, period=0.01
