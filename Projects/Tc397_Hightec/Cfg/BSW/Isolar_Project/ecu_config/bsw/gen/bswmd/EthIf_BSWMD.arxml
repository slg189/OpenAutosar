AUTOSAR XML (schema 4-0-3)
package /AUTOSAR_EthIf/BswModuleDescriptions
  bsw module description EthIf: category=BSW_MODULE, module-id=65, outgoing-callbacks=[EthIf_RxIndication, EthIf_TxConfirmation, EthIf_TrcvModeIndication, EthIf_SwitchPortModeIndication]  # Ethernet Interface
    provided-entrys:
      EthIf_GetControllerMode
      EthIf_GetCurrentTime
      EthIf_EnableEgressTimeStamp
      EthIf_GetEgressTimeStamp
      EthIf_GetIngressTimeStamp
      EthIf_GetPhysAddr
      EthIf_SetPhysAddr
      EthIf_SwitchPortGroupRequestMode
      EthIf_StartAllPorts
      EthIf_GetVersionInfo
      EthIf_Init
      EthIf_MainFunctionRx_EthIfPhysCtrlRxMainFunctionPriorityProcessing
      EthIf_MainFunctionTx
      EthIf_MainFunctionState
      EthIf_ProvideTxBuffer
      EthIf_SetControllerMode
      EthIf_Transmit
      EthIf_UpdatePhysAddrFilter
      EthIf_GetVlanId
package /AUTOSAR_EthIf/BswModuleEntrys
  23 x bsw module entry, all with sw-service-impl-policy=STANDARD:
    EthIf_GetControllerMode: is-reentrant=false, is-synchronous=true, call-type=REGULAR, execution-context=UNSPECIFIED  # This service obtains the state of the indexed controller | Obtains the state of the indexed controller
      return type ReturnValue: direction=OUT, implementation-data-type=Std_ReturnType  # E_OK: success E_NOT_OK: controller could not be initialized
      sw service arg CtrlIdx: direction=IN, implementation-data-type=uint8  # Index of the Ethernet controller within the context of the Ethernet Interface
      sw service arg CtrlModePtr: category=DATA_REFERENCE, direction=OUT, sw-pointer-target-props={target-category=VALUE, implementation-data-type=Eth_ModeType}  # ETHCTRL_MODE_DOWN: the controller is disabled ETHCTRL_MODE_ACTIVE: the controller is enabled
    EthIf_GetCurrentTime: is-reentrant=false, is-synchronous=false, call-type=REGULAR, execution-context=UNSPECIFIED  # This service returns a time value out of the HW registers according to the capability of the HW | Returns a time value out of the HW registers according to the capability of the HW. Is the HW resolution is lower than the Eth_TimeStampType resolution resp. range, than an the remaining bits will be filled with 0
      return type ReturnValue: direction=OUT, implementation-data-type=Std_ReturnType  # E_OK: success; E_NOT_OK: failed to get the current time
      sw service arg CtrlIdx: direction=IN, implementation-data-type=uint8  # Index of EthIf controller.
      sw service arg timeQualPtr: category=DATA_REFERENCE, direction=OUT, sw-pointer-target-props={target-category=VALUE, implementation-data-type=Eth_TimeStampQualType}  # quality of HW time stamp, e.g. based on current drift.
      sw service arg timeStampPtr: category=DATA_REFERENCE, direction=OUT, sw-pointer-target-props={target-category=VALUE, implementation-data-type=Eth_TimeStampType}  # current time stamp
    EthIf_EnableEgressTimeStamp: is-reentrant=false, is-synchronous=false, call-type=REGULAR, execution-context=UNSPECIFIED  # This service activates egress time stamping on a dedicated message object. | Activates egress time stamping on a dedicated message object. Some HW does store once the egress time stamp marker and some HW needs it always before transmission. There will be no "disable" functionality, due to the fact, that the message type is always "time stamped" by network design.
      sw service arg CtrlIdx: direction=IN, implementation-data-type=uint8  # Index of EthIf controller
      sw service arg BufIdx: direction=IN, implementation-data-type=uint8  # Index of the message buffer, where Application expects egress time stamping
    EthIf_GetEgressTimeStamp: is-reentrant=false, is-synchronous=false, call-type=REGULAR, execution-context=UNSPECIFIED  # This service reads back the egress time stamp on a dedicated message object. | Reads back the egress time stamp on a dedicated message object. EthIf_GetEgressTimeStamp() API must be called by the UL of EthIf within the UL_TxConfirmation() callback function.
      4 x sw service arg:
        CtrlIdx: direction=IN, implementation-data-type=uint8  # Index of EthIf controller.
        BufIdx: direction=IN, implementation-data-type=uint8  # Index of the message buffer, where Application expects egress time stamping
        timeQualPtr: category=DATA_REFERENCE, direction=OUT, sw-pointer-target-props={target-category=VALUE, implementation-data-type=Eth_TimeStampQualType}  # quality of HW time stamp, e.g. based on current drift
        timeStampPtr: category=DATA_REFERENCE, direction=OUT, sw-pointer-target-props={target-category=VALUE, implementation-data-type=Eth_TimeStampType}  # current time stamp
    EthIf_GetIngressTimeStamp: is-reentrant=false, is-synchronous=false, call-type=REGULAR, execution-context=UNSPECIFIED  # This service reads back the ingress time stamp on a dedicated message object. | Reads back the ingress time stamp on a dedicated message object. It must be called within the RxIndication() function.
      4 x sw service arg:
        CtrlIdx: direction=IN, implementation-data-type=uint8  # Index of EthIf controller.
        DataPtr: category=DATA_REFERENCE, direction=IN, sw-pointer-target-props={target-category=VALUE, implementation-data-type=Eth_DataType}  # Pointer to the message buffer, where Application expects ingress time stamping
        timeQualPtr: category=DATA_REFERENCE, direction=OUT, sw-pointer-target-props={target-category=VALUE, implementation-data-type=Eth_TimeStampQualType}  # quality of HW time stamp, e.g. based on current drift.
        timeStampPtr: category=DATA_REFERENCE, direction=OUT, sw-pointer-target-props={target-category=VALUE, implementation-data-type=Eth_TimeStampType}  # current time stamp
    EthIf_GetPhysAddr: is-reentrant=false, is-synchronous=true, call-type=REGULAR, execution-context=UNSPECIFIED  # This service obtains the physical source address used by the indexed controller | Obtains the physical source address used by the indexed controller
      sw service arg CtrlIdx: direction=IN, implementation-data-type=uint8  # Index of the EthIfController within the context of the Ethernet Interface
      sw service arg PhysAddrPtr: category=DATA_REFERENCE, direction=OUT, sw-pointer-target-props={target-category=VALUE, implementation-data-type=uint8}  # Physical source address (MAC address) in network byte order.
    EthIf_SetPhysAddr: is-reentrant=false, is-synchronous=true, call-type=REGULAR, execution-context=UNSPECIFIED  # This service sets the physical source address used by the indexed controller if it is not in active state | Sets the physical source address used by the indexed controller
      sw service arg CtrlIdx: direction=IN, implementation-data-type=uint8  # Index of the EthIfPhysController within the context of the Ethernet Interface
      sw service arg PhysAddrPtr: category=DATA_REFERENCE, direction=IN, sw-pointer-target-props={target-category=VALUE, implementation-data-type=uint8}  # Physical source address (MAC address) in network byte order.
    EthIf_StartAllPorts: is-reentrant=true, is-synchronous=true, call-type=REGULAR, execution-context=UNSPECIFIED  # This service requests to start all switch ports that belong to PNC port groups. | Request to start all switch ports, which are not in a port group referenced by EthIfController.
      return type ReturnValue: direction=OUT, implementation-data-type=Std_ReturnType  # E_OK: success. E_NOT_OK: port could not be activated.
    EthIf_GetVersionInfo: is-reentrant=true, is-synchronous=true, call-type=REGULAR, execution-context=UNSPECIFIED  # This service returns the version information of this module | Returns the version information of this module
      sw service arg VersionInfoPtr: category=DATA_REFERENCE, direction=OUT, sw-pointer-target-props={target-category=VALUE, implementation-data-type=Std_VersionInfoType}  # Version information of this module
    EthIf_Init: is-reentrant=false, is-synchronous=true, call-type=REGULAR, execution-context=UNSPECIFIED  # This service initializes the Ethernet Interface | Initializes the Ethernet Interface
      sw service arg CfgPtr: category=DATA_REFERENCE, direction=IN, sw-pointer-target-props={target-category=VALUE, implementation-data-type=EthIf_ConfigType, sw-impl-policy=CONST}  # Points to the implementation specific structure
    EthIf_MainFunctionRx_EthIfPhysCtrlRxMainFunctionPriorityProcessing: is-reentrant=false, is-synchronous=true, call-type=SCHEDULED, execution-context=TASK  # This service is a cyclic main function to check for new received frames in polling mode. | The function checks for new received frames in polling mode for the FIFO EthCtrlConfigIngressFifo belonging to the EthCtrl EthernetCommunicationController.
    EthIf_MainFunctionTx: is-reentrant=false, is-synchronous=true, call-type=SCHEDULED, execution-context=TASK  # This service is a cyclic main function which issues transmission confirmations in polling mode. | The function issues transmission confirmations in polling mode.
    EthIf_MainFunctionState: is-reentrant=false, is-synchronous=true, call-type=SCHEDULED, execution-context=TASK  # This service is a cyclic main function that operates the effects of the EthIf state machine and polls link state of used hardware. | The function operates the effects of the EthIf state machine and polls the link state of the used communication hardware (Ethernet transceiver, Ethernet switch ports).
    EthIf_ProvideTxBuffer: is-reentrant=false, is-synchronous=true, call-type=REGULAR, execution-context=UNSPECIFIED  # This service provides access to a transmit buffer of the specified Ethernet controller. | Provides access to a transmit buffer of the specified Ethernet controller.
      return type ReturnValue: direction=OUT, implementation-data-type=BufReq_ReturnType  # BUFREQ_OK: success BUFREQ_E_NOT_OK: development error detected BUFREQ_E_BUSY: all buffers in use.
      6 x sw service arg:
        CtrlIdx: direction=IN, implementation-data-type=uint8  # Index of the Ethernet controller within the context of the Ethernet Interface
        FrameType: direction=IN, implementation-data-type=Eth_FrameType  # Ethernet Frame Type (EtherType)
        Priority: direction=IN, implementation-data-type=uint8  # Priority value which shall be used for the 3-bit PCP field of the VLAN tag
        BufIdxPtr: category=DATA_REFERENCE, direction=OUT, sw-pointer-target-props={target-category=VALUE, implementation-data-type=uint8}  # Index to the granted buffer resource. To be used for subsequent requests
        BufPtr: category=DATA_REFERENCE, direction=OUT, sw-pointer-target-props={target-category=VALUE, implementation-data-type=uint8}  # Pointer to the granted buffer
        LenBytePtr: category=DATA_REFERENCE, direction=INOUT, sw-pointer-target-props={target-category=VALUE, implementation-data-type=uint16}  # in: desired length in bytes, out: granted length in bytes
    EthIf_RxIndication: is-reentrant=true, is-synchronous=true, call-type=CALLBACK, execution-context=UNSPECIFIED  # This service handles a received frame received by the indexed controller | Handles a received frame received by the indexed controller
      6 x sw service arg, all with direction=IN:
        CtrlIdx: implementation-data-type=uint8  # Index of the Ethernet controller within the context of the Ethernet Interface
        FrameType: implementation-data-type=Eth_FrameType  # Frame type of received Ethernet frame
        IsBroadcast: implementation-data-type=boolean  # parameter to indicate a broadcast frame
        PhysAddrPtr: category=DATA_REFERENCE, sw-pointer-target-props={target-category=VALUE, implementation-data-type=uint8}  # Pointer to Physical source address (MAC address in network byte order) of received Ethernet frame
        DataPtr: category=DATA_REFERENCE, sw-pointer-target-props={target-category=VALUE, implementation-data-type=Eth_DataType}  # Pointer to payload of received Ethernet frame.
        LenByte: implementation-data-type=uint16  # Length of the received frame bytes
    EthIf_SetControllerMode: is-reentrant=false, is-synchronous=true, call-type=REGULAR, execution-context=UNSPECIFIED  # This service enables / disables the indexed controller | Enables / disables the indexed controller
      return type ReturnValue: direction=OUT, implementation-data-type=Std_ReturnType  # E_OK: success E_NOT_OK: controller mode could not be changed
      sw service arg CtrlIdx: direction=IN, implementation-data-type=uint8  # Index of the Ethernet controller within the context of the Ethernet Interface
      sw service arg CtrlMode: direction=IN, implementation-data-type=Eth_ModeType  # ETHCTRL_MODE_DOWN: disable the controller ETHCTRL_MODE_ACTIVE: enable the controller
    EthIf_SwitchPortGroupRequestMode: is-reentrant=false, is-synchronous=true, call-type=REGULAR, execution-context=UNSPECIFIED  # This service requests a mode for the EthIfSwtPortGroup. | The request forwarded to EthSwt by calling EthSwt_SetSwitchPortMode() API for all EthSwtPorts referenced by the port group.
      return type ReturnValue: direction=OUT, implementation-data-type=Std_ReturnType  # E_OK: success E_NOT_OK: port group mode could not be changed
      sw service arg PortGroupIdx: direction=IN, implementation-data-type=EthIf_SwitchPortGroupIdxType  # Index of the port group within the context of the Ethernet Interface
      sw service arg PortMode: direction=IN, implementation-data-type=EthTrcv_ModeType  # ETHTRCV_MODE_DOWN: disable the port group. ETHTRCV_MODE_ACTIVE: enable the port group.
    EthIf_Transmit: is-reentrant=false, is-synchronous=true, call-type=REGULAR, execution-context=UNSPECIFIED  # This service triggers transmission of a previously filled transmit buffer | Triggers transmission of a previously filled transmit buffer
      return type ReturnValue: direction=OUT, implementation-data-type=Std_ReturnType  # E_OK: success E_NOT_OK: transmission failed
      6 x sw service arg, all with direction=IN:
        CtrlIdx: implementation-data-type=uint8  # Index of the Ethernet controller within the context of the Ethernet Interface
        BufIdx: implementation-data-type=uint8  # Index of the buffer resource
        FrameType: implementation-data-type=Eth_FrameType  # Ethernet frame type
        TxConfirmation: implementation-data-type=boolean  # Activates transmission confirmation
        LenByte: implementation-data-type=uint16  # Data length in byte
        PhysAddrPtr: category=DATA_REFERENCE, sw-pointer-target-props={target-category=VALUE, implementation-data-type=uint8}  # Physical target address (MAC address) in network byte order
    EthIf_TrcvModeIndication: is-reentrant=true, is-synchronous=false, call-type=CALLBACK, execution-context=UNSPECIFIED  # This service indicates EthIf that there is a mode change in the transceiver. | Called asynchronously when mode has been read out. Triggered by previous EthTrcv_SetTransceiverMode call. Can directly be called within the trigger functions.
      sw service arg TrcvIdx: direction=IN, implementation-data-type=uint8  # Index of the Ethernet transceiver within the context of the Ethernet Interface.
      sw service arg TrcvMode: direction=IN, implementation-data-type=EthTrcv_ModeType  # Notified Ethernet transceiver mode.
    EthIf_SwitchPortModeIndication: is-reentrant=false, is-synchronous=false, call-type=CALLBACK, execution-context=UNSPECIFIED  # This service is called by EthSwt, if the port mode changes for a particular port of the switch. | The EthIf shall determine the expected notifications based on the EthSwtPort configuration. In case the EthSwtPort references an EthTrcv the EthIf expects a notification from the EthTrcv via API EthIf_TrcvModeIndication(). Otherwise the EthIf expects a notification from the EthSwt via API EthIf_SwitchPortModeIndication()
      sw service arg SwitchIdx: direction=IN, implementation-data-type=uint8  # Index of the switch within the context of the Ethernet Switch Driver.
      sw service arg SwitchPortIdx: direction=IN, implementation-data-type=uint8  # Index of the port at the addressed switch Parameters.
      sw service arg PortMode: direction=IN, implementation-data-type=EthTrcv_ModeType  # Notified Ethernet Switch port mode.
    EthIf_TxConfirmation: is-reentrant=true, is-synchronous=true, call-type=CALLBACK, execution-context=UNSPECIFIED  # This service confirms frame transmission by the indexed controller | This service confirms frame transmission by the indexed controller.
      4 x sw service arg, all with direction=IN:
        CtrlIdx: implementation-data-type=uint8  # Index of the Ethernet controller within the context of the Ethernet Interface.
        BufIdx: implementation-data-type=uint8  # Index of the transmitted buffer.
        DataPtr: category=DATA_REFERENCE, sw-pointer-target-props={target-category=VALUE, implementation-data-type=Eth_DataType, sw-impl-policy=CONST}  # Pointer to the payload of the transmitted frame.
        LenByte: implementation-data-type=uint16  # Length of the transmitted frame in bytes.
    EthIf_UpdatePhysAddrFilter: is-reentrant=true, is-synchronous=false, call-type=REGULAR, execution-context=UNSPECIFIED  # This service updates the physical source address to/from the indexed controller filter | Update the physical source address to/from the indexed controller filter. If the Ethernet Controller is not capable to do the filtering, the software has to do this.
      return type ReturnValue: direction=OUT, implementation-data-type=Std_ReturnType  # E_OK: filter was successfully changed E_NOT_OK: filter could not be changed
      sw service arg CtrlIdx: direction=IN, implementation-data-type=uint8  # Index of the Ethernet controller within the context of the Ethernet Driver.
      sw service arg PhysAddrPtr: category=DATA_REFERENCE, direction=IN, sw-pointer-target-props={target-category=VALUE, implementation-data-type=uint8, sw-impl-policy=CONST}  # Pointer to memory containing the physical source address (MAC address) in network byte order.
      sw service arg Action: direction=IN, implementation-data-type=Eth_FilterActionType  # Add or remove the address from the Ethernet controllers filter.
    EthIf_GetVlanId: is-reentrant=false, is-synchronous=true, call-type=REGULAR, execution-context=UNSPECIFIED  # This service returns the VLAN ID of the requested EthIfCtrl. | This service returns the VLAN identifier of the requested Ethernet Interface controller.
      return type ReturnValue: direction=OUT, implementation-data-type=Std_ReturnType  # E_OK: returned VLAN ID valid. E_NOT_OK: API execution failed.
      sw service arg CtrlIdx: direction=IN, implementation-data-type=uint8  # Index of the Ethernet Interface controller.
      sw service arg VlanIdPtr: category=DATA_REFERENCE, direction=OUT, sw-pointer-target-props={target-category=VALUE, implementation-data-type=uint16}  # Pointer to store the VLAN identifier (VID) of the Ethernet controller. Zero is returned, if the EthIfCtrl represents no virtual network (VLAN).
package /AUTOSAR_EthIf/CompuMethods
  compu method Eth_StateType: 0=ETH_STATE_UNINIT (Driver is not yet configured.), 1=ETH_STATE_INIT (Driver is configured.), 2=ETH_STATE_ACTIVE (Driver is active.)
package /AUTOSAR_EthIf/ImplementationDataTypes
  36 x impl type, all with type-emitter=HEADER_FILE:
    EthTrcv_ModeType: compu {0=ETHTRCV_MODE_DOWN (Transceiver disabled), 1=ETHTRCV_MODE_ACTIVE (Transceiver enabled)}, implementation-data-type=uint8  # This type defines the transceiver modes
    EthTrcv_LinkStateType: compu {0=ETHTRCV_LINK_STATE_DOWN (No physical Ethernet connection established), 1=ETHTRCV_LINK_STATE_ACTIVE (Physical Ethernet connection established), 2=ETHTRCV_LINK_STATE_UNDEF (Physical Ethernet connection undefined)}, implementation-data-type=uint8  # This type defines the Ethernet link state. The link state changes after an Ethernet cable gets plugged in and the transceivers on both ends negotiated the transmission parameters (i.e. baud rate and duplex mode)
    EthTrcv_StateType: compu {0=ETHTRCV_STATE_UNINIT (Driver is not yet configured), 1=ETHTRCV_STATE_INIT (Driver is configured), 2=ETHTRCV_STATE_ACTIVE (Driver is active)}, implementation-data-type=uint8  # Status supervision used for Development Error Detection. The state shall be available for debugging
    EthTrcv_BaudRateType: compu {0=ETHTRCV_BAUD_RATE_10MBIT (10MBIT Ethernet connection), 1=ETHTRCV_BAUD_RATE_100MBIT (100MBIT Ethernet connection), 2=ETHTRCV_BAUD_RATE_1000MBIT (1000MBIT Ethernet connection), 3=ETHTRCV_BAUD_RATE_UNDEF (Undefined Ethernet connection)}, implementation-data-type=uint8  # This type defines the Ethernet baud rate. The baud rate gets either negotiated between the connected transceivers or has to be configured
    EthTrcv_DuplexModeType: compu {0=ETHTRCV_DUPLEX_MODE_HALF (Half duplex Ethernet connection), 1=ETHTRCV_DUPLEX_MODE_FULL (Full duplex Ethernet connection), 2=ETHTRCV_DUPLEX_MODE_UNDEF (Undefined Ethernet connection)}, implementation-data-type=uint8  # This type defines the Ethernet duplex mode. The duplex mode gets either negotiated between the connected transceivers or has to be configured
    EthTrcv_WakeupModeType: compu {0=ETHTRCV_WUM_DISABLE (Transceiver wake up disabled), 1=ETHTRCV_WUM_ENABLE (Transceiver wake up enabled), 2=ETHTRCV_WUM_CLEAR (Transceiver wake up reason cleared)}, implementation-data-type=uint8  # This type controls the transceiver wake up modes and/or clears the wake-up reason
    EthTrcv_WakeupReasonType: compu {0=ETHTRCV_WUR_NONE (No wake up reason detected), 1=ETHTRCV_WUR_GENERAL (General wake up detected, no distinct reason supported by hardware), 2=ETHTRCV_WUR_BUS (Bus wake up detected. Available if supported by hardware), 3=ETHTRCV_WUR_INTERNAL (Internal wake up detected. Available if supported by hardware), 4=ETHTRCV_WUR_RESET (Reset wake up detected. Available if supported by hardware), 5=ETHTRCV_WUR_POWER_ON (Power on wake up detected. Available if supported by hardware), 6=ETHTRCV_WUR_PIN (Pin wake up detected. Available if supported by hardware), 7=ETHTRCV_WUR_SYSERR (System error wake up detected. Available if supported by hardware)}, implementation-data-type=uint8  # This type defines the transceiver wake up reasons
    EthTrcv_PhyTestModeType: compu {0=ETHTRCV_PHYTESTMODE_NONE (normal operation), 1=ETHTRCV_PHYTESTMODE_1 (test transmitter droop), 2=ETHTRCV_PHYTESTMODE_2 (test master timing jitter), 3=ETHTRCV_PHYTESTMODE_3 (test slave timing jitter), 4=ETHTRCV_PHYTESTMODE_4 (test transmitter distortion), 5=ETHTRCV_PHYTESTMODE_5 (test power spectral density (PSD) mask), 6=ETHTRCV_PHYTESTMODE_6 (Transmission of continuous pattern), 7=ETHTRCV_PHYTESTMODE_7 (Measurement of Bi Error Ration)}, implementation-data-type=uint8  # Describes the possible PHY test modes
    EthTrcv_PhyLoopbackModeType: compu {0=ETHTRCV_PHYLOOPBACK_NONE (normal operation), 1=ETHTRCV_PHYLOOPBACK_INTERNAL (internal loopback), 2=ETHTRCV_PHYLOOPBACK_EXTERNAL (external loopback), 3=ETHTRCV_PHYLOOPBACK_REMOTE (remote loopback)}, implementation-data-type=uint8  # Describes the possible PHY loopback modes
    EthTrcv_PhyTxModeType: compu {0=ETHTRCV_PHYTXMODE_NORMAL (normal operation), 1=ETHTRCV_PHYTXMODE_TX_OFF (transmitter disabled), 2=ETHTRCV_PHYTXMODE_SCRAMBLER_OFF (scrambler disabled)}, implementation-data-type=uint8  # Describes the possible PHY transmit modes
    EthTrcv_CableDiagResultType: compu {0=ETHTRCV_CABLEDIAG_OK (Cable diagnostic ok), 1=ETHTRCV_CABLEDIAG_ERROR (Cable diagnostic failed), 2=ETHTRCV_CABLEDIAG_SHORT (Short circuit detected), 3=ETHTRCV_CABLEDIAG_OPEN (Open circuit detected), 4=ETHTRCV_CABLEDIAG_PENDING (Cable diagnostic is pending), 5=ETHTRCV_CABLEDIAG_WRONG_POLARITY (Wrong Polarity detected)}, implementation-data-type=uint8  # Describes the results of the cable diagnostics
    Eth_ModeType: compu {0=ETH_MODE_DOWN (Controller disabled.), 1=ETH_MODE_ACTIVE (Controller enabled.)}, implementation-data-type=uint8  # This type defines the controller modes.
    Eth_FilterActionType: compu {0=ADD_TO_FILTER (add the MAC address to the filter, meaning allow reception.), 0=ETH_ADD_TO_FILTER (add the MAC address to the filter, meaning allow reception.), 1=REMOVE_FROM_FILTER (remove the MAC address from the filter, meaning reception is blocked in the lower layer.), 1=ETH_REMOVE_FROM_FILTER (remove the MAC address from the filter, meaning reception is blocked in the lower layer.)}, implementation-data-type=uint8  # The Enumeration Type Eth_FilterActionType describes the action to be taken for the MAC address given in *PhysAddrPtr. | The Enumeration Type Eth_FilterActionType describes the action to be taken for the MAC address given in *PhysAddrPtr..
    Eth_TimeStampQualType: compu {0=ETH_VALID, 1=ETH_INVALID, 2=ETH_UNCERTAIN}, implementation-data-type=uint8  # Depending on the HW, quality information regarding the evaluated time stamp might be supported. If not supported, the value shall always be valid. For Uncertain and Invalid values, the upper layer shall discard the time stamp.
    EthIf_MeasurementIdxType: compu {1=ETHIF_MEAS_DROP_CRTLIDX (Measurement index of dropped datagrams caused by invalid CrtlIdx/VLAN.), 128=ETHIF_MEAS_DROP_ETHERTYPE (Vendor specific range : Measurement index of dropped datagrams caused by invalid EtherType.), 255=ETHIF_MEAS_ALL (Represents all measurement indexes.)}, implementation-data-type=uint8  # Index to select specific measurement data.
    Eth_RxStatusType: compu {0=ETH_RECEIVED (Ethernet frame has been received, no further frames available.), 1=ETH_NOT_RECEIVED (Ethernet frame has not been received, no further frames available.), 2=ETH_RECEIVED_MORE_DATA_AVAILABLE (Ethernet frame has been received, more frames are available.), 3=ETH_RECEIVED_FRAMES_LOST (Ethernet frame has been received, some frames got lost.)}, implementation-data-type=uint8  # Ethernet frame has been received, some frames got lost
    Eth_ReturnType: compu {0=ETH_OK (success.), 1=ETH_E_NOT_OK (general failure.), 3=ETH_E_NO_ACCESS (Ethernet hardware access failure.)}, implementation-data-type=uint8  # Ethernet Driver specific return type
    Eth_MacVlanType: category=STRUCTURE  # The interpretation of this value is not specified, i.e. whether it is number of used bytes or number of used memory cells, etc.
      4 x element, all with category=TYPE_REFERENCE:
        MacAddr: array-size=6, array-size-semantics=FIXED-SIZE, implementation-data-type=uint8  # Specifies the MAC address
        VlanId: implementation-data-type=uint16  # Specifies the VLAN address
        SwitchPort: implementation-data-type=uint8  # Port of the switch
        HashValue: implementation-data-type=uint16  # Hash value that is generated by the Ethernet switch according the given MacAddr. If the HashValue is not available the value shall be set to 0b1111xxxxxxxxxxxx == 0xFxxx (invalid value). If the HashValue is available the value shall be set to 0b0000xxxxxxxxxxxx == 0x0xxx (valid value)
    Eth_TimeStampType: category=STRUCTURE  # Evaluated time stamp.
      element nanoseconds: implementation-data-type=uint32  # Nanoseconds part of the time.
      element seconds: implementation-data-type=uint32  # 32 bit LSB of the 48 bits Seconds part of the time.
      element secondsHi: implementation-data-type=uint16  # 16 bit MSB of the 48 bits Seconds part of the time.
    Eth_TimeIntDiffType: category=STRUCTURE  # Variables of this type are used to express time differences.
      element diff: implementation-data-type=Eth_TimeStampType  # time difference.
      element sign: implementation-data-type=boolean  # Positive (True) / negative (False) time.
    Eth_RateRatioType: category=STRUCTURE  # Variables of this type are used to express frequency ratios.
      element IngressTimeStampDelta: implementation-data-type=Eth_TimeIntDiffType  # IngressTimeStampSync2 - IngressTimeStampSync1
      element OriginTimeStampDelta: implementation-data-type=Eth_TimeIntDiffType  # OriginTimeStampSync2[FUP2] - OriginTimeStampSync1[FUP1]
    Eth_DataType: implementation-data-type=uint8  # This type defines the Ethernet data type used for data transmission. Its definition depends on the used CPU.
    EthIf_SwitchPortGroupIdxType: implementation-data-type=uint8  # Data Type that represents the Ethernet interface switch port group index. | Data Type that represents the Ethernet interface switch port group index. The index is zero based and unique for every configured switch port group.
    Eth_FrameType: implementation-data-type=uint16  # This type defines the Ethernet frame type used in the Ethernet frame header.
    EthIf_ConfigType: category=STRUCTURE  # Configuration data structure of the EthIf module. | Note: as documentation generation from BSWMD is currently not working properly, type of the structure members is mentioned in the description. Complete type description is filled additionally manually the the chapter Data types.
      10 x element, all with category=DATA_REFERENCE, sw-pointer-target-props={target-category=VALUE, base-type=void}:
        EthIf_GeneralTable_cpcst  # Pointer to the General table structure of type const EthIf_General_tst* const.
        EthIf_FrameOwnerConfigTable_cpcst  # Pointer to the FrameOwner table structure of type const EthIf_FrameOwnerConfig_tst* const.
        EthIf_StaticEthIfCtrlTable_cpcst  # Pointer to the Static EthIfCtrl table structure of type const EthIf_StaticEthIfCtrl_tst* const.
        EthIf_DynamicEthIfCtrlTable_cpst  # Pointer to the Dynamic EthIfCtrl table structure of type EthIf_DynamicEthIfCtrl_tst* const.
        EthIf_DynamicPhysCtrlTable_cpst  # Pointer to the Dynamic PhysCtrl table structure of type EthIf_DynamicPhysCtrl_tst* const.
        EthIf_DynamicTrcvTable_cpst  # Pointer to the Dynamic Transceiver table structure of type EthIf_DynamicTrcv_tst* const.
        EthIf_StaticSwitchTable_cpcst  # Pointer to the Static Switch table structure of type const EthIf_StaticSwitch_tst* const.
        EthIf_DynamicSwitchTable_cpst  # Pointer to the Dynamic Switch table structure of type EthIf_DynamicSwitch_tst* const.
        EthIf_DynamicSwtPortTable_cpst  # Pointer to the Dynamic Switch Port table structure of type EthIf_DynamicSwtPort_tst* const.
        EthIf_StaticSwtPortGroupTable_cpcst  # Pointer to the Static Switch PG table structure of type const EthIf_StaticSwtPortGroup_tst* const.
    Eth_CounterType: category=STRUCTURE  # Statistic counter for diagnostics.
      18 x element, all with category=TYPE_REFERENCE, implementation-data-type=uint32:
        DropPktBufOverrun  # Dropped packets due to buffer overrun.
        DropPktCrc  # Dropped packets due to CRC errors.
        UndersizePkt  # Number of undersize packets. | Number of undersize packets, which were less than 64 octets long (excluding framing bits, but including FCS octets) and were otherwise well formed (see IETF RFC 1757).
        OversizePkt  # Number of oversize packets. | Number of oversize packets, which are longer than 1518 octets (excluding framing bits, but including FCS octets) and were otherwise well formed (see IETF RFC 1757).
        AlgnmtErr  # Number of alignment errors. | Number of alignment errors, i.e. packets which are received and are not an integral number of octets in length and do not pass the CRC.
        SqeTestErr  # SQE test error. | SQE test error according to IETF RFC1643 dot3StatsSQETestErrors.
        DiscInbdPkt  # The number of discarded error free inbound packets. | The number of inbound packets, which were chosen to be discarded even though no errors had been detected to prevent their being deliverable to a higher-layer protocol. One possible reason for discarding such a packet could be to free up buffer space (see IETF RFC 2233 ifInDiscards).
        ErrInbdPkt  # Total number of erroneous inbound packets.
        DiscOtbdPkt  # The number of discarded error free outbound packets. | The number of outbound packets, which were chosen to be discarded even though no errors had been detected to prevent their being transmitted. One possible reason for discarding such a packet could be to free up buffer space (see IETF RFC 2233 ifOutDiscards).
        ErrOtbdPkt  # Total number of erroneous outbound packets.
        SnglCollPkt  # Single collision frames. | Single collision frames: A count of successfully transmitted frames on a particular interface for which transmission is inhibited by exactly one collision (see IETF RFC1643 dot3StatsSingleCollisionFrames).
        MultCollPkt  # Multiple collision frames. | Multiple collision frames: A count of successfully transmitted frames on a particular interface for which transmission is inhibited by more than one collision (see IETF RFC1643 dot3StatsMultipleCollisionFrames).
        DfrdPkt  # Number of deferred transmission. | Number of deferred transmission: A count of frames for which the first transmission attempt on a particular interface is delayed because the medium is busy (see IETF RFC1643 dot3StatsDeferredTransmissions).
        LatCollPkt  # Number of late collisions. | Number of late collisions: The number of times that a collision is detected on a particular interface later than 512 bit-times into the transmission of a packet (see IETF RFC1643 dot3StatsLateCollisions).
        HwDepCtr{0..3}  # Hardware dependent counter value.
    Eth_RxStatsType: category=STRUCTURE  # Statistic counter for diagnostics.
      18 x element, all with category=TYPE_REFERENCE:
        RxStatsDropEvents: implementation-data-type=uint32  # The total number of events in which packets were dropped by the probe due to lack of resources. | The total number of events, in which packets were dropped by the probe due to lack of resources. Also described in IETF RFC 2819 MIB etherStatsDropEvents.
        RxStatsOctets: implementation-data-type=uint64  # The total number of octets of data received on the network. | The total number of octets of data (including those in bad packets) received on the network (excluding framing bits but including FCS octets). Also described in IETF RFC 2819 MIB etherStatsOctets.
        RxStatsPkts: implementation-data-type=uint32  # The total number of packets received. | The total number of packets (including bad packets, broadcast packets, and multicast packets) received. Also described in IETF RFC 2819 MIB etherStatsPkts.
        RxStatsBroadcastPkts: implementation-data-type=uint32  # The total number of good packets received that were directed to the broadcast address. | The total number of good packets received that were directed to the broadcast address. Also described in IETF RFC 2819 MIB etherStatsBroadcastPkts.
        RxStatsMulticastPkts: implementation-data-type=uint32  # The total number of good packets received that were directed to a multicast address. | The total number of good packets received that were directed to a multicast address. Also described in IETF RFC 2819 MIB etherStatsMulticastPkts.
        RxStatsCrcAlignErrors: implementation-data-type=uint32  # The total number of packets received that had a length of between 64 and 1518 octets that had either a bad FCS with an integral number of octets (FCS Error) or a bad FCS with a non-integral number of octets (Alignment Error). | The total number of packets received that had a length of between 64 and 1518 octets that had either a bad Frame Check Sequence (FCS) with an integral number of octets (FCS Error) or a bad FCS with a non-integral number of octets (Alignment Error). Also described in IETF RFC 2819 MIB etherStatsCRCAlignErrors.
        RxStatsUndersizePkts: implementation-data-type=uint32  # The total number of packets received that were less than 64 octets long and were otherwise well formed. | The total number of packets received that were less than 64 octets long (excluding framing bits, but including FCS octets) and were otherwise well formed. Also described in IETF RFC 2819 MIB etherStatsUndersizePkts.
        RxStatsOversizePkts: implementation-data-type=uint32  # The total number of packets received that were longer than 1518 octets and were otherwise well formed. | The total number of packets received that were longer than 1518 octets (excluding framing bits, but including FCS octets) and were otherwise well formed. Also described in IETF RFC 2819 MIB etherStatsOversizePkts.
        RxStatsFragments: implementation-data-type=uint32  # The total number of packets received that were less than 64 octets in length and had either a bad FCS with an integral number of octets (FCS Error) or a bad FCS with a non-integral number of octets (Alignment Error). | The total number of packets received that were less than 64 octets in length (excluding framing bits but including FCS octets) and had either a bad Frame Check Sequence (FCS) with an integral number of octets (FCS Error) or a bad FCS with a non-integral number of octets (Alignment Error). Also described in IETF RFC 2819 MIB etherStatsFragments.
        RxStatsJabbers: implementation-data-type=uint32  # The total number of packets received that were longer than 1518 octets, and had either a bad FCS with an integral number of octets (FCS Error) or a bad FCS with a non-integral number of octets (Alignment Error). | The total number of packets received that were longer than 1518 octets, and had either a bad Frame Check Sequence (FCS) with an integral number of octets (FCS Error) or a bad FCS with a non-integral number of octets (Alignment Error). Also described in IETF RFC 2819 MIB etherStatsJabbers.
        RxStatsCollisions: implementation-data-type=uint32  # The best estimate of the total number of collisions on this Ethernet segment. | The best estimate of the total number of collisions on this Ethernet segment. Also described in IETF RFC 2819 MIB etherStatsCollisions.
        RxStatsPkts64Octets: implementation-data-type=uint32  # The total number of packets received that were 64 octets in length. | The total number of packets (including bad packets) received that were 64 octets in length. Also described in IETF RFC 2819 MIB etherStatsPkts64Octets.
        RxStatsPkts65to127Octets: implementation-data-type=uint32  # The total number of packets received that were between 65 and 127 octets in length. | The total number of packets (including bad packets) received that were between 65 and 127 octets in length. Also described in IETF RFC 2819 MIB etherStatsPkts65to127Octets.
        RxStatsPkts128to255Octets: implementation-data-type=uint32  # The total number of packets received that were between 128 and 255 octets in length. | The total number of packets (including bad packets) received that were between 128 and 255 octets in length. Also described in IETF RFC 2819 MIB etherStatsPkts128to255Octets.
        RxStatsPkts256to511Octets: implementation-data-type=uint32  # The total number of packets received that were between 256 and 511 octets in length. | The total number of packets (including bad packets) received that were between 256 and 511 octets in length. Also described in IETF RFC 2819 MIB etherStatsPkts256to511Octets.
        RxStatsPkts512to1023Octets: implementation-data-type=uint32  # The total number of packets received that were between 512 and 1023 octets in length. | The total number of packets (including bad packets) received that were between 512 and 1023 octets in length. Also described in IETF RFC 2819 MIB etherStatsPkts512to1023Octets.
        RxStatsPkts1024to1518Octets: implementation-data-type=uint32  # The total number of packets received that were between 1024 and 1518 octets in length. | The total number of packets (including bad packets) received that were between 1024 and 1518 octets in length. Also described in IETF RFC 2819 MIB etherStatsPkts1024to1518Octets.
        RxUnicastFrames: implementation-data-type=uint32  # The number of subnetwork-unicast packets delivered to a higher-layer protocol. | The number of subnetwork-unicast packets delivered to a higher-layer protocol. Also described in IETF RFC1213 MIB ifInUcastPkts.
    Eth_TxStatsType: category=STRUCTURE  # Statistic counter for diagnostics.
      element TxNumberOfOctets: implementation-data-type=uint64  # The total number of octets transmitted out of the interface, including framing characters. | The total number of octets transmitted out of the interface, including framing characters. Also described in IETF RFC1213 MIB ifOutOctets.
      element TxNUcastPkts: implementation-data-type=uint32  # The total number of packets that higher-level protocols requested be transmitted to a non-unicast address. | The total number of packets that higher-level protocols requested be transmitted to a non-unicast (i.e., a subnetwork-broadcast or subnetwork-multicast) address, including those that were discarded or not sent. Also described in IETF RFC1213 MIB ifOutNUcastPkts.
      element TxUniCastPkts: implementation-data-type=uint32  # The total number of packets that higher-level protocols requested be transmitted to a subnetwork-unicast address. | The total number of packets that higher-level protocols requested be transmitted to a subnetwork-unicast address, including those that were discarded or not sent. Also described in IETF RFC1213 MIB ifOutUcastPkts.
    Eth_TxErrorCounterValuesType: category=STRUCTURE  # Statistic counter for diagnostics.
      7 x element, all with category=TYPE_REFERENCE, implementation-data-type=uint32:
        TxDroppedNoErrorPkts  # The number of outbound packets which were chosen to be discarded even though no errors had been detected to prevent their being transmitted. | The number of outbound packets which were chosen to be discarded even though no errors had been detected to prevent their being transmitted. One possible reason for discarding such a packet could be to free up buffer space. Also described in IETF RFC1213 MIB ifOutDiscards.
        TxDroppedErrorPkts  # The number of outbound packets that could not be transmitted because of errors. | The number of outbound packets that could not be transmitted because of errors. Also described in IETF RFC1213 MIB ifOutErrors.
        TxDeferredTrans  # A count of frames for which the first transmission attempt on a particular interface is delayed because the medium is busy. | A count of frames for which the first transmission attempt on a particular interface is delayed because the medium is busy. The count represented by an instance of this object does not include frames involved in collisions. Also described in IETF RFC1643 MIB dot3StatsDeferredTransmissions.
        TxSingleCollision  # A count of successfully transmitted frames on a particular interface for which transmission is inhibited by exactly one collision. | A count of successfully transmitted frames on a particular interface for which transmission is inhibited by exactly one collision. A frame that is counted by an instance of this object is also counted by the corresponding instance of the TxUniCastPkts and TxNUcastPkts and is not counted by the corresponding instance of the TxMultipleCollision object. Also described in IETF RFC1643 MIB dot3StatsSingleCollisionFrames.
        TxMultipleCollision  # A count of successfully transmitted frames on a particular interface for which transmission is inhibited by more than one collision. | A count of successfully transmitted frames on a particular interface for which transmission is inhibited by more than one collision. A frame that is counted by an instance of this object is also counted by the corresponding instance of the TxUniCastPkts and TxNUcastPkts and is not counted by the corresponding instance of the TxSingleCollision object. Also described in IETF RFC1643 MIB dot3StatsMultipleCollisionFrames.
        TxLateCollision  # The number of times that a collision is detected on a particular interface later than 512 bit-times into the transmission of a packet. | The number of times that a collision is detected on a particular interface later than 512 bit-times into the transmission of a packet. Five hundred and twelve bit-times corresponds to 51.2 microseconds on a 10 Mbit/s system. A (late) collision included in a count represented by an instance of this object is also considered as a (generic) collision for purposes of other collision-related statistics. Also described in IETF RFC1643 MIB dot3StatsLateCollisions.
        TxExcessiveCollison  # A count of frames for which transmission on a particular interface fails due to excessive collisions. | A count of frames for which transmission on a particular interface fails due to excessive collisions. Also described in IETF RFC1643 MIB dot3StatsExcessiveCollisions.
    EthIf_SignalQualityResultType: category=STRUCTURE  # Structure to store polled EthTrcv/EthSwt port signal quality.
      element HighestSignalQuality: implementation-data-type=uint32  # The highest link signal quality of a link since last clear.
      element LowestSignalQuality: implementation-data-type=uint32  # The lowest link signal quality of a link since last clear.
      element ActualSignalQuality: implementation-data-type=uint32  # Actual link signal quality.
    Eth_ZeroCopyTxHeaderInfo_tst: category=STRUCTURE  # Structure used to store the Zero Copy Tx header information which is required by EthDriver to transmit the frame.
      element HeaderId_u16: implementation-data-type=uint16  # Id of the header in TcpIp context.
      element HeaderPartBuffer_pu8: category=DATA_REFERENCE, sw-pointer-target-props={target-category=TYPE_REFERENCE, implementation-data-type=uint8}  # Pointer to the header buffer.
      element HeaderPartLen_u8: implementation-data-type=uint8  # Length of the header buffer.
    Eth_ZeroCopyTxDataInfo_tst: category=STRUCTURE  # Structure used to store the Zero Copy Tx data provided by the Upper Layer application.
      element DataBufferList_ppu8: category=DATA_REFERENCE, sw-pointer-target-props={target-category=TYPE_REFERENCE, implementation-data-type=uint8}  # Pointer to the list of data buffers. | This structure field which is a double pointer (uint8**) is described as single pointer due to the restriction of Autosar template (see constraint [TPS_SWCT_01258][constr_1254]).
      element DataBufferCount_u16: implementation-data-type=uint16  # Number of data buffers.
      element DataLen_u16: implementation-data-type=uint16  # Length of the data buffers.
    Eth_ZeroCopyArg_tst: category=STRUCTURE  # ZeroCopy structure containing all required information to execute a ZeroCopy transmission. This structure is passed from one layer to another and contains the allocated header pointers and the application data pointer.
      5 x element:
        ZeroCopyAllocatedHeaders_ast: category=DATA_REFERENCE, sw-pointer-target-props={target-category=TYPE_REFERENCE, implementation-data-type=Eth_ZeroCopyTxHeaderInfo_tst}  # List of allocated TcpIp header blocks.
        AllocatedHeaderCount_u8: implementation-data-type=uint8  # Number of allocated TcpIp header blocks.
        ZeroCopyData_pcst: category=DATA_REFERENCE, sw-pointer-target-props={target-category=TYPE_REFERENCE, implementation-data-type=Eth_ZeroCopyTxDataInfo_tst, sw-impl-policy=CONST}  # ZeroCopy data to be transmitted given by UL.
        TxConfFlag_b: implementation-data-type=boolean  # Boolean indicating if TxConfirmation need to be monitored.
        TriggerTx_b: implementation-data-type=boolean  # Boolean indicating if previously saved and current transmission requests need to be processed by the driver (until this flag is set to TRUE, the driver will hold the requests).
    EthSwt_PortMirrorCfgType: category=STRUCTURE  # In case of port mirroring it shall be possible to set up port mirroring configurations. It shall be possible to store different filter packages in the Ethernet switch. The parameter SetSelection set the index for the filter package (0x01 .. 0xFF). Filter packages are accessible by the index. In case SetSelection is set to 0x00, the package use the a free configuration.
      10 x element, all with category=TYPE_REFERENCE:
        TrafficDirectionIngressBitMask: implementation-data-type=uint32  # specifies the Ingress mask
        TrafficDirectionEgressBitMask: implementation-data-type=uint32  # specifies the Egress mask
        CapturePortIdx: implementation-data-type=uint8  # Specifies the Ethernet switch port which capture the mirrored traffic
        MirroringMode: implementation-data-type=uint8  # Specifies the mode how the mirrored traffic should be tagged 0x00 == No VLAN retagging; 0x01 == VLAN retagging; 0x03 == VLAN Doubletagging
        VlanIdFilter: implementation-data-type=uint16  # Specifies the VLAN address 0..4094 that should be mirrored.
        ReTaggingVlanId: implementation-data-type=uint16  # Specifies the VLAN address 0..4094 which shall be used for Re-tagging
        DoubleTaggingVlanId: implementation-data-type=uint16  # Specifies the VLAN address 0..4094 which shall be used for double tagging
        MirroringPacketDivider: implementation-data-type=uint8  # Divider if only a subset of received frames should be mirrored. E.g. MirroringPacketDivider = 2 means every second frames is mirrored
        srcMacAddrFilter: implementation-data-type=uint8  # Specifies the source MAC address [0..255,0..255,0..255,0..255,0..255,0..255] that should be mirrored
        dstMacAddrFilter: implementation-data-type=uint8  # Specifies the destination MAC address [0..255,0..255,0..255,0..255,0..255,0..255] that should be mirrored
    EthSwt_PortMirrorStateType: compu {0=PORT_MIRRORING_DISABLED (port mirroring disabled.), 1=PORT_MIRRORING_ENABLED (port mirroring enabled)}, implementation-data-type=uint8  # It shall be possible to set and get the state (enable / disable) of the ehternet switch port.
    EthSwt_MacLearningType: compu {0=ETHSWT_MACLEARNING_HWDISABLED (If hardware learning disabled, the switch must not learn new MAC addresses), 0=ETHSWT_MACLEARNING_HWENABLED (If hardware learning enabled, the switch learns new MAC addresses), 1=ETHSWT_MACLEARNING_SWENABLED (If software learning enabled, the hardware learning is disabled and the switch forwards packets with an unknown source address to a host CPU)}, implementation-data-type=uint8  # It shall make possible the interpretation of this value.
