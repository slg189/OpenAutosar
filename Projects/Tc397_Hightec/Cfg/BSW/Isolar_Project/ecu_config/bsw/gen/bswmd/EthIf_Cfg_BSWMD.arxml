AUTOSAR XML (schema 4-2-2)
package /AUTOSAR_EthIf/BswImplementations
  bsw implementation EthIf: programming-language=C, sw-version=10.0.0, ar-release-version=4.2.2, behavior=BswInternalBehavior
    code-descriptors:
      code CodeDescriptor: artifact-descriptors=autosar-engineering-object={short-label=ArEngObj, category=SWSRC}
    resource consumption EthIf_ResourceConsumption
      15 x memory section:
        ETHIF_CONST_8: alignment=8, prefix=ETHIF, sw-addrmethod=CONST, symbol=CONST_8
        ETHIF_CONST_16: alignment=16, prefix=ETHIF, sw-addrmethod=CONST, symbol=CONST_16
        ETHIF_CONST_32: alignment=32, prefix=ETHIF, sw-addrmethod=CONST, symbol=CONST_32
        ETHIF_CONST_UNSPECIFIED: alignment=UNSPECIFIED, prefix=ETHIF, sw-addrmethod=CONST, symbol=CONST_UNSPECIFIED
        ETHIF_VAR_CLEARED_8: alignment=8, prefix=ETHIF, sw-addrmethod=VAR_CLEARED, symbol=VAR_CLEARED_8
        ETHIF_VAR_CLEARED_16: alignment=16, prefix=ETHIF, sw-addrmethod=VAR_CLEARED, symbol=VAR_CLEARED_16
        ETHIF_VAR_CLEARED_32: alignment=32, prefix=ETHIF, sw-addrmethod=VAR_CLEARED, symbol=VAR_CLEARED_32
        ETHIF_VAR_CLEARED_UNSPECIFIED: alignment=UNSPECIFIED, prefix=ETHIF, sw-addrmethod=VAR_CLEARED, symbol=VAR_CLEARED_UNSPECIFIED
        ETHIF_VAR_INIT_8: alignment=8, prefix=ETHIF, sw-addrmethod=VAR_INIT, symbol=VAR_INIT_8
        ETHIF_VAR_INIT_16: alignment=16, prefix=ETHIF, sw-addrmethod=VAR_INIT, symbol=VAR_INIT_16
        ETHIF_VAR_INIT_32: alignment=32, prefix=ETHIF, sw-addrmethod=VAR_INIT, symbol=VAR_INIT_32
        ETHIF_VAR_INIT_UNSPECIFIED: alignment=UNSPECIFIED, prefix=ETHIF, sw-addrmethod=VAR_INIT, symbol=VAR_INIT_UNSPECIFIED
        EthIf_CODE: prefix=EthIf, sw-addrmethod=CODE, symbol=CODE
        ETHIF_CODE: prefix=ETHIF, sw-addrmethod=CODE, symbol=CODE
        ETHIF_CODE_FAST: prefix=ETHIF, sw-addrmethod=CODE_FAST, symbol=CODE_FAST
      section name prefix EthIf
      section name prefix ETHIF
package /AUTOSAR_EthIf/BswModuleDescriptions
  bsw module description EthIf
    bsw internal behavior BswInternalBehavior
      bsw schedulable entity SE_MainFunctionState: implemented-entry=EthIf_MainFunctionState
      bsw schedulable entity SE_MainFunctionTx: implemented-entry=EthIf_MainFunctionTx
      bsw schedulable entity SE_MainFunctionRx_EthIfPhysCtrlRxMainFunctionPriorityProcessing: implemented-entry=EthIf_MainFunctionRx_EthIfPhysCtrlRxMainFunctionPriorityProcessing
      bsw timing event EV_SE_MainFunctionState: starts-on-event=SE_MainFunctionState, period=0.005
      bsw timing event EV_SE_MainFunctionTx: starts-on-event=SE_MainFunctionTx, period=0.001
      bsw timing event EV_SE_MainFunctionRx_EthIfPhysCtrlRxMainFunctionPriorityProcessing: starts-on-event=SE_MainFunctionRx_EthIfPhysCtrlRxMainFunctionPriorityProcessing, period=0.01
package /AUTOSAR_EthIf/Units
  unit NoUnit: display-name=noUnit, factor-si-to-unit=1.0, offset-si-to-unit=0.0, physical-dimension=NoUnit  # No Unit
package /AUTOSAR_EthIf/PhysicalDimensions
  physical dimension NoUnit: length-exp=0
