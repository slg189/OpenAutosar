AUTOSAR XML (schema 4-0-3)
package /AUTOSAR_EthSM/BswModuleDescriptions
  bsw module description EthSM: category=BSW_MODULE, module-id=143, provided-entrys=[EthSM_MainFunction, EthSM_Init, EthSM_GetVersionInfo, EthSM_RequestComMode, EthSM_GetCurrentComMode], outgoing-callbacks=[EthSM_CtrlModeIndication, EthSM_TrcvLinkStateChg, EthSM_TcpIpModeIndication]  # Ethernet State Manager
package /AUTOSAR_EthSM/BswModuleEntrys
  8 x bsw module entry, all with sw-service-impl-policy=STANDARD:
    EthSM_MainFunction: is-reentrant=false, is-synchronous=true, call-type=SCHEDULED, execution-context=TASK  # Cyclic Main Function which is called from the scheduler | EthSM stores the mode request or status from EthSM_RequestComMode(), EthSM_TrcvLinkStateChg(), EthSM_TcpIpModeIndication() and EthSM_CtrlModeIndication(). Depending on these, EthSM_MainFunction() services all possible state transitions. If hardware error is reported by the transceiver, EthSM_MainFunction() will first get the network to ETHSM_STATE_OFFLINE and then retriggers the state transitions as requested by ComM.
    EthSM_Init: is-reentrant=false, is-synchronous=true, call-type=REGULAR, execution-context=UNSPECIFIED  # Service which initializes EthSM module. | This service is used for initializing global variables.
    EthSM_GetVersionInfo: is-reentrant=true, is-synchronous=true, call-type=REGULAR, execution-context=UNSPECIFIED  # Service which fetches the version information of EthSM module | Service retrieves the major, minor and patches version of the current EthSM module.
      sw service arg versioninfo: category=DATA_REFERENCE, direction=OUT, sw-pointer-target-props={target-category=VALUE, implementation-data-type=Std_VersionInfoType}  # The address of the version information of the EthSM module.
    EthSM_RequestComMode: is-reentrant=false, is-synchronous=false, call-type=REGULAR, execution-context=UNSPECIFIED  # Service which stores the communication mode requests from ComM. | Stores the ComM requested mode - COMM_FULL_COMMUNICATION and COMM_NO_COMMUNICATION. If COMM_SILENT_COMMUNICATION is requested, API will not store the request and returns with E_OK.
      return type ReturnValue: direction=OUT, implementation-data-type=Std_ReturnType  # E_OK is returned if the request has been accepted. Otherwise E_NOT_OK is returned. | Possible reasons for E_NOT_OK being returned. EthSM module is not initialized. Network Handle is greater than the configured number of EthSM networks. The requested ComM mode is not one of the following: COMM_NO_COMMUNICATION, COMM_FULL_COMMUNICATION or COMM_SILENT_COMMUNICATION.
      sw service arg NetworkHandle: direction=IN, implementation-data-type=NetworkHandleType  # This parameter selects one of the configured EthSM network.
      sw service arg ComM_Mode: direction=IN, implementation-data-type=ComM_ModeType  # This parameter specifies the requested communication mode.
    EthSM_GetCurrentComMode: is-reentrant=false, is-synchronous=true, call-type=REGULAR, execution-context=UNSPECIFIED  # The service puts out the current communication mode of Ethernet Network | The function EthSM_GetCurrentComMode puts out the current communication mode for the network handle to the designated pointer of type ComM_ModeType, if it accepts the request. Returns the ComM mode - COMM_FULL_COMMUNICATION or COMM_NO_COMMUNICATION depending on current state of EthSM network. If EthSM network is ETHSM_STATE_ONLINE, ETHSM_STATE_ONHOLD or ETHSM_STATE_WAIT_OFFLINE API returns COMM_FULL_COMMUNICATION. If states are ETHSM_STATE_OFFLINE, ETHSM_STATE_WAIT_TRCVLINK, ETHSM_STATE_WAIT_ONLINE, ETHSM_SUBSTATE_OFFLINE_WAIT_CTRLMODE, ETHSM_SUBSTATE_OFFLINE_WAIT_TRCV_ACTIVE or ETHSM_SUBSTATE_OFFLINE_WAIT_TRCV_DOWN then the API returns COMM_NO_COMMUNICATION.
      return type ReturnValue: direction=OUT, implementation-data-type=Std_ReturnType  # E_OK is returned if the current COM mode is put out. Otherwise E_NOT_OK is returned. | Possible reasons for E_NOT_OK being returned. EthSM module is not initialized. Network Handle is greater than the configured number of EthSM networks. The output parameter is a null pointer.
      sw service arg NetworkHandle: direction=IN, implementation-data-type=NetworkHandleType  # This parameter selects one of the configured EthSM network.
      sw service arg ComM_ModePtr: category=DATA_REFERENCE, direction=OUT, sw-pointer-target-props={target-category=VALUE, implementation-data-type=ComM_ModeType}  # Pointer where to put out the current communication mode
    EthSM_CtrlModeIndication: is-reentrant=true, is-synchronous=true, call-type=CALLBACK, execution-context=UNSPECIFIED  # This service is called when EthIfCtrl mode has been changed. | Called when EthIfCtrl mode has been changed.Triggered by previous EthIf_SetControllerMode call. Can directly be called within the trigger functions.This API stores the EthIfCtrl mode reported. If EthIf reports unexpected ETH_MODE_DOWN, it is considered as HW error.
      sw service arg CtrlIdx: direction=IN, implementation-data-type=uint8  # Index of the EthIf controller.
      sw service arg CtrlMode: direction=IN, implementation-data-type=Eth_ModeType  # Notified EthIfCtrl mode
    EthSM_TrcvLinkStateChg: is-reentrant=false, is-synchronous=true, call-type=CALLBACK, execution-context=UNSPECIFIED  # This service reports a change in the Transceiver link state | This service is called per EthIfCtrl by EthIf and stores the link status reported. It is triggered whenever there is a change in the link state of the Ethernet transceiver. If the EthSM network is in ETHSM_STATE_ONLINE and EthSM_TrcvLinkStateChg(ETHTRCV_LINK_STATE_DOWN) is called EthSM reports the DEM error - ETHSM_E_LINK_DOWN. If EthSM network is ETHSM_STATE_ONHOLD and EthSM_TrcvLinkStateChg(ETHTRCV_LINK_STATE_ACTIVE) is called EthSM clears the DEM error - ETHSM_E_LINK_DOWN.
      sw service arg CtrlIdx: direction=IN, implementation-data-type=uint8  # The Index of the EthIf controller whose transceiver link has changed.
      sw service arg TransceiverLinkState: direction=IN, implementation-data-type=EthTrcv_LinkStateType  # Actual transceiver link state of the specific EthIf controller
    EthSM_TcpIpModeIndication: is-reentrant=false, is-synchronous=true, call-type=CALLBACK, execution-context=UNSPECIFIED  # Service called by TcpIp to report the actual TcpIp state | This service informs EthSM in which state TcpIp currently is (online, offline).This API is called by TcpIp per EthIfCtrl and stores the TcpIp mode reported.
      return type ReturnValue: direction=OUT, implementation-data-type=Std_ReturnType  # E_OK is returned if service is accepted. Otherwise E_NOT_OK is returned.
      sw service arg CtrlIdx: direction=IN, implementation-data-type=uint8  # The Index of the EthIf controller mapped to a TcpIp Ctrl whose state is indicated..
      sw service arg TcpIpState: direction=IN, implementation-data-type=TcpIp_StateType  # The actual state of the TcpIp Controller.
package /AUTOSAR_EthSM/ImplementationDataTypes
  impl type EthSM_NetworkModeStateType:  # This type defines the state of the network mode state machine.
    compu {0=ETHSM_STATE_OFFLINE (EthSM network state after initialization.), 1=ETHSM_STATE_WAIT_TRCVLINK (EthIfCtrl mode is ACTIVE. EthSM is waiting for EthSM_TrcvLinkStateChg(ACTIVE) call back.), 2=ETHSM_STATE_WAIT_ONLINE (Link state is ACTIVE and TcpIp requested for IP address assignment. EthSM is waiting for EthSM_TcpIpModeIndication(ACTIVE) call back.), 3=ETHSM_STATE_ONLINE (IP assignment process is complete and ComM state COMM_FULL_COMMUNICATION is reached.), 4=ETHSM_STATE_ONHOLD (Link has gone DOWM after reaching ETHSM_STATE_ONLINE.), 5=ETHSM_STATE_WAIT_OFFLINE (EthSM is requested for COMM_NO_COMMUNICATION and EthSM has requested TcpIp to release IP.), 6=ETHSM_SUBSTATE_OFFLINE_WAIT_CTRLMODE_ACTIVE (Substate of ETHSM_STATE_OFFLINE. EthIfCtrl is requested for mode Active and waiting for the call back.)}
    implementation-data-type=uint8
    type-emitter=HEADER_FILE
  impl type EthSM_NetworkUserType_ten: compu {0=ETHSM_USER_TCPIP (Network user is TcpIp.), 1=ETHSM_USER_CDD (Network user is Complex Device Driver.)}, implementation-data-type=uint8, type-emitter=HEADER_FILE  # Specifies the network user type.
  impl type EthSM_NetworkUserConfig_tst: category=STRUCTURE, type-emitter=HEADER_FILE  # This type defines a data structure for network user related parameters.
    element NetworkUser_en: implementation-data-type=EthSM_NetworkUserType_ten  # Specifies the network user type.
    element UserTrcvLinkStateChgFunc: category=DATA_REFERENCE, sw-pointer-target-props={target-category=TYPE_REFERENCE, implementation-data-type=uint8}  # Function pointer to the User_TrcvLinkStateChg function.
