AUTOSAR XML (schema 4-2-2)
package /AUTOSAR_EthSM/ApplicationDataTypes
  application array data type EthSM_NetworkModeStateType_au8_app: category=ARRAY, sw-calibration-access=READ-WRITE  # Array of NetworkMode StateType
    element EthSM_Array_Element_of_NetworkModeStateType: category=VALUE, type=EthSM_NetworkModeStateType_Enum, max-number-of-elements=1
  app type EthSM_NetworkModeStateType_Enum: category=VALUE, sw-calibration-access=READ-WRITE, compu {0=ETHSM_STATE_OFFLINE, 1=ETHSM_STATE_WAIT_TRCVLINK, 2=ETHSM_STATE_WAIT_ONLINE, 3=ETHSM_STATE_ONLINE, 4=ETHSM_STATE_ONHOLD, 5=ETHSM_STATE_WAIT_OFFLINE} "Enumeration for EthSM Network Mode State Type", range phys 0..255, display-format=%5.0f  # Enum for NetworkMode StateType
package /AUTOSAR_EthSM/BswImplementations
  bsw implementation EthSM: programming-language=C, sw-version=10.0.0, ar-release-version=4.2.2, behavior=BswInternalBehavior
    code-descriptors:
      code CodeDescriptor: artifact-descriptors=autosar-engineering-object={short-label=ArEngObj, category=SWSRC}
    resource consumption EthSM_ResourceConsumption
      14 x memory section:
        ETHSM_CONST_8: alignment=8, prefix=ETHSM, sw-addrmethod=CONST, symbol=CONST_8
        ETHSM_CONST_16: alignment=16, prefix=ETHSM, sw-addrmethod=CONST, symbol=CONST_16
        ETHSM_CONST_32: alignment=32, prefix=ETHSM, sw-addrmethod=CONST, symbol=CONST_32
        ETHSM_CONST_UNSPECIFIED: alignment=UNSPECIFIED, prefix=ETHSM, sw-addrmethod=CONST, symbol=CONST_UNSPECIFIED
        ETHSM_VAR_CLEARED_8: alignment=8, prefix=ETHSM, sw-addrmethod=VAR_CLEARED, symbol=VAR_CLEARED_8
        ETHSM_VAR_CLEARED_16: alignment=16, prefix=ETHSM, sw-addrmethod=VAR_CLEARED, symbol=VAR_CLEARED_16
        ETHSM_VAR_CLEARED_32: alignment=32, prefix=ETHSM, sw-addrmethod=VAR_CLEARED, symbol=VAR_CLEARED_32
        ETHSM_VAR_CLEARED_UNSPECIFIED: alignment=UNSPECIFIED, prefix=ETHSM, sw-addrmethod=VAR_CLEARED, symbol=VAR_CLEARED_UNSPECIFIED
        ETHSM_VAR_INIT_8: alignment=8, prefix=ETHSM, sw-addrmethod=VAR_INIT, symbol=VAR_INIT_8
        ETHSM_VAR_INIT_16: alignment=16, prefix=ETHSM, sw-addrmethod=VAR_INIT, symbol=VAR_INIT_16
        ETHSM_VAR_INIT_UNSPECIFIED: alignment=UNSPECIFIED, prefix=ETHSM, sw-addrmethod=VAR_INIT, symbol=VAR_INIT_UNSPECIFIED
        EthSM_CODE: prefix=EthSM, sw-addrmethod=CODE, symbol=CODE
        ETHSM_CODE: prefix=ETHSM, sw-addrmethod=CODE, symbol=CODE
        ETHSM_CODE_FAST: prefix=ETHSM, sw-addrmethod=CODE_FAST, symbol=CODE_FAST
      section name prefix EthSM
      section name prefix ETHSM
package /AUTOSAR_EthSM/BswModuleDescriptions
  bsw module description EthSM
    bsw internal behavior BswInternalBehavior: data-type-mapping=DataTypeMappingSet
      static-memorys:
        data EthSM_NetState_aen: category=ARRAY, sw-addr-method=INTERNAL_VAR_CLEARED, sw-calibration-access=READ-ONLY, display-format=%5.1f, type=EthSM_NetworkModeStateType_au8_app  # Gives information about states defined internally for EthSM Networks (ETHSM_STATE_OFFLINE - EthSM is initialized in this state, ETHSM_STATE_WAIT_TRCVLINK - ComM requests COMM_FULL_COMMUNICATION in this state, Ctrl and Trcv will be initialized and set to ACTIVE. EthSM waits for transceiver link state (ACTIVE),ETHSM_STATE_WAIT_ONLINE - Transceiver link state is ACTIVE. EthSM waits for IP communication (TcpIP state = ONLINE), ETHSM_STATE_ONLINE - IP communication is availabe ComM state COMM_FULL_COMMUNICATION is reached, ETHSM_STATE_ONHOLD - EthSM lost active transceiver link state, TcpIP state is still online, ETHSM_STATE_WAIT_OFFLINE - ComM requests COMM_NO_COMMUNICATION in this state)
      bsw schedulable entity SE_MainFunction: implemented-entry=EthSM_MainFunction
      bsw timing event EV_SE_MainFunction: starts-on-event=SE_MainFunction, period=0.01
package /AUTOSAR_EthSM/DataTypeMappingSets
  data type mapping set DataTypeMappingSet
    data-type-maps:
      application-data-type=EthSM_NetworkModeStateType_au8_app, implementation-data-type=EthSM_NetworkModeStateType_au8_impl
      application-data-type=EthSM_NetworkModeStateType_Enum, implementation-data-type=EthSM_NetworkModeStateType_Enum_impl
package /AUTOSAR_EthSM/ImplementationDataTypes
  impl type EthSM_NetworkModeStateType_au8_impl: category=ARRAY  # Array of NetworkModeStateType
    element EthSM_Array_Element_of_NetworkModeStateType: array-size=1, array-size-semantics=FIXED-SIZE, implementation-data-type=EthSM_NetworkModeStateType_Enum_impl
  impl type EthSM_NetworkModeStateType_Enum_impl: implementation-data-type=uint8  # Enumeration for EthSM Network Mode State Type
package /AUTOSAR_EthSM/Units
  unit NoUnit: display-name=noUnit, factor-si-to-unit=1.0, offset-si-to-unit=0.0, physical-dimension=NoUnit  # No Unit
package /AUTOSAR_EthSM/PhysicalDimensions
  physical dimension NoUnit: length-exp=0
