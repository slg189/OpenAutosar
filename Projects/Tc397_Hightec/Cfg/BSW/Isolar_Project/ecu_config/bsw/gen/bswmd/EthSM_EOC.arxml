AUTOSAR XML (schema 4-3-0)
package /AUTOSAR_EthSM/TimingExtensions
  bsw module timing EthSM: behavior=BswInternalBehavior
    timing-descriptions:
      td event bsw internal behavior EOC_T_xxms: bsw-module-entity=SE_MainFunction
      td event bsw module EOC_EthSM_Init: bsw-module-description=EthSM, bsw-module-entry=EthSM_Init, td-event-bsw-module-type=BSW-M-ENTRY-CALLED
    timing-requirements:
      execution order constraint EOC_T_xxms: execution-order-constraint-type=ORDINARY-EOC, is-event=true, permit-multiple-references-to-ee=false
        ordered-elements:
          eoc event ref EOCEventRef_EthSM_1: bsw-module-instance=EthSM, event=EV_SE_MainFunction, successor=[EOCEventRef_TcpIp_1, EOCEventRef_EthIf_State_1]
