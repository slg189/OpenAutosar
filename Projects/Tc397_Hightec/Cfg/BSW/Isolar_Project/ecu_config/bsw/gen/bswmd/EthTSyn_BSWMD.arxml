AUTOSAR XML (schema 4-2-2)
package /AUTOSAR_EthTSyn/BswModuleDescriptions
  bsw module description EthTSyn: category=BSW_MODULE, module-id=164, provided-entrys=[EthTSyn_GetVersionInfo, EthTSyn_Init, EthTSyn_MainFunction, EthTSyn_SetTransmissionMode], outgoing-callbacks=[EthTSyn_RxIndication, EthTSyn_TrcvLinkStateChg, EthTSyn_TxConfirmation]  # Time Sync Over Ethernet
package /AUTOSAR_EthTSyn/BswModuleEntrys
  7 x bsw module entry, all with is-reentrant=false, is-synchronous=true, sw-service-impl-policy=STANDARD:
    EthTSyn_GetVersionInfo: service-id=0x02, call-type=REGULAR, execution-context=UNSPECIFIED  # This services fetches the software version information of the EthTSyn module. | The software major, minor and patch version of the EthTSyn module is put out.
      sw service arg versioninfo: category=DATA_REFERENCE, direction=OUT, sw-pointer-target-props={target-category=VALUE, implementation-data-type=Std_VersionInfoType}  # Pointer to store the version information of this module.
    EthTSyn_Init: service-id=0x01, call-type=REGULAR, execution-context=UNSPECIFIED  # This service initializes the EthTSyn Module. | EthTSyn_Init( const EthTSyn_ConfigType* ConfigPtr ) , The service initializes global variables, RAM data structures of EthTSyn modules.
    EthTSyn_MainFunction: service-id=0x09, call-type=SCHEDULED, execution-context=TASK  # This service schedules the EthTSyn Module. | The service schedules EthTSyn Module and operates the effects of the EthTSyn state machines.
    EthTSyn_RxIndication: service-id=0x06, call-type=CALLBACK, execution-context=UNSPECIFIED  # This service indicates the reception of a frame. | By this API service the EthTSyn gets an indication and the data of a received frame.
      6 x sw service arg, all with direction=IN:
        CtrlIdx: implementation-data-type=uint8  # Index of the Ethernet controller.
        FrameType: implementation-data-type=Eth_FrameType  # Frame type of received Ethernet frame.
        IsBroadcast: implementation-data-type=boolean  # Parameter to indicate a broadcast frame.
        PhysAddrPtr: category=DATA_REFERENCE, sw-pointer-target-props={target-category=VALUE, implementation-data-type=uint8}  # Pointer to the memory where the physical source address (MAC address) in network byte order is stored.
        DataPtr: category=DATA_REFERENCE, sw-pointer-target-props={target-category=VALUE, implementation-data-type=uint8}  # Pointer to payload of the received Ethernet frame (i.e. Ethernet header is not provided).
        LenByte: implementation-data-type=uint16  # Length of received data.
    EthTSyn_SetTransmissionMode: service-id=0x05, call-type=REGULAR, execution-context=UNSPECIFIED  # This API is used to turn on and off the TX capabilities of the EthTSyn.
      sw service arg CtrlIdx: direction=IN, implementation-data-type=uint8  # Index of the Ethernet controller.
      sw service arg Mode: direction=IN, implementation-data-type=EthTSyn_TransmissionModeType  # ETHTSYN_TX_OFF ETHTSYN_TX_ON
    EthTSyn_TrcvLinkStateChg: service-id=0x08, call-type=CALLBACK, execution-context=UNSPECIFIED  # Allows resetting state machine in case of unexpected Link loss to avoid inconsistent Sync and Follow_Up sequences.
      sw service arg CtrlIdx: direction=IN, implementation-data-type=uint8  # Index of the Ethernet controller.
      sw service arg TrcvLinkState: direction=IN, implementation-data-type=EthTrcv_LinkStateType  # ETHTRCV_LINK_STATE_DOWN ETHTRCV_LINK_STATE_ACTIVE
    EthTSyn_TxConfirmation: service-id=0x07, call-type=CALLBACK, execution-context=UNSPECIFIED  # Confirms the transmission of an Ethernet frame. | Confirms the transmission of an Ethernet frame
      sw service arg CtrlIdx: direction=IN, implementation-data-type=uint8  # Index of the Ethernet controller.
      sw service arg BufIdx: direction=IN, implementation-data-type=uint8  # Index of the buffer resource.
package /AUTOSAR_EthTSyn/ImplementationDataTypes
  impl type EthTSyn_TransmissionModeType: compu {0=ETHTSYN_TX_OFF (Transmission Disabled.), 1=ETHTSYN_TX_ON (Transmission Enabled.)}, implementation-data-type=uint8, type-emitter=HEADER_FILE  # Type specifying the EthTSyn Transmission Mode. | Handles the enabling and disabling of the transmission mode.
  impl type EthTSyn_SyncStateType: compu {0=ETHTSYN_SYNC (Ethernet time synchronous.), 1=ETHTSYN_UNSYNC (Ethernet not time synchronous.), 2=ETHTSYN_UNCERTAIN (Ethernet Sync state uncertain.), 3=ETHTSYN_NEVERSYNC (No Sync message received between EthTSyn_Init() and current requested state.)}, implementation-data-type=uint8, type-emitter=HEADER_FILE  # Type specifying the EthTSyn Sync State. | Depending on the HW, quality information regarding the evaluated Sync state might be supported.
