AUTOSAR XML (schema 4-2-2)
package /AUTOSAR_EthTSyn/BswImplementations
  bsw implementation EthTSyn: programming-language=C, sw-version=10.0.0, ar-release-version=4.2.2, behavior=BswInternalBehavior
    code-descriptors:
      code CodeDescriptor: artifact-descriptors=autosar-engineering-object={short-label=ArEngObj, category=SWSRC}
    resource consumption EthTSyn_ResourceConsumption
      5 x memory section:
        ETHTSYN_CONST_UNSPECIFIED: alignment=UNSPECIFIED, prefix=ETHTSYN, sw-addrmethod=CONST, symbol=CONST_UNSPECIFIED
        ETHTSYN_VAR_CLEARED_UNSPECIFIED: alignment=UNSPECIFIED, prefix=ETHTSYN, sw-addrmethod=VAR_CLEARED, symbol=VAR_CLEARED_UNSPECIFIED
        ETHTSYN_VAR_INIT_UNSPECIFIED: alignment=UNSPECIFIED, prefix=ETHTSYN, sw-addrmethod=VAR_INIT, symbol=VAR_INIT_UNSPECIFIED
        EthTSyn_CODE: prefix=EthTSyn, sw-addrmethod=CODE, symbol=CODE
        ETHTSYN_CODE: prefix=ETHTSYN, sw-addrmethod=CODE, symbol=CODE
      section name prefix EthTSyn
      section name prefix ETHTSYN
package /AUTOSAR_EthTSyn/BswModuleDescriptions
  bsw module description EthTSyn
    bsw internal behavior BswInternalBehavior
      bsw schedulable entity SE_MainFunction: implemented-entry=EthTSyn_MainFunction
      bsw timing event EV_SE_MainFunction: starts-on-event=SE_MainFunction, period=0.01
package /AUTOSAR_EthTSyn/Units
  unit NoUnit: display-name=noUnit, factor-si-to-unit=1.0, offset-si-to-unit=0.0, physical-dimension=NoUnit  # No Unit
package /AUTOSAR_EthTSyn/PhysicalDimensions
  physical dimension NoUnit: length-exp=0
