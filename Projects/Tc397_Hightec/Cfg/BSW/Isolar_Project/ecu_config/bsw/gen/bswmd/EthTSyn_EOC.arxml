AUTOSAR XML (schema 4-2-2)
package /AUTOSAR_EthTSyn/TimingExtensions
  bsw module timing EthTSyn: behavior=BswInternalBehavior
    timing-descriptions:
      td event bsw module EOC_EthTSyn_Init: bsw-module-description=EthTSyn, bsw-module-entry=EthTSyn_Init, td-event-bsw-module-type=BSW-M-ENTRY-CALLED
      td event bsw internal behavior EOC_T_xxms: bsw-module-entity=SE_MainFunction
    timing-requirements:
      execution order constraint EOC_T_xxms: execution-order-constraint-type=ORDINARY-EOC, is-event=true, permit-multiple-references-to-ee=false
        ordered-elements:
          eoc event ref EOCEventRef_EthTSyn_1: bsw-module-instance=EthTSyn, event=EV_SE_MainFunction, successor=EOCEventRef_EthIf_Tx_1
