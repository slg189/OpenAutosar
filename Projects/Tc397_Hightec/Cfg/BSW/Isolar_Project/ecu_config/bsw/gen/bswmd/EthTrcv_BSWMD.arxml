AUTOSAR XML (schema 4-0-3)
package /AUTOSAR_EthTrcv/BswModuleDescriptions
  bsw module description EthTrcv: category=BSW_MODULE, module-id=73, provided-entrys=EthTrcv_MainFunction
package /AUTOSAR_EthTrcv/BswModuleEntrys
  bsw module entry EthTrcv_MainFunction: is-reentrant=false, is-synchronous=true, call-type=SCHEDULED, execution-context=TASK, sw-service-impl-policy=STANDARD  # Cyclic Main Function which is called from the scheduler | EthTrcv stores the mode request or status from EthTrcv_SetTransceiverMode() and the mode change will be executed in th EthTrcv_MainFunction. Also, the link status and the mode status will be monitored.
