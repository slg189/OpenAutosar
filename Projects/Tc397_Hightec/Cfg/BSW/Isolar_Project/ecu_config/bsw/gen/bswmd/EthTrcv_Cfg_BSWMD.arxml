AUTOSAR XML (schema 4-2-2)
package /AUTOSAR_EthTrcv/BswImplementations
  bsw implementation EthTrcv: programming-language=C, sw-version=10.0.0, ar-release-version=4.2.2, behavior=BswInternalBehavior
    code-descriptors:
      code CodeDescriptor: artifact-descriptors=autosar-engineering-object={short-label=ArEngObj, category=SWSRC}
package /AUTOSAR_EthTrcv/BswModuleDescriptions
  bsw module description EthTrcv
    bsw internal behavior BswInternalBehavior
      bsw schedulable entity SE_MainFunction: implemented-entry=EthTrcv_MainFunction
      bsw timing event EV_SE_MainFunction: starts-on-event=SE_MainFunction, period=0.001
package /AUTOSAR_EthTrcv/Units
  unit NoUnit: display-name=noUnit, factor-si-to-unit=1.0, offset-si-to-unit=0.0, physical-dimension=NoUnit  # No Unit
package /AUTOSAR_EthTrcv/PhysicalDimensions
  physical dimension NoUnit: length-exp=0
