AUTOSAR XML (schema 4-3-0)
package /AUTOSAR_EthTrcv/TimingExtensions
  bsw module timing EthTrcv: behavior=BswInternalBehavior
    timing-descriptions:
      td event bsw internal behavior EOC_T_xxms: bsw-module-entity=SE_MainFunction
    timing-requirements:
      execution order constraint EOC_T_xxms: execution-order-constraint-type=ORDINARY-EOC, is-event=true, permit-multiple-references-to-ee=false
        ordered-elements:
          eoc event ref EOCEventRef_EthTrcv_1: bsw-module-instance=EthTrcv, event=EV_SE_MainFunction
