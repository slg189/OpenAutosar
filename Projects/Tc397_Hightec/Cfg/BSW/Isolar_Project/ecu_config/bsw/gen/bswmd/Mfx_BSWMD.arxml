AUTOSAR XML (schema 4-1-1)
package /AUTOSAR_Mfx/BswModuleDescriptions
  bsw module description Mfx: category=BSW_MODULE, module-id=211
    bsw internal behavior BswInternalBehavior
      bsw scheduler name prefix Mfx
package /AUTOSAR_Mfx/BswImplementations
  bsw implementation Mfx: programming-language=C, sw-version=7.1.0, ar-release-version=4.2.2, behavior=BswInternalBehavior
    code-descriptors:
      code CodeDescriptor: artifact-descriptors=autosar-engineering-object={short-label=ArEngObj, category=SWSRC}
    resource consumption Mfx_ResourceConsumption
      memory section MFX_CODE_SLOW: prefix=MFX, sw-addrmethod=CODE_SLOW, symbol=CODE_SLOW
      memory section MFX_CODE_FAST: prefix=MFX, sw-addrmethod=CODE_FAST, symbol=CODE_FAST
      memory section MFX_CODE: prefix=MFX, sw-addrmethod=CODE, symbol=CODE
      section name prefix MFX
