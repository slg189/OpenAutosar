AUTOSAR XML (schema 4-2-2)
package /AUTOSAR_Nm/BswModuleEntrys
  bsw module entry Nm_Init: is-reentrant=false, is-synchronous=true, call-type=REGULAR, execution-context=UNSPECIFIED, sw-service-impl-policy=STANDARD
  bsw module entry Nm_NetworkMode: is-reentrant=true, is-synchronous=true, call-type=CALLBACK, execution-context=UNSPECIFIED, sw-service-impl-policy=STANDARD
