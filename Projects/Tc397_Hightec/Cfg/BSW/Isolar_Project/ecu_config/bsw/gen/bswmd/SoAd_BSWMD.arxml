AUTOSAR XML (schema 4-0-3)
package /AUTOSAR_SoAd/BswModuleDescriptions
  bsw module description SoAd: category=BSW_MODULE, module-id=56
    provided-entrys:
      SoAd_ChangeParameter
      SoAd_CloseSoCon
      SoAd_CopyTxData
      SoAd_DisableRouting
      SoAd_DisableSpecificRouting
      SoAd_EnableRouting
      SoAd_EnableSpecificRouting
      SoAd_GetLocalAddr
      SoAd_GetPhysAddr
      SoAd_GetRemoteAddr
      SoAd_GetSoConId
      SoAd_GetVersionInfo
      SoAd_IfRoutingGroupTransmit
      SoAd_IfSpecificRoutingGroupTransmit
      SoAd_IfTransmit
      SoAd_Init
      SoAd_LocalIpAddrAssignmentChg
      SoAd_MainFunction
      SoAd_OpenSoCon
      SoAd_ReadDhcpHostNameOption
      SoAd_ReleaseIpAddrAssignment
      SoAd_RequestIpAddrAssignment
      SoAd_RxIndication
      SoAd_SetRemoteAddr
      SoAd_SetUniqueRemoteAddr
      SoAd_TcpAccepted
      SoAd_TcpConnected
      SoAd_TcpIpEvent
      SoAd_TpCancelReceive
      SoAd_TpCancelTransmit
      SoAd_TpTransmit
      SoAd_TxConfirmation
      SoAd_WriteDhcpHostNameOption
      SoAd_GetAndResetMeasurementData
    6 x bsw module dependency:
      ComStack: target-module-id=196
      Det: target-module-id=15
      PduR: target-module-id=51
      Sd: target-module-id=171
      TcpIp: target-module-id=170
      UdpNm: target-module-id=33
package /AUTOSAR_SoAd/BswModuleEntrys
  35 x bsw module entry, all with sw-service-impl-policy=STANDARD:
    SoAd_MainFunction: service-id=25, is-reentrant=false, is-synchronous=true, call-type=SCHEDULED, execution-context=TASK  # This API Schedules the Socket Adaptor(Entry point for scheduling)
    SoAd_MainFunction_1ms: service-id=38, is-reentrant=false, is-synchronous=true, call-type=SCHEDULED, execution-context=TASK  # This API Schedules the Socket Adaptor for Time Out ParamHandling every 1milliseconds
    SoAd_ChangeParameter: service-id=17, is-reentrant=false, is-synchronous=false, call-type=REGULAR, execution-context=UNSPECIFIED  # This API can be requested to control the connection parameter either by SoAd or TcpIp
      sw service arg SoConId: direction=IN, implementation-data-type=SoAd_SoConIdType  # Socket connection index specifying the socket connection which shall be closed
      sw service arg ParameterId: direction=IN, implementation-data-type=SoAd_ParamIdType  # Parameter which is requested by UL to get or set the values
      sw service arg ParameterValuePtr: category=DATA_REFERENCE, direction=IN, implementation-data-type=uint8  # Pointer to an address which contains the value for the corresponding ParameterId in case of set request.Else, this address will be filled by TcpIp module if its a Get request.
    SoAd_CloseSoCon: service-id=9, is-reentrant=false, is-synchronous=false, call-type=REGULAR, execution-context=UNSPECIFIED  # This API This service closes the socket connection specified by SoConId
      sw service arg SoConId: direction=IN, implementation-data-type=SoAd_SoConIdType  # Socket connection index specifying the socket connection which shall be closed
      sw service arg Abort: direction=IN, implementation-data-type=boolean  # TRUE: socket connection will immediately be terminated FALSE: socket connection will be terminated if no other upper layer is using this socket connection
    SoAd_CopyTxData: service-id=19, is-reentrant=false, is-synchronous=true, call-type=REGULAR, execution-context=UNSPECIFIED  # This API requests to copy data for transmission to the buffer indicated. This call is triggered by TcpIp_Transmit(). Note: The call to SoAd_CopyTxData() may happen in the context of TcpIp_Transmit() | This API requests to copy data for transmission to the buffer indicated. This call is triggered by TcpIp_Transmit(). Note: The call to SoAd_CopyTxData() may happen in the context of TcpIp_Transmit().
      sw service arg SocketId: direction=IN, implementation-data-type=TcpIp_SocketIdType  # Socket identifier of the related local socket resource
      sw service arg BufPtr: category=DATA_REFERENCE, direction=IN, implementation-data-type=uint8  # Pointer to buffer for transmission data
      sw service arg BufLength: direction=IN, implementation-data-type=uint16  # Length of provided data buffer
    SoAd_DisableRouting: service-id=15, is-reentrant=false, is-synchronous=false, call-type=REGULAR, execution-context=UNSPECIFIED  # Disables routing of a group of PDUs in the SoAd related to the RoutingGroup specified by parameter id
      sw service arg id: direction=IN, implementation-data-type=SoAd_RoutingGroupIdType  # Id of the soad routing group, for which the routing should be disabled
    SoAd_DisableSpecificRouting: service-id=33, is-reentrant=false, is-synchronous=false, call-type=REGULAR, execution-context=UNSPECIFIED  # Disables routing of a group of PDUs in the SoAd related to the RoutingGroup specified by parameter id only on the socket connection identified by SoConId
      sw service arg id: direction=IN, implementation-data-type=SoAd_RoutingGroupIdType  # Id of the soad routing group, for which the routing should be enabled
      sw service arg SoConId: direction=IN, implementation-data-type=SoAd_SoConIdType  # Id of the socket connection index, for which the routing group shall be enabled
    SoAd_EnableRouting: service-id=14, is-reentrant=false, is-synchronous=false, call-type=REGULAR, execution-context=UNSPECIFIED  # Enables routing of a group of PDUs in the SoAd related to the RoutingGroup specified by parameter id
      sw service arg id: direction=IN, implementation-data-type=SoAd_RoutingGroupIdType  # Id of the soad routing group, for which the routing should be enabled
    SoAd_EnableSpecificRouting: service-id=32, is-reentrant=false, is-synchronous=false, call-type=REGULAR, execution-context=UNSPECIFIED  # Enables routing of a group of PDUs in the SoAd related to the RoutingGroup specified by parameter id only on the socket connection identified by SoConId
      sw service arg id: direction=IN, implementation-data-type=SoAd_RoutingGroupIdType  # Id of the soad routing group, for which the routing should be enabled
      sw service arg SoConId: direction=IN, implementation-data-type=SoAd_SoConIdType  # Id of the socket connection index, for which the routing group shall be enabled
    SoAd_GetLocalAddr: service-id=12, is-reentrant=false, is-synchronous=false, call-type=REGULAR, execution-context=UNSPECIFIED  # Obtains the local address (IP address and port) actually used for the SoAd socket connection specified by SoConIdx, the netmask and default router
      4 x sw service arg:
        SoConId: direction=IN, implementation-data-type=SoAd_SoConIdType  # Socket connection index representing the SoAd socket connection for which the actual local IP address shall be obtained
        LocalAddrPtr: category=DATA_REFERENCE, direction=OUT, implementation-data-type=TcpIp_SockAddrType  # Pointer to struct where the IP address of the default router (gateway) is stored (struct member port is not used and of arbitrary value)
        NetmaskPtr: category=DATA_REFERENCE, direction=OUT, implementation-data-type=uint8  # Pointer to memory where Network mask of IPv4 address or address prefix of IPv6 address in CIDR Notation is stored
        DefaultRouterPtr: category=DATA_REFERENCE, direction=OUT, implementation-data-type=TcpIp_SockAddrType  # Pointer to a struct where the local address (IP address and port) is stored
    SoAd_GetPhysAddr: service-id=13, is-reentrant=false, is-synchronous=false, call-type=REGULAR, execution-context=UNSPECIFIED  # Obtains the physical source address of the EthIf controller used by the SoAd socket connection specified by SoConIdx
      sw service arg SoConId: direction=IN, implementation-data-type=SoAd_SoConIdType  # Socket connection index representing the SoAd socket connection for which the physical source address of the related EthIf controller shall be obtained
      sw service arg PhysAddrPtr: category=DATA_REFERENCE, direction=OUT, implementation-data-type=uint8  # Pointer to the memory where the physical source address (MAC address) in network byte order is stored
    SoAd_GetRemoteAddr: service-id=28, is-reentrant=false, is-synchronous=false, call-type=REGULAR, execution-context=UNSPECIFIED  # Retrieves the remote address (IP address and port) actually used for the SoAd socket connection specified by SoConId
      sw service arg SoConId: direction=IN, implementation-data-type=SoAd_SoConIdType  # Socket connection index representing the SoAd socket connection for which the actually specified remote address shall be obtained
      sw service arg IpAddrPtr: category=DATA_REFERENCE, direction=OUT, implementation-data-type=TcpIp_SockAddrType  # Pointer to a struct where the retrieved remote address (IP address and port) is stored
    SoAd_GetSoConId: service-id=07, is-reentrant=false, is-synchronous=false, call-type=REGULAR, execution-context=UNSPECIFIED  # This function is called from SoAd_GetSoConId to handle the DET error for function arguments. It covers SWS_SoAd_00609 &amp; SWS_SoAd_00610 requirements
      sw service arg TxPduId: direction=IN, implementation-data-type=PduIdType  # Transmit PduId specifying the SoAd socket connection for which the socket connection index shall be returned
      sw service arg SoConIdPtr: category=DATA_REFERENCE, direction=OUT, implementation-data-type=SoAd_SoConIdType  # Pointer to memory receiving the socket connection index asked for
    SoAd_GetVersionInfo: service-id=02, is-reentrant=false, is-synchronous=false, call-type=REGULAR, execution-context=UNSPECIFIED  # Service for passing the Information through a pointer "*VersionInfo"
      sw service arg versioninfo: category=DATA_REFERENCE, direction=OUT, implementation-data-type=Std_VersionInfoType  # Pointer to where to store the version information of this module
    SoAd_IfRoutingGroupTransmit: service-id=29, is-reentrant=false, is-synchronous=false, call-type=REGULAR, execution-context=UNSPECIFIED  # This API Triggers the transmission of all If-TxPDUs identified by the parameter id after requesting the data from the related upper layer
      sw service arg id: direction=IN, implementation-data-type=SoAd_RoutingGroupIdType  # This parameter contains the routing group identifier indirectly specifying PDUs to be transmitted and thereby specifying the socket to be used for transmission of the data
    SoAd_IfSpecificRoutingGroupTransmit: service-id=31, is-reentrant=false, is-synchronous=false, call-type=REGULAR, execution-context=UNSPECIFIED  # This API Triggers the transmission of all If-TxPDUs identified by the parameter id on the socket connectio specified by SoConId after requesting the data from the related upper layer | This API Triggers the transmission of all If-TxPDUs identified by the parameter id on the socket connectio specified by SoConId after requesting the data from the related upper layer.
      sw service arg id: direction=IN, implementation-data-type=SoAd_RoutingGroupIdType  # This parameter contains the routing group identifier indirectly specifying PDUs to be transmitted (after requesting the newest data from the related upper layer)
      sw service arg SoConId: direction=IN, implementation-data-type=SoAd_SoConIdType  # socket connection index specifying the socket connection on which the PDUs shall be transmitted.
    SoAd_IfTransmit: service-id=03, is-reentrant=false, is-synchronous=false, call-type=REGULAR, execution-context=UNSPECIFIED  # This API initiates a request for transmission of the L-PDU specified by the SoAdSrcPduId
      sw service arg SoAdSrcPduId: direction=IN, implementation-data-type=PduIdType  # This parameter contains a unique identifier referencing to the PDU Routing Table and thereby specifying the socket to be used for transmission of the data
      sw service arg SoAdSrcPduInfoPtr: category=DATA_REFERENCE, direction=IN, implementation-data-type=PduInfoType  # A pointer to a structure with socket related data: data length and pointer to a data buffer
    SoAd_Init: service-id=01, is-reentrant=false, is-synchronous=false, call-type=REGULAR, execution-context=UNSPECIFIED  # This service initializes all global variables of a Socket Adaptor instance and puts it into the idle state. It has no return value because software errors in initialization data shall be detected during configuration time (e.g. by configuration tool). Furthermore, if a hardware error occurs it shall be reported via the error manager modules | This service initializes all global variables of a Socket Adaptor instance and puts it into the idle state. It has no return value because software errors in initialization data shall be detected during configuration time (e.g. by configuration tool). Furthermore, if a hardware error occurs it shall be reported via the error manager modules.
      sw service arg SoAdConfigPtr: category=DATA_REFERENCE, direction=IN, implementation-data-type=SoAd_ConfigType  # Pointer to the configuration data of the SoAd module
    SoAd_LocalIpAddrAssignmentChg: service-id=0, is-reentrant=false, is-synchronous=true, call-type=REGULAR, execution-context=UNSPECIFIED  # SoAd_LocalIpAssignmentChg() gets called by the TCP/IP stack if an IP address assignment changes
      sw service arg IpAddrId: direction=IN, implementation-data-type=TcpIp_LocalAddrIdType  # IP address Identifier, representing an IP address specified in the TcpIp module configuration
      sw service arg State: direction=IN, implementation-data-type=TcpIp_IpAddrStateType  # State of IP address assignment
    SoAd_OpenSoCon: service-id=8, is-reentrant=false, is-synchronous=false, call-type=REGULAR, execution-context=UNSPECIFIED  # This API opens the socket connection specified by SoConId
      sw service arg SoConId: direction=IN, implementation-data-type=SoAd_SoConIdType  # Socket connection index specifying the socket connection which shall be opened
    SoAd_ReadDhcpHostNameOption: service-id=26, is-reentrant=false, is-synchronous=false, call-type=REGULAR, execution-context=UNSPECIFIED  # SoAd_ReadDhcpHostNameOption() gets called by the UL to read the currently configured hostname
      sw service arg SoConId: direction=IN, implementation-data-type=SoAd_SoConIdType  # Socket connection index specifying the socket connection for which the parameter shall be read
      sw service arg length: category=DATA_REFERENCE, direction=OUT, implementation-data-type=uint8  # Pointer to an uint8 address where length of the host name will be copied
      sw service arg data: category=DATA_REFERENCE, direction=OUT, implementation-data-type=uint8  # Pointer to an uint8 address where host name will be copied
    SoAd_ReleaseIpAddrAssignment: service-id=11, is-reentrant=false, is-synchronous=false, call-type=REGULAR, execution-context=UNSPECIFIED  # By this API service the local IP address assignment which shall be released for the socket connection specified by SoConIdx
      sw service arg SoConId: direction=IN, implementation-data-type=SoAd_SoConIdType  # Socket connection index specifying the socket connection for which the IP address shall be released
    SoAd_RequestIpAddrAssignment: service-id=10, is-reentrant=false, is-synchronous=false, call-type=REGULAR, execution-context=UNSPECIFIED  # By this API service the local IP address assignment which shall be used for the socket connection specified by SoConIdx is initiated
      5 x sw service arg, all with direction=IN:
        SoConId: implementation-data-type=SoAd_SoConIdType  # Socket connection index specifying the socket connection for which the IP address shall be set
        Type: implementation-data-type=TcpIp_IpAddrAssignmentType  # Type of IP address assignment which shall be initiated
        LocalIpAddrPtr: category=DATA_REFERENCE, implementation-data-type=TcpIp_SockAddrType  # Pointer to structure containing the IP address which shall be assigned to the EthIf controller indirectly specified via SoConIdx. Note:This parameter is only use in case parameter Type is set to TCPIP_IPADDR_ASSIGNMENT_STATIC.
        Netmask: implementation-data-type=uint8  # Network mask of IPv4 address or address prefix of IPv6 address in CIDR Notation Note: This parameter is only used in case the parameter Type is set to TCPIP_IPADDR_ASSIGNMENT_STATIC.
        DefaultRouterPtr: category=DATA_REFERENCE, implementation-data-type=TcpIp_SockAddrType  # Pointer to structure containing the IP address of the default router (gateway) which shall be assigned. Note: This parameter is only used in case the parameter Type is set to TCPIP_IPADDR_ASSIGNMENT_STATIC, can be set to NULL_PTR otherwise.
    SoAd_RxIndication: service-id=0, is-reentrant=false, is-synchronous=true, call-type=REGULAR, execution-context=UNSPECIFIED  # The TCP/IP stack calls this primitive after the reception of data on a socket. The socket identifier along with configuration information determines which module is to be called | The TCP/IP stack calls this primitive after the reception of data on a socket. The socket identifier along with configuration information determines which module is to be called.
      4 x sw service arg, all with direction=IN:
        SocketId: implementation-data-type=TcpIp_SocketIdType  # TcpIp socket identifier of the related local socket resource
        RemoteAddrPtr: category=DATA_REFERENCE, implementation-data-type=TcpIp_SockAddrType  # Pointer to memory containing IP address and port of the remote host which sent the data
        BufPtr: category=DATA_REFERENCE, implementation-data-type=uint8  # Pointer to the received data
        Length: implementation-data-type=uint16  # Data length of the received TCP segment or UDP datagram
    SoAd_SetRemoteAddr: service-id=16, is-reentrant=false, is-synchronous=false, call-type=REGULAR, execution-context=UNSPECIFIED  # By this API service the remote address (IP address and port) of the specified socket connection shall be set
      sw service arg SoConId: direction=IN, implementation-data-type=SoAd_SoConIdType  # Socket connection index specifying the socket connection for which the remote address shall be set
      sw service arg RemoteAddrPtr: category=DATA_REFERENCE, direction=IN, implementation-data-type=TcpIp_SockAddrType  # Struct contain the IP address and port to be set
    SoAd_SetUniqueRemoteAddr: service-id=30, is-reentrant=false, is-synchronous=false, call-type=REGULAR, execution-context=UNSPECIFIED  # The TCP/IP stack calls this function after a socket was set into the listen state with TcpIp_TcpListen() and a TCP connection is requested by the peer
      sw service arg SoConId: direction=IN, implementation-data-type=SoAd_SoConIdType  # Index of any socket connection that is part of the SoAdSocketConnectionGroup
      sw service arg RemoteAddrPtr: category=DATA_REFERENCE, direction=IN, implementation-data-type=TcpIp_SockAddrType  # Pointer to the structure containing the requested remote IP address and port
      sw service arg AssignedSoConIdPtr: category=DATA_REFERENCE, direction=IN, implementation-data-type=SoAd_SoConIdType  # Pointer to the SoAd_SoConIdType where the index of the socket connection configured with the remote address (IpAddrPtr) shall be stored
    SoAd_TcpAccepted: service-id=0, is-reentrant=false, is-synchronous=true, call-type=REGULAR, execution-context=UNSPECIFIED  # The TCP/IP stack calls this function after a socket was set into the listen state with TcpIp_TcpListen() and a TCP connection is requested by the peer
      sw service arg SocketId: direction=IN, implementation-data-type=TcpIp_SocketIdType  # Socket identifier of the related local socket resource
      sw service arg SocketIdConnected: direction=IN, implementation-data-type=TcpIp_SocketIdType  # Socket identifier of the local socket resource used for the established connection
      sw service arg RemoteAddrPtr: category=DATA_REFERENCE, direction=IN, implementation-data-type=TcpIp_SockAddrType  # Pointer to IP address and port of the remote host
    SoAd_TcpConnected: service-id=0, is-reentrant=false, is-synchronous=true, call-type=REGULAR, execution-context=UNSPECIFIED  # The TCP/IP stack calls this function after a socket was requested to connect with TcpIp_TcpConnect() and a TCP connection is confirmed by the peer
      sw service arg SocketId: direction=IN, implementation-data-type=TcpIp_SocketIdType  # Socket identifier of the related local socket resource
    SoAd_TcpIpEvent: service-id=0, is-reentrant=false, is-synchronous=true, call-type=REGULAR, execution-context=UNSPECIFIED  # SoAd_TcpIpEvent() gets called if the stack encounters a condition described by the values in TcpIpEvent
      sw service arg SocketId: direction=IN, implementation-data-type=TcpIp_SocketIdType  # Socket identifier of the related local socket resource
      sw service arg Event: direction=IN, implementation-data-type=TcpIp_EventType  # This parameter contains a description of the event just encountered
    SoAd_TpCancelReceive: service-id=06, is-reentrant=false, is-synchronous=false, call-type=REGULAR, execution-context=UNSPECIFIED  # Requests cancellation of the reception for a specific I-PDU
      sw service arg PduId: direction=IN, implementation-data-type=PduIdType  # Identifiaction of the I-PDU to be cancelled
    SoAd_TpCancelTransmit: service-id=05, is-reentrant=false, is-synchronous=false, call-type=REGULAR, execution-context=UNSPECIFIED  # Requests cancellation of the transmission via TP for a specific I-PDU
      sw service arg PduId: direction=IN, implementation-data-type=PduIdType  # Identifiaction of the I-PDU to be cancelled
    SoAd_TpTransmit: service-id=04, is-reentrant=false, is-synchronous=false, call-type=REGULAR, execution-context=UNSPECIFIED  # This service is utilized to request the transfer of data. It sets a flag for indicating that a transmit request is present. This function has to be called with the PDU-ID of the SoAd, i.e. the upper layer has to translate its own PDU-ID into the one of the SoAd for the corresponding message. This call shall fail if no entry for the PDU-ID can be found in the socket connection table. Within the provided SoAdSrcPduInfoPtr only SduLength is valid (no data)! If this function returns E_OK then there will arise a call of &lt;Ul&gt;_SoAdCopyTxData in order to get data for sending | This service is utilized to request the transfer of data. It sets a flag for indicating that a transmit request is present. This function has to be called with the PDU-ID of the SoAd, i.e. the upper layer has to translate its own PDU-ID into the one of the SoAd for the corresponding message. This call shall fail if no entry for the PDU-ID can be found in the socket connection table. Within the provided SoAdSrcPduInfoPtr only SduLength is valid (no data)! If this function returns E_OK then there will arise a call of &lt;Ul&gt;_SoAdCopyTxData in order to get data for sending.
      sw service arg SoAdSrcPduId: direction=IN, implementation-data-type=PduIdType  # This parameter contains a unique identifier referencing to the PDU Routing Table and thereby specifying the socket to be used for transmission of the data
      sw service arg SoAdSrcPduInfoPtr: category=DATA_REFERENCE, direction=IN, implementation-data-type=PduInfoType  # A pointer to a structure with socket related data: data length and pointer to a data buffer
    SoAd_TxConfirmation: service-id=0, is-reentrant=false, is-synchronous=true, call-type=REGULAR, execution-context=UNSPECIFIED  # The TCP/IP stack calls this function after the data has been acknowledged by the peer for TCP
      sw service arg SocketId: direction=IN, implementation-data-type=TcpIp_SocketIdType  # Socket identifier of the related local socket resource
      sw service arg Length: direction=IN, implementation-data-type=uint16  # Number of transmitted data bytes
    SoAd_WriteDhcpHostNameOption: service-id=27, is-reentrant=false, is-synchronous=false, call-type=REGULAR, execution-context=UNSPECIFIED  # By this API service an upper layer of the SoAd can set the hostname option in the DHCP submodule of the TCP/IP stack
      sw service arg SoConId: direction=IN, implementation-data-type=SoAd_SoConIdType  # Socket connection index specifying the socket connection for which the parameter shall be changed
      sw service arg length: direction=IN, implementation-data-type=uint8  # Length of parameter value to be set
      sw service arg data: category=DATA_REFERENCE, direction=IN, implementation-data-type=uint8  # Pointer to memory containing the new parameter value
    SoAd_GetAndResetMeasurementData: service-id=69, is-reentrant=true, is-synchronous=true, call-type=REGULAR, execution-context=UNSPECIFIED  # By this API service an upper layer of the SoAd can read and reset detailed measurement data for diagnostic purposes | >By this API service an upper layer of the SoAd can read and reset detailed measurement data for diagnostic purposes
      sw service arg MeasurementIdx: direction=IN, implementation-data-type=SoAd_MeasurementIdxType  # Data index of measurement data
      sw service arg MeasurementResetNeeded: direction=IN, implementation-data-type=boolean  # Flag to trigger a reset of the measurement data
      sw service arg MeasurementDataPtr: category=DATA_REFERENCE, direction=OUT, implementation-data-type=uint32  # Reference to data buffer, where to copy measurement data
package /AUTOSAR_SoAd/ImplementationDataTypes
  49 x impl type, all with type-emitter=HEADER_FILE:
    SoAd_UpperLayerType_ten: compu {0=SOAD_IF (UpperLayer type is IF), 1=SOAD_TP (UpperLayer type is TP)}, implementation-data-type=uint8  # Type specifying the upper layer of the SoAd. | Specifies the upper layer of the SoAd.
    SoAdTxUdpTriggerMode_ten: compu {0=SOAD_TRIGGER_ALWAYS (PDU triggers the transmission), 1=SOAD_TRIGGER_NEVER (PDU does not trigger the transmission)}, implementation-data-type=uint8  # Type specifying trigger transmision enabled or not. | Specifies the trigger transmision enabled or not.
    SoAd_SoConModeType: compu {0=SOAD_SOCON_OFFLINE (Socket connection state is closed and no transmission and reception is possible), 1=SOAD_SOCON_RECONNECT (Socket connection in this state is trying to come to online), 2=SOAD_SOCON_ONLINE (Socket connection state is open and transmission and reception is possible)}, implementation-data-type=uint8  # Type specifying socket connection states. | Specifies the socket connection states.
    SoAd_SoConSubMode_ten: compu {0=SOAD_SOCON_IDLE (State in which a socket connection completely idle), 1=SOAD_SOCON_CLOSE (State in which a socket connection completely closed), 2=SOAD_SOCON_TCPIP_ALLOCATED (State in which socket is successfully created but waiting to bind), 3=SOAD_SOCON_BOUND (State in which socket is successfully bound but waiting to go online), 4=SOAD_SOCON_TCPWAITFORREMOTE (State in which opening for a socket connection is requested and request is sent to TCPIP layer), 5=SOAD_SOCON_ACTIVE (State in which socket connection is ready to transmit and receive pdus), 6=SOAD_SOCON_WAITFORCLOSE (State in which socket connection is waiting to get SoAd_TcpIpEvent to close), 7=SOAD_SOCON_READYTOCLOSE (State in which socket connection is ready to close in next main function)}, implementation-data-type=uint8  # Type specifying socket states. | Specifies the socket states.
    SoAd_TriggerEventType_ten: compu {0=SOAD_EVENT_IDLE (Event for which socket connection is in idle state), 1=SOAD_EVENT_ONLINEREQ (Event for which socket connection shall take action to go online), 2=SOAD_EVENT_OFFLINEREQ_UL (Event for which socket connection shall take action to go off line, because trigger event shall initiated by upper layer), 3=SOAD_EVENT_OFFLINEREQ_SOAD (Event for which socket connection shall take action to go reconnect, because trigger event shall initiated internally by SoAd)}, implementation-data-type=uint8  # Type specifying the triggering event types of SoAd. | Specifies the triggering event types of SoAd.
    SoAd_SocTpDataCopyStatus_ten: compu {0=SOAD_TP_DATAFRAGMENT_COPY_START (Used for the first time entry into Loop for a fragment copy), 1=SOAD_TP_DATAFRAGMENT_COPY_ONGOING (CopyTxData of a fragment is going on), 2=SOAD_TP_DATAFRAGMENT_COPY_FINISHED (CopyTxData is done completely for a fragment of data), 3=SOAD_TP_DATAFRAGMENT_COPY_RETRY (CopyTxData shall be retreid in the next main function), 4=SOAD_TP_DATACOPY_ERROR (Error in copying the data)}, implementation-data-type=uint8  # Type specifying the TP data copy status. | Specifies the TP data copy status.
    SoAd_UserType_ten: compu {0=SOAD_USER_PDUR (PDUR is the upper layer of SoAd), 1=SOAD_USER_DOIP (Diagnostics over IP is the upper layer of SoAd), 2=SOAD_USER_XCP (XCP is the upper layer of SoAd), 3=SOAD_USER_CDD (Complex Device Driver is the upper layer of SoAd), 4=SOAD_USER_CDDTCP (Complex Devide Driver(for TCP) is the upper layer of SoAd), 5=SOAD_USER_SD (Service Discovery is the upper layer of SoAd), 6=SOAD_USER_UDPNM (UDPNM is the upper layer of SoAd), 7=SOAD_USER_ETHDIAGMM (ETHDIAGMM is the upper layer of SoAd)}, implementation-data-type=uint8  # Type specifying the user types. | Specifies the user types.
    SoAd_RxPduAcceptance_ten: compu {0=SOAD_PDU_OK (Pdu is valid for further processing), 1=SOAD_PDU_FRAGMENTED_HEADER (Pdu header is fragmented), 2=SOAD_PDU_FRAGMENTED_DATA (Pdu data is fragmented), 3=SOAD_PDU_DISCARD (Pdu needs to be discarded)}, implementation-data-type=uint8  # Type specifying the acceptance of the received pdu. | Specifies the acceptance of the received pdu.
    SoAd_IfTransmitReqStatus_ten: compu {0=SOAD_IF_TRANSMISSION_OK (Pdu data is transmitted successfully in SoAd_IfTransmit( ) API itself), 1=SOAD_IF_TRANSMISSION_E_NOT_OK (Pdu data is not able to transmit via corresponding socket), 2=SOAD_IF_NPDU_BUFFERING_OK (Pdu data is buffered successfully in socket specific buffer)}, implementation-data-type=uint8  # Type specifying the status of the IF transmission pdu. | Specifies the status of the IF transmission pdu.
    SoAd_SoConIdType: implementation-data-type=uint16  # SoAd Socket Id.
    SoAd_RoutingGroupIdType: implementation-data-type=uint16  # SoAd Routing Group Id.
    SoAd_MeasurementIdxType: implementation-data-type=uint8  # SoAd Measurement Index type.
    SoAd_TcpSocGrpIndexType: implementation-data-type=uint8  # The number of Tcp Protocols configured in SoAd Socket Groups.
    SoAd_UdpSocGrpIndexType: implementation-data-type=uint8  # The number of Udp Protocols configured in SoAd Socket Groups.
    SoAd_TpUdpTxBuffIndexType: implementation-data-type=uint8  # The number of TP Udp Transmit Pdu Sockets configured in SoAd.
    SoAd_nPduUdpTxBuffIndexType: implementation-data-type=uint8  # The number of nPdu Udp Transmit Pdu Sockets configured in SoAd.
    SoAd_ParamIdType: implementation-data-type=uint8  # Specifies the type of parameter.
    SoAd_RxPduDesc_tst: category=STRUCTURE  # SoAd_RxPduDesc_tst: Description of a received Pdu.
      element PduDataLength_u32: implementation-data-type=uint32  # Data length of the received Pdu.
      element RxPduId_uo: implementation-data-type=PduIdType  # Rx Pdu Id of the corresponding socket route.
    SoAd_DynRxBuffTableType_tst: category=STRUCTURE  # SoAd_DynRxBuffTableType_tst: Dynamic Rx Buff Table .
      11 x element:
        RxBuffStrt_cpu8: category=DATA_REFERENCE, sw-pointer-target-props={target-category=TYPE_REFERENCE, implementation-data-type=SoAd_RoutingGroupIdType, sw-impl-policy=CONST}  # Pointer to the starting of the reception buffer.
        RxNxtData_pu8: category=DATA_REFERENCE, sw-pointer-target-props={target-category=TYPE_REFERENCE, implementation-data-type=uint8}  # Pointer to the next data location of the reception buffer.
        RxNxtFree_pu8: category=DATA_REFERENCE, sw-pointer-target-props={target-category=TYPE_REFERENCE, implementation-data-type=uint8}  # Pointer to the next free location of the reception buffer.
        DataFragCurrentRxPduDesc_st: implementation-data-type=SoAd_RxPduDesc_tst  # Description of the fragmented Pdu under reception.
        TpDataRemainingLenToTransfer_u32: implementation-data-type=uint32  # Remaining length of the TP Pdu to be transfered from Rx buffer to UL
        TotalRxBuffSize_cu16: implementation-data-type=uint16, sw-impl-policy=CONST  # Size of the Rx buffer.
        DataFragCurrentSize_u16: implementation-data-type=uint16  # Length of fragmented data stored in the Rx buffer
        TpDataCurrentSize_u16: implementation-data-type=uint16  # Length of TP data stored in the Rx buffer
        HeaderFragCurrentSize_u8: implementation-data-type=uint8  # Length of fragmented Pdu header stored in the Rx buffer
        DataFragReceptionInProgress_b: implementation-data-type=boolean  # Flag indicating if there is a reception of fragmented data.
        HeaderFragReceptionInProgress_b: implementation-data-type=boolean  # Flag indicating if there is a reception of fragmented Pdu header.
    SoAd_IfTcpPduTxPendingStatus_tst: category=STRUCTURE  # This container specifies the status of the Pdu transmitted from the upperlayer If and protocol used is TCP.
      element ifTcpTxConfRemainingLen_au32: implementation-data-type=uint32  # Number of bytes has been transmitted for this pdu, it can be via single socket or multiple sockets.
      element ifTcpTxConfReceivedStatus_b: implementation-data-type=boolean  # Transmission Confimation received status for IF TCP pdus. If multiple PduRouteDests are configured(fan-out) and active(ONLINE), then this flag will be set if TxConfirmation received atleast from one remote.
    SoAd_TpUdpTxBufferInfo_tst: category=STRUCTURE  # This container specifies the buffer for the transmission of the Pdu of the upper layer TP which uses UDP protocol. | This container specifies the buffer of the transmission of the Pdu of the upper layer TP which uses UDP protocol.
      element tpUdpTxBuffer_pu8: category=DATA_REFERENCE, sw-pointer-target-props={target-category=TYPE_REFERENCE, implementation-data-type=uint8}  # TP Udp Transmission Buffer pointer.
      element tpUdpTxBufferSize_u16: implementation-data-type=uint16  # TP Udp Transmission Buffer size.
    SoAd_nPduUdpTxBufferInfo_tst: category=STRUCTURE  # This container specifies the buffer for the transmission of the Pdu of the upper layer IF which uses UDP protocol and pdu header enabled. | This container specifies the buffer of the transmission of the Pdu of the upper layer TP which uses UDP protocol and pdu header enabled.
      5 x element:
        nPduUdpTxBuffer_pu8: category=DATA_REFERENCE, sw-pointer-target-props={target-category=TYPE_REFERENCE, implementation-data-type=uint8}  # IF Udp Transmission Buffer pointer.
        nPduUdpTxBufferTimer_u32: implementation-data-type=uint32  # It specific the timeout value for nPduUdpTxBuffer to which timer will be running, once it is expired, copied data in nPduUdpTxBuffer should be transmitted immediately.Note: It is converted to multiple of SoAd main period to easy manipulation.
        nPduUdpTxBufferSize_cu16: implementation-data-type=uint16, sw-impl-policy=CONST  # nPdu Udp Transmission Buffer size.
        nPduUdpTxBuffCopiedLen_u16: implementation-data-type=uint16  # It specifies the number of bytes copied to nPduUdpTxBuffer.
        nPduUdpTxPduIdSize_cu8: implementation-data-type=uint8, sw-impl-policy=CONST  # Size of the PduId's mapped to the socket.
    SoAd_TxPduDynInfo_tst: category=STRUCTURE  # This container specifies Dynamic Info about TxPdu.
      element isIfTxCalled_b: implementation-data-type=boolean  # it indicates if IF transmit is called for a PDU.
      element isTpTxCalled_b: implementation-data-type=boolean  # it indicates if TP transmit is called for a PDU.
      element isCancelTpTxCalled_b: implementation-data-type=boolean  # it indicates if TP cancel transmit is called for a PDU.
    SoAd_RxPduDynInfo_tst: category=STRUCTURE  # This container specifies Dynamic Info about rxPdu.
      element isCancelTpRxCalled_b: implementation-data-type=boolean  # it indicates if TP cancel Rx is called for a PDU.
    SoAd_RoutingGroupSoConMap_tst: category=STRUCTURE  # This container specifies SoConId's which are mapped to specific Routing Group's and Routing Group status.
      element mappedSoConId_uo: implementation-data-type=SoAd_SoConIdType  # Mapped Socket Connection to Specific Routing Group.
      element specificRgStatus_b: implementation-data-type=boolean  # Specific Routing Group status.
    SoAd_RoutingGroupSoConStructMap_tst: category=STRUCTURE  # This container specifies the RoutingGroupSoConMap structure pointer and length of the SoCon which are mapped to corresponding RG Id.
      4 x element:
        routingGrpSoConMap_pst: category=DATA_REFERENCE, sw-pointer-target-props={target-category=TYPE_REFERENCE, implementation-data-type=SoAd_RoutingGroupSoConMap_tst}  # RoutingGroupSoConMap structure pointer.
        numOfSoConIdMapped_uo: implementation-data-type=SoAd_SoConIdType  # Number of SoConId mapped in RoutingGroupSoConMap structure for particular index.
        rgStatus_b: implementation-data-type=boolean  # Routing group status.
        specificRgCheck_b: implementation-data-type=boolean  # It specifies if specific routing group is enabled.
    SoAd_TriggerTransmitInfo_tst: category=STRUCTURE  # This container specifies the trigger transmit information.
      element triggerTransmitSocketIdx_uo: implementation-data-type=SoAd_SoConIdType  # Reference to the static socket table to which PDU needs to be transmitted.if socket connection group reference is mapped and SoAd_TriggerIfSpecificRgTransmit( ) API called, then It will be updated with SoConId which passes as arguments for the function.
    SoAd_LocalAddrIdInfoType_tst: category=STRUCTURE  # This container specifies the TcpIp local address id info information.
      element localAddrIdx_State_en: implementation-data-type=TcpIp_IpAddrStateType  # It indicates the state of local address Id.
      element isLocalAddrIdCfgd_b: implementation-data-type=boolean  # It indicates if local address id is present in SoAd config.
    PduRouteDestType_tst: category=STRUCTURE  # This container specifies the PduRouteDest information. | This container specifies PduRouteDest information.
      9 x element:
        txPduHeaderId_u32: implementation-data-type=uint32  # TxPdu Header Id of the PduRouteDest.
        triggerTransmissionInfo_puo: category=DATA_REFERENCE, sw-pointer-target-props={target-category=TYPE_REFERENCE, implementation-data-type=SoAd_TriggerTransmitInfo_tst}  # Reference to the static socket table to which PDU needs to be transmitted.if socket connection group reference is mapped and SoAd_TriggerIfSpecificRgTransmit( ) API called, then It will be updated with SoConId which passes as arguments for the function.
        triggerTransmission_en: implementation-data-type=SoAdTxUdpTriggerMode_ten  # Specifies whether a PDU triggers the transmission of the nPduUdpTxBuffer.
        txUdpTriggerTimeout_32: implementation-data-type=uint32  # Specifies the timeout value for nPduUdpTxBuffer for specific pdu and it shall be compared ,with SoAdSocketUdpTriggerTimeout parameter if it is configured and chooses the small one. Suppose if SoAdSocketUdpTriggerTimeout parameter is not configured, then it shall be direcly assign as nPduUdpTimeout value for the particular socket. Note: It shall be multiple of SoAd main period for easy manupulation at run time.
        txRoutingGroupConf_cpuo: category=DATA_REFERENCE, sw-pointer-target-props={target-category=TYPE_REFERENCE, implementation-data-type=SoAd_RoutingGroupIdType, sw-impl-policy=CONST}  # List of Routing Groups which are configured for the particular Tx PduRouteDest.
        numOfTxRoutingGroups_uo: implementation-data-type=SoAd_RoutingGroupIdType  # Number of Tx Routing groups configured under the PduRouteDest.
        txStaticSocketOrGroupIdx_uo: implementation-data-type=SoAd_SoConIdType  # Reference to the static socket table or static socket group table.If identifyTxSocketConnOrGroupRef_b is TRUE means it will be static socket table.If identifyTxSocketConnOrGroupRef_b is FASLE means it will be static socket group table.
        identifyTxSocketConnOrGroupRef_b: implementation-data-type=boolean  # It indicates that PduRouteDest is mapped to Socket connection or group .TRUE - socket connection ref, FALSE - socket connection Group ref.
        nPduUdpTxBufferedSocketCnt_pu8: category=DATA_REFERENCE, sw-pointer-target-props={target-category=TYPE_REFERENCE, implementation-data-type=uint8}  # It indicates that in how many socket buffers, Pdu data is stored.If it is stored atleast in any one of the socket buffer, SoAd has to provide the Ul_TxConfirmation callback once buffered data is transmitted to LL successfully.For example, if PduRoteDest is mapped to socket connection group and 3 sockets are belongs to socket connection group, then it shall be updated to 3 if pdudata is buffered in all 3 sockets buffer, else it shall be updated to some value based on the no of socket buffer in which Pdu data was stored. | It indicates that in how many socket buffers, Pdu data is stored.If it is stored atleast in any one of the socket buffer, SoAd has to provide the Ul_TxConfirmation callback once buffered data is transmitted to LL successfully.For example, if PduRoteDest is mapped to socket connection group and 3 sockets are belongs to socket connection group, then it shall be updated to 3 if pdudata is buffered in all 3 sockets buffer, else it shall be updated to some value based on the no of socket buffer in which Pdu data was stored..
    SoAd_TxPduConfigType_tst: category=STRUCTURE  # This container specifies the transmission Pdu Configuration Table. | This container specifies the Pdu Configuration Table.
      15 x element:
        txPduCfgTableIdx_uo: implementation-data-type=PduIdType  # Index of the SoAd_CurrConfig_cpst->SoAd_TxPduConfig_cpst table.
        txPduId_uo: implementation-data-type=PduIdType  # Tx PDU ID of the PDU coming from the PDU Router.
        ulTxPduId_uo: implementation-data-type=PduIdType  # Tx PDU ID of the Upper layer, used in call backs of upper layers.
        PduRouteDestNum_uo: implementation-data-type=PduIdType  # Number of PduRouteDest configured with this PduRoute.
        txUpperLayerType_en: implementation-data-type=SoAd_UpperLayerType_ten  # Specifies the upper layer interface type.
        txUser_en: implementation-data-type=SoAd_UserType_ten  # User of the TxPdu.
        PduRouteDestConf_cpst: category=DATA_REFERENCE, sw-pointer-target-props={target-category=TYPE_REFERENCE, implementation-data-type=PduRouteDestType_tst, sw-impl-policy=CONST}  # Data of all PduRouteDests of the PduRoute (TxPdu).
        SoAd_TxPduConfigType_tst: category=DATA_REFERENCE, sw-pointer-target-props={target-category=TYPE_REFERENCE, implementation-data-type=PduRouteDestType_tst, sw-impl-policy=CONST}  # Data of all PduRouteDests of the PduRoute (TxPdu). | Data of all PduRouteDests of the PduRoute (TxPdu)
        txPduLength_uo: implementation-data-type=PduLengthType  # Tx PDU Length of the PDU coming from the PDU Router
        txIfTcpPduIndex_u8: implementation-data-type=uint8  # Index to the array SoAd_IfTcpPduTxPendingStatus_tst which has the length pending for confirmation for IF TCP and fanout status
        idxIfTxConfirm_u8: implementation-data-type=uint8  # Index to the IfTxConfirm table
        idxTpTxConfirm_u8: implementation-data-type=uint8  # Index to the TpTxConfirm table
        idxTpCopyTxDataCallback_u8: implementation-data-type=uint8  # Index of the Soc connection CopyTxDataCallback
        idxTriggerTransmitCallback_u8: implementation-data-type=uint8  # Index of the Soc connection CopyTxDataCallback
        isTxPduMetaDataCfgd_b: implementation-data-type=boolean  # Flag indicating if TxMetaData item configured is of type SOCKET_CONNECTION_ID_16
    SoAd_RxPduConfigType_tst: category=STRUCTURE  # This container specifies the reception Pdu Configuration Table.
      21 x element:
        rxPduCfgTableIdx_uo: implementation-data-type=PduIdType  # Index of the SoAd_CurrConfig_cpst->SoAd_RxPduConfig_cpst table
        rxPduId_uo: implementation-data-type=PduIdType  # Rx PDU ID used by the upper layer to call cancel reception of this pdu id
        ulRxPduId_uo: implementation-data-type=PduIdType  # Rx PDU ID of the Upper layer, used in call backs of upper layers.
        rxPduDynInfo_pst: category=DATA_REFERENCE, sw-pointer-target-props={target-category=TYPE_REFERENCE, implementation-data-type=SoAd_RxPduDynInfo_tst, sw-impl-policy=CONST}  # Dynamic information of the Rx PDU.
        txPduDyninfo_pst: category=DATA_REFERENCE, sw-pointer-target-props={target-category=TYPE_REFERENCE, implementation-data-type=SoAd_TxPduDynInfo_tst, sw-impl-policy=CONST}  # Dynamic information of the PDU.
        reservedPduId_uo: implementation-data-type=PduIdType  # Reserved for padding and will be used in future
        rxPduHeaderId_u32: implementation-data-type=uint32  # Id contained in the packet received on the TCP/IP connection if the PDU header option is enabled
        rxUpperLayerType_en: implementation-data-type=SoAd_UpperLayerType_ten  # Specifies the upper layer interface type.
        rxUser_en: implementation-data-type=SoAd_UserType_ten  # User of the RxPdu.
        rxPduLength_uo: implementation-data-type=PduIdType  # Rx PDU Length of the PDU coming from the PDU Router
        reservedPduLen_uo: implementation-data-type=PduIdType  # Reserved for padding and will be used in future
        rxStaticSocketOrGroupIdx_uo: implementation-data-type=SoAd_SoConIdType  # Reference to the static socket table or static socket group table if identifyRxSocketConnOrBundRef_b is TRUE means it will be static socket table if identifyRxSocketConnOrBundRef_b is FALSE means it will be static socket group table
        reservedSoConIdx_uo: implementation-data-type=SoAd_SoConIdType  # Reserved for padding and will be used in future
        rxRoutingGroupConf_cpuo: category=DATA_REFERENCE, sw-pointer-target-props={target-category=TYPE_REFERENCE, implementation-data-type=SoAd_RoutingGroupIdType, sw-impl-policy=CONST}  # List of Routing Groups which are configured for the particular Rx PduRouteDest.
        numOfRxRoutingGroups_uo: implementation-data-type=SoAd_RoutingGroupIdType  # Number of Rx Routing groups configured under the SocketRouteDest.
        idxIfRxIndication_u8: implementation-data-type=uint8  # Index to the IfTxConfirm table.
        idxTpRxIndication_u8: implementation-data-type=uint8  # Index to the TpTxConfirm table.
        idxTpCopyRxDataCbk_u8: implementation-data-type=uint8  # Index of SoAdTp_copyRxDataCallbacks_cast.
        idxTpStartReceptionCbk_u8: implementation-data-type=uint8  # Index of SoAdTpStartOfReception call backs.
        identifyRxSocketConnOrBundRef_b: implementation-data-type=boolean  # It indicates that SocketRoute is mapped to Socket connection or group TRUE - socket connection ref, FALSE - socket bundle ref. | It indicates that SocketRoute is mapped to Socket connection or group TRUE - socket connection ref, FALSE - socket bundle ref..
        isRxPduMetaDataCfgd_b: implementation-data-type=boolean  # Flag indicating if RxMetaData item configured is of type SOCKET_CONNECTION_ID_16
    SoAd_StaticSocConfigType_tst: category=STRUCTURE  # This container specifies Static socket configuration.
      14 x element:
        soConCfgTableIdx_uo: implementation-data-type=SoAd_SoConIdType  # Index of the SoAd_StaticSocConfig_cast table.
        soConId_uo: implementation-data-type=SoAd_SoConIdType  # SymbolicNameValue; The Socket ID is used as a reference to a particular connection when transferring data to and from the PDU Router.
        soConGrpId_uo: implementation-data-type=SoAd_SoConIdType  # Id of the group to which this socket connection.
        reserved_uo: implementation-data-type=SoAd_SoConIdType  # Reserved member for padding and will be used in future.
        SoAd_Prv_idxDynSocTable_puo: category=DATA_REFERENCE, sw-pointer-target-props={target-category=TYPE_REFERENCE, implementation-data-type=SoAd_SoConIdType}  # Index to SoAd_DyncSocConfigType structure which is handled dynamically.
        dynRxBuffTableEntry_pst: category=DATA_REFERENCE, sw-pointer-target-props={target-category=TYPE_REFERENCE, implementation-data-type=SoAd_DynRxBuffTableType_tst}  # Pointer to an address of corresponding index of Rx Buff table which is handled dynamically.
        rxPduIds_pcuo: category=DATA_REFERENCE, sw-pointer-target-props={target-category=TYPE_REFERENCE, implementation-data-type=PduIdType, sw-impl-policy=CONST}  # pointer to an array of rxPduid list.
        idxStatSoConRemoteAddr_uo: implementation-data-type=SoAd_SoConIdType  # Index to get an SoAd_SockAddrInetType or SoAd_SockAddrInet6Type structure which holds the remote IP address and port.
        tpUdpTxBuffIdx_uo: implementation-data-type=SoAd_TpUdpTxBuffIndexType  # Index of the TP UDP Tx Buffer array SoAdTp_UdpTxSocketBufferInfo_cpauo.
        nPduUdpTxBuffIdx_uo: implementation-data-type=SoAd_nPduUdpTxBuffIndexType  # Index of the nPdu UDP Tx Buffer array SoAdIf_nPduUdpTxSocketBufferInfo_cpauo.
        numberofULsConfigured_u8: implementation-data-type=uint8  # Specifies the number of upper layers configured for this socket connection.
        idxSocModeChgCallback_u8: implementation-data-type=uint8  # Index of the Soc connection mode change notification call back.
        idxLocalIpAddrChgCbk_u8: implementation-data-type=uint8  # Index of Local Ip Address assignment change call bcak to UL.
        numberOfRxPdusConfigured_u8: implementation-data-type=uint8  # number of RxPdu's configured for the socket.
    SoAd_StaticUdpConfigType_tst: category=STRUCTURE  # This container specifies the Static Socket Connection Group Configuration Entry for Udp Protocol.
      6 x element, all with category=TYPE_REFERENCE:
        socketUdpTriggerTimeout_u32: implementation-data-type=uint32  # Specifies the timeout value for nPduUdpTxBuffer for specific socket and it shall be compared , with SoAdTxUdpTriggerTimeout parameter if it is configured and always chooses the small one. Suppose if SoAdTxUdpTriggerTimeout parameter is not configured, then it shall be direcly assign as nPduUdpTimeout value for the particular socket. Note: It shall be multiple of SoAd main period for easy manupulation at run time
        nPduUdpTxBufferMin_u16: implementation-data-type=uint16  # Specifies the data in bytes to be buffered for tx, if the UDP message be buffered for tx of multiple PDUs per UDP
        listenOnlyUDP_u8: implementation-data-type=uint8  # Used to disable the transmit functionality on this UDP port.This parameter is only relevant for UDP connections.
        udpStrictHdrLenChkEnabled_u8: implementation-data-type=uint8  # Specifies if UDP messages shall be dropped (TRUE) if the length of all contained PDUs does not match the length of the whole message or not (FALSE). Shall only be set to TRUE
        udpAliveSupervisionTimeoutIdx_uo: implementation-data-type=SoAd_UdpSocGrpIndexType  # Specifies the Index of Udp Alive Supervision Timeout Socket Group Array
        udpTriggerTimeoutIdx_uo: implementation-data-type=SoAd_UdpSocGrpIndexType  # Specifies the Index of timeout in [s] a nPduUdpTxBuffer is waiting for a PDU with TriggerMode = TRIGGER_ALWAYS
    SoAd_StaticTcpConfigType_tst: category=STRUCTURE  # This container specifies the Static Socket Connection Group Configuration Entry for TCP Protocol.
      9 x element, all with category=TYPE_REFERENCE:
        tcpTxQuota_u32: implementation-data-type=uint32  # Specifies the maximum amout of bytes (PDU data provided by the upper layer and PDU Header if used) the SoAd may queue for transmission via TCP at the TcpIp module for each socket connection of this socket connection group.
        tcpTlsConnId_uo: implementation-data-type=TcpIp_TlsConnectionIdType  # Specifies the tls connection Id.
        tcpKeepAliveTimeIdx_uo: implementation-data-type=SoAd_TcpSocGrpIndexType  # Specifies the Index of Tcp Keep Alive Time Socket Group Array.
        tcpKeepAliveIntervalIdx_uo: implementation-data-type=SoAd_TcpSocGrpIndexType  # Specifies the Index of Tcp Keep Alive Time Interval Socket Group Array.
        tcpKeepAliveProbeMaxIdx_uo: implementation-data-type=SoAd_TcpSocGrpIndexType  # Specifies the Index of Tcp Keep Alive Probe Max Socket Group Array.
        tcpKeepAlive_u8: implementation-data-type=uint8  # Specifies if keepalive feature is enabled. This is only for TCP connections.
        tcpImmediateTpTxConfirm_u8: implementation-data-type=uint8  # Specifies whether the immediate Tcp confirmation is required for TP transmissions.
        tcpInitiate_u8: implementation-data-type=uint8  # Specifies the initiator for this TCP connection.This parameter is only relevant for TCP connections.
        tcpNoDelay_u8: implementation-data-type=uint8  # Specifies not to use the congestion control mechanism for this connection. This is only for TCP connections.
    SoAd_StaticSoConGrpConfigType_tst: category=STRUCTURE  # This container specifies the Static Socket Connection Group Configuration Entry.
      19 x element:
        soConGrpCfgTableIdx_uo: implementation-data-type=SoAd_SoConIdType  # Index of the SoAd_CurrConfig_cpst->SoAd_StaticSocGroupConfig_cpst table.
        soConGrpId_uo: implementation-data-type=SoAd_SoConIdType  # Symbolic Name Value; The GroupId shall be useful to recognize the socket connection belongs to which Group.
        startSoConIdx_uo: implementation-data-type=SoAd_SoConIdType  # Index of the Start socket connection of this group.
        maxSoConChannel_uo: implementation-data-type=SoAd_SoConIdType  # Max socket connection configured for this group.
        groupTcpIpSocketId_puo: category=DATA_REFERENCE, sw-pointer-target-props={target-category=TYPE_REFERENCE, implementation-data-type=TcpIp_SocketIdType}  # To store the Tcp listen socket id or UDP group socket id.
        udpProtocolConf_cpst: category=DATA_REFERENCE, sw-pointer-target-props={target-category=TYPE_REFERENCE, implementation-data-type=SoAd_StaticUdpConfigType_tst, sw-impl-policy=CONST}  # Pointer to an address of Corresponding index of UDP Protocol structure array.
        tcpProtocolConf_cpst: category=DATA_REFERENCE, sw-pointer-target-props={target-category=TYPE_REFERENCE, implementation-data-type=SoAd_StaticTcpConfigType_tst, sw-impl-policy=CONST}  # Pointer to an address of Corresponding index of TCP Protocol structure array.
        soConGrpProtocol_en: implementation-data-type=TcpIp_ProtocolType  # Specifies the transport protocol (UDP or TCP).
        domain_en: implementation-data-type=TcpIp_DomainType  # Specifies the domain (IPV4 or IPV6).
        tpTcpRxBufferMin_u16: implementation-data-type=uint16  # Specifies the amount of data in bytes the SoAd shall be able to buffer for data reception for TP for this socket connection.
        soConGrpLocalPort_u16: implementation-data-type=uint16  # Local UDP or TCP port used for this connection.
        soConGrpLocalAddressIdx_u8: implementation-data-type=TcpIp_LocalAddrIdType  # Index to be passed to lower layer to refer local address.Used to identify the local IP address and EthIf controller configured in TcipIp.
        soConGrpFramePriority_u8: implementation-data-type=uint8  # Specifies the priority of the Ethernet frame.
        headerEnable_b: implementation-data-type=boolean  # Enables the transmission of the SoAd PDU header (ID, length) on this socket connection.
        resourceMgtEnable_b: implementation-data-type=boolean  # Enables the resource management option for this socket. May not be activated for UDP sockets in receive.
        soConGrpAutoConSetup_b: implementation-data-type=boolean  # Specifies if the setup of the socket connection shall be done automatically (TRUE) or manually (FALSE).
        ipAddrAssgnChgNotify_b: implementation-data-type=boolean  # Specifies if the local IP address assignment change notification callback function to be called.
        socMsgAcceptanceFiletEnable_b: implementation-data-type=boolean  # Specifies if the message acceptance filter is enabled (TRUE) or not (FALSE).
        socModeChgNotifyEnable_b: implementation-data-type=boolean  # Specifies if the SoCon mode change notify cbk to be called in case of SoCon mode change.
    SoAd_DyncSocConfigType_tst: category=STRUCTURE  # This container specifies Dynamic Socket Table of Active Sockets. | Dynamic Socket Table of Active SocketsThis container specifies Dynamic Socket Table of Active Sockets.
      41 x element:
        rxPduInfoPtr_cpst: category=DATA_REFERENCE, sw-pointer-target-props={target-category=TYPE_REFERENCE, implementation-data-type=PduInfoType, sw-impl-policy=CONST}  # The reference to Rx Packet Buffer.
        txPduInfoPtr_cpst: category=DATA_REFERENCE, sw-pointer-target-props={target-category=TYPE_REFERENCE, implementation-data-type=PduInfoType, sw-impl-policy=CONST}  # The reference to Tx Packet Buffer.
        socConMode_en: implementation-data-type=SoAd_SoConModeType  # The State of the Socket.
        socConSubMode_en: implementation-data-type=SoAd_SoConSubMode_ten  # The sub state of the soc connection.
        socConRequestedMode_en: implementation-data-type=SoAd_TriggerEventType_ten  # To store the triggering event requested for the socket connection.
        idxDynSoConRemoteAddr_uo: implementation-data-type=SoAd_SoConIdType  # Index to get an SoAd_SockAddrInetType or SoAd_SockAddrInet6Type structure which holds the remote IP address and port.
        dynSoConRemoteIpAddr_u32: implementation-data-type=uint32  # SoAdSocketRemoteIpAddress; Could be configured as ANY (0) or a specific value (used for message acceptance policy).
        dynSoConRemotePort_u16: implementation-data-type=uint16  # SoAdSocketRemotePort; Could be configured as ANY (0) or a specific value (used for message acceptance policy).
        soConDynLocalPort_u16: implementation-data-type=uint16  # Local UDP or TCP port used for this connection in runtime.
        rxOngoingCnt_u8: implementation-data-type=uint8  # count of ongoing receptions as RxIndication is reentrant.
        ifRgTxOngoing_b: implementation-data-type=boolean  # flag to check IF rg Tx is ongoing.
        socConOpenReqCnt_u16: implementation-data-type=uint16  # Number of open SoCon requests comes from UL.
        socConCloseReqCnt_u16: implementation-data-type=uint16  # Number of close SoCon requests comes from UL.
        tpTxRemainingLength_uo: implementation-data-type=PduLengthType  # Variable to hold the remaining length info in Tp_Tx.
        tpTransmittedLength_uo: implementation-data-type=PduLengthType  # Variable to hold the transmitted length info in Tp_Tx.
        tpTcpCopyTxDataLength_uo: implementation-data-type=PduLengthType  # Variable to hold the length requested in SoAd_CopyTxData call back.
        tpTxTotPduLen_uo: implementation-data-type=PduLengthType  # Total pdu length TP packet, this member will be used only for TP.
        tpReceptionOngoing_b: implementation-data-type=boolean  # Status to store while TP reception is ongoing.
        tpTransmissionOnGoing_b: implementation-data-type=boolean  # Status to stote TP transmission is ongoing.
        tpTransmitRequest_b: implementation-data-type=boolean  # Flag to store the TpTransmit request to be processed in main function.
        UdpAliveSupervisionTimer_u32: implementation-data-type=uint32  # Variable to hold UdpActiveSupervision timeout value.
        txPduHeaderId_u32: implementation-data-type=uint32  # If multiple PduRouteDests are configured per pdu and header was configured,SoAd_CopyTxData needs the header Id for the active socket. | If multiple PduRouteDests are configured per pdu and header was configured,SoAd_CopyTxData needs the header Id for the active socket
        ifTxTcpPduLenReqByUL_uo: implementation-data-type=PduLengthType  # To store the length of the packet requested by UL and it will be more necessary to support IF TCP Fanout feature.
        ifTxTcpAckedDataLen_uo: implementation-data-type=PduLengthType  # To store the Acked data length from lower layer.
        ifTxCopiedLength_uo: implementation-data-type=PduLengthType  # To store the length of buffer copied to TCPIP layer.
        reserved_uo: implementation-data-type=PduLengthType  # Reserved for byte alligned.
        idxDynSocConfigTable_uo: implementation-data-type=SoAd_SoConIdType  # Index of dynamic socket table.
        idxStaticSoc_uo: implementation-data-type=SoAd_SoConIdType  # Index of static socket table.
        idxTxPduTable_uo: implementation-data-type=PduIdType  # Index of txPduId Table which needs to be remembered for tx confirmation.
        idxRxPduTable_uo: implementation-data-type=PduIdType  # Index of rxPduId Table which needs to be remembered for rx confirmation.
        socketHandleTcpIp_uo: implementation-data-type=TcpIp_SocketIdType  # The Socket Handle of the dynamic socket table in TcpIp module.
        rxTcpRemainingPduLengthToDicard_u32: implementation-data-type=uint32  # Remaining length to discard for a received Pdu.
        ifTransmissionOnGoing_b: implementation-data-type=boolean  # Flag to store the IfTransmit request to be processed in main function.
        tpTxTcpTransmitRetryCnt_u16: implementation-data-type=uint16  # Number of retries done by SoAd.
        tpTxTcpBufferAvailable_b: implementation-data-type=boolean  # Flag to indicate availability of buffer during TcpTransmit.
        tpUdpTxTriggered_b: implementation-data-type=boolean  # TP Transmission is triggered.
        ifSkipFanOutTransmission_b: implementation-data-type=boolean  # Flag to store the IfTransmit request needs to be processed in SoAd_IfTransmit() function after SoAd_ValidateAllPduRouteDestSocketsActive() function.
        openReqWhileClosing_b: implementation-data-type=boolean  # Boolean to store while opening of a socket connection is requested if closing is not yet finished.
        statusAbort_b: implementation-data-type=boolean  # To store the Abort status.
        discardNewTxRxReq_b: implementation-data-type=boolean  # Status to store new transmission and reception shall be rejected.
        ifTpTxSoAdHdrCopied_b: implementation-data-type=boolean  # Flag to store the whether SoAd header has been copied already for transmission.
    SoAd_IfTxCallbacks_tst: category=STRUCTURE  # IF transmission call back function.
      element TxCallback_pfn: category=DATA_REFERENCE, sw-pointer-target-props={target-category=TYPE_REFERENCE, implementation-data-type=PduIdType}  # IF transmission call back function pointer. | If transmission call back function pointer.
    SoAd_IfRxCallbacks_tst: category=STRUCTURE  # IF reception call back function.
      element RxCallback_pfn: category=DATA_REFERENCE, sw-pointer-target-props={target-category=TYPE_REFERENCE, implementation-data-type=PduIdType}  # If reception call back function pointer.
    SoAd_TpTxCallbacks_tst: category=STRUCTURE  # TP transmission call back function.
      element RxCallback_pfn: category=DATA_REFERENCE, sw-pointer-target-props={target-category=TYPE_REFERENCE, implementation-data-type=PduIdType}  # TP transmission call back function pointer.
    SoAd_TpRxCallbacks_tst: category=STRUCTURE  # TP reception call back function.
      element RxCallback_pfn: category=DATA_REFERENCE, sw-pointer-target-props={target-category=TYPE_REFERENCE, implementation-data-type=PduIdType}  # TP reception call back function pointer.
    SoAd_TpStartOfReceptionCallbacks_tst: category=STRUCTURE  # TP start of reception call back function.
      element StartOfReception_pfn: category=DATA_REFERENCE, sw-pointer-target-props={target-category=TYPE_REFERENCE, implementation-data-type=PduIdType}  # TP start of reception call back function pointer.
    SoAd_TpcopyTxDataCallbacks_tst: category=STRUCTURE  # TP copy transmission call back function.
      element soAdCopyTxDataCbk_pfn: category=DATA_REFERENCE, sw-pointer-target-props={target-category=TYPE_REFERENCE, implementation-data-type=PduIdType}  # TP copy transmission call back function pointer.
    SoAd_TpcopyRxDataCallbacks_tst: category=STRUCTURE  # TP copy reception call back function.
      element soAdCopyRxDataCbk_pfn: category=DATA_REFERENCE, sw-pointer-target-props={target-category=TYPE_REFERENCE, implementation-data-type=PduIdType}  # TP copy reception call back function pointer.
    SoAd_SoConModeChgCallbacks_tst: category=STRUCTURE  # Socket mode change call back function.
      element soAdCopyRxDataCbk_pfn: category=DATA_REFERENCE, sw-pointer-target-props={target-category=TYPE_REFERENCE, implementation-data-type=SoAd_SoConIdType}  # Socket mode change call back function pointer.
    SoAd_LocalIpAddrAsgnChgCbk_tst: category=STRUCTURE  # Socket local Ip address assignment change call back function.
      element soAdLocalIpAddrAsgnChgCbk_pfn: category=DATA_REFERENCE, sw-pointer-target-props={target-category=TYPE_REFERENCE, implementation-data-type=SoAd_SoConIdType}  # Socket local Ip address assignment change call back function pointer.
    SoAd_IfTriggerTransmitCallbacks_tst: category=STRUCTURE  # IF trigger transmit call back function.
      element TriggerTransmit_pfn: category=DATA_REFERENCE, sw-pointer-target-props={target-category=TYPE_REFERENCE, implementation-data-type=PduIdType}  # IF trigger transmit call back function pointer.
    SoAd_SockAddrInetType: category=STRUCTURE  # Structure to store an IPv4 address (together with port).
      element addr_u32: implementation-data-type=uint32  # IPv4 address.
      element port_u16: implementation-data-type=uint16  # port number.
    SoAd_SockAddrInet6Type: category=STRUCTURE  # Structure to store an IPv6 address (together with port).
      element addr_u32: implementation-data-type=uint32  # IPv6 address.
      element port_u16: implementation-data-type=uint16  # port number.
    SoAd_ConfigType: category=STRUCTURE  # This container specifies the all the configuration parameters in SoAd.
      33 x element:
        SoAd_RoutingGroup_ROM_cpb: category=DATA_REFERENCE, sw-pointer-target-props={target-category=TYPE_REFERENCE, implementation-data-type=boolean, sw-impl-policy=CONST}  # Pointer Routing Group's in configuration.
        SoAd_RoutingGrTriggerable_ROM_cpb: category=DATA_REFERENCE, sw-pointer-target-props={target-category=TYPE_REFERENCE, implementation-data-type=boolean, sw-impl-policy=CONST}  # Pointer Routing Group is triggerable in configuration.
        SoAd_IfTriggerTransmitCallbacks_cpst: category=DATA_REFERENCE, sw-pointer-target-props={target-category=TYPE_REFERENCE, implementation-data-type=SoAd_IfTriggerTransmitCallbacks_tst, sw-impl-policy=CONST}  # Pointer to the list of the IF trigger callback function in configuration. | Pointer to the list of the IF trigger callback function in configuration
        SoAd_TxPduConfig_cpst: category=DATA_REFERENCE, sw-pointer-target-props={target-category=TYPE_REFERENCE, implementation-data-type=SoAd_TxPduConfigType_tst, sw-impl-policy=CONST}  # Pointer to the transmission PDUs Configuration. | Pointer to the transmission PDUs Configuration
        SoAd_RxPduConfig_cpst: category=DATA_REFERENCE, sw-pointer-target-props={target-category=TYPE_REFERENCE, implementation-data-type=SoAd_RxPduConfigType_tst, sw-impl-policy=CONST}  # Pointer to the reception PDUs Configuration. | Pointer to the reception PDUs Configuration
        SoAd_StaticSocConfig_cpst: category=DATA_REFERENCE, sw-pointer-target-props={target-category=TYPE_REFERENCE, implementation-data-type=SoAd_StaticSocConfigType_tst, sw-impl-policy=CONST}  # Pointer to the Static SoAd Socket Configuration.
        SoAd_Config_TcpKeepAliveTime_cpu32: category=DATA_REFERENCE, sw-pointer-target-props={target-category=TYPE_REFERENCE, implementation-data-type=uint32, sw-impl-policy=CONST}  # Pointer to TCP Keep Alive Time array in multiples of SoAd Main periods.
        SoAd_Config_TcpKeepAliveInterval_cpu32: category=DATA_REFERENCE, sw-pointer-target-props={target-category=TYPE_REFERENCE, implementation-data-type=uint32, sw-impl-policy=CONST}  # Pointer to TCP Keep Alive Interval array in multiples of SoAd Main periods.
        SoAd_Config_TcpKeepAliveProbeMax_cpu16: category=DATA_REFERENCE, sw-pointer-target-props={target-category=TYPE_REFERENCE, implementation-data-type=uint16, sw-impl-policy=CONST}  # Pointer to TCP Keep Alive Probe Max array in multiples of SoAd Main periods. | Pointer to TCP Keep Alive Interval array in multiples of SoAd Main periods.
        SoAdIf_UdpTxPduIndex_cpu16: category=DATA_REFERENCE, sw-pointer-target-props={target-category=TYPE_REFERENCE, implementation-data-type=uint16, sw-impl-policy=CONST}  # Pointer to index for Transmission confirm for Transmission IF UDP Pdus.
        SoAd_Config_UdpAliveSupervisionTimeOut_cpu32: category=DATA_REFERENCE, sw-pointer-target-props={target-category=TYPE_REFERENCE, implementation-data-type=uint32, sw-impl-policy=CONST}  # Pointer to UdpAliveSupervisionTimeOut timer array.
        SoAdTp_UdpTransmitBufferInfo_cpu8: category=DATA_REFERENCE, sw-pointer-target-props={target-category=TYPE_REFERENCE, implementation-data-type=SoAd_TpUdpTxBufferInfo_tst, sw-impl-policy=CONST}  # Pointer to TP UDP transmission Buffer array.
        SoAdIf_nPduUdpTransmitBufferInfo_pu8: category=DATA_REFERENCE, sw-pointer-target-props={target-category=TYPE_REFERENCE, implementation-data-type=SoAd_nPduUdpTxBufferInfo_tst}  # Pointer to nPDU UDP transmission Buffer array.
        SoAdIf_TxCallbacks_cpst: category=DATA_REFERENCE, sw-pointer-target-props={target-category=TYPE_REFERENCE, implementation-data-type=SoAd_IfTxCallbacks_tst, sw-impl-policy=CONST}  # Pointer to List of callbacks for IF-transmission Confirmation.
        SoAdIf_RxCallbacks_cpst: category=DATA_REFERENCE, sw-pointer-target-props={target-category=TYPE_REFERENCE, implementation-data-type=SoAd_IfRxCallbacks_tst, sw-impl-policy=CONST}  # Pointer to List of callbacks for IF-reception Confirmation.
        SoAdTp_TxCallbacks_cpst: category=DATA_REFERENCE, sw-pointer-target-props={target-category=TYPE_REFERENCE, implementation-data-type=SoAd_TpTxCallbacks_tst, sw-impl-policy=CONST}  # Pointer to List of callbacks for TP-transmission Confirmation.
        SoAdTp_RxCallbacks_cpst: category=DATA_REFERENCE, sw-pointer-target-props={target-category=TYPE_REFERENCE, implementation-data-type=SoAd_TpRxCallbacks_tst, sw-impl-policy=CONST}  # Pointer to List of callbacks for TP-reception Confirmation.
        SoAdTp_StartOfReceptionCallbacks_cpst: category=DATA_REFERENCE, sw-pointer-target-props={target-category=TYPE_REFERENCE, implementation-data-type=SoAd_TpStartOfReceptionCallbacks_tst, sw-impl-policy=CONST}  # Pointer to List of callbacks for TpRxStartofReception.
        SoAdTp_copyTxDataCallbacks_cpst: category=DATA_REFERENCE, sw-pointer-target-props={target-category=TYPE_REFERENCE, implementation-data-type=SoAd_TpcopyTxDataCallbacks_tst, sw-impl-policy=CONST}  # Pointer to List of callbacks for socket copy transmission data to upper layer.
        SoAdTp_copyRxDataCallbacks_cpst: category=DATA_REFERENCE, sw-pointer-target-props={target-category=TYPE_REFERENCE, implementation-data-type=SoAd_TpcopyRxDataCallbacks_tst, sw-impl-policy=CONST}  # Pointer to List of callbacks for socket copy reception data to upper layer.
        SoAd_SoConModeChgCallbacks_cpst: category=DATA_REFERENCE, sw-pointer-target-props={target-category=TYPE_REFERENCE, implementation-data-type=SoAd_SoConModeChgCallbacks_tst, sw-impl-policy=CONST}  # Pointer to List of callbacks for soc connection mode change notification to upper layer.
        SoAd_LocalIpAddrAsgnChgCbk_cpst: category=DATA_REFERENCE, sw-pointer-target-props={target-category=TYPE_REFERENCE, implementation-data-type=SoAd_LocalIpAddrAsgnChgCbk_tst, sw-impl-policy=CONST}  # Pointer to List of callbacks for soc copy transmission data to upper layer.
        SoAd_RoutingGroupSoConStructMap_pst: category=DATA_REFERENCE, sw-pointer-target-props={target-category=TYPE_REFERENCE, implementation-data-type=SoAd_RoutingGroupSoConStructMap_tst, sw-impl-policy=CONST}  # Pointer to List of SoConId mapping for each Routing Group Id.
        SoAd_LocalAddrIdInfo_past: category=DATA_REFERENCE, sw-pointer-target-props={target-category=TYPE_REFERENCE, implementation-data-type=SoAd_LocalAddrIdInfoType_tst, sw-impl-policy=CONST}  # Info about TcpIp local address Id state and mapping of local address id in SoAd .
        SoAd_noStaticSockets_uo: implementation-data-type=SoAd_SoConIdType, sw-impl-policy=CONST  # Number of Static SoAd Socket in Configuration.
        SoAd_noStaticSocketGroups_uo: implementation-data-type=SoAd_SoConIdType, sw-impl-policy=CONST  # Number of Static SoAd SocketConnectionGroup in Configuration.
        SoAd_noActiveSockets_uo: implementation-data-type=SoAd_SoConIdType, sw-impl-policy=CONST  # Number of Active Socket in Configuration.
        SoAd_noRxPdus_uo: implementation-data-type=PduIdType, sw-impl-policy=CONST  # Number of Rx PDUs in Configuration.
        SoAd_noTxPdus_cuo: implementation-data-type=PduIdType, sw-impl-policy=CONST  # Number of Tx PDUs in Configuration .
        SoAdIf_noUdpTxPdus_cuo: implementation-data-type=PduIdType, sw-impl-policy=CONST  # Number of UDP Tx IF PDUs in Configuration.
        SoAd_reserved_uo: implementation-data-type=PduIdType, sw-impl-policy=CONST  # Reserved for future use and word aligned purpose .
        SoAdIf_noOfnPduUdpTxBuffers_cuo: implementation-data-type=PduIdType, sw-impl-policy=CONST  # Number of nPduUdpTxBufferSocket Configured.
        SoAd_noRoutingGrps_cuo: implementation-data-type=SoAd_RoutingGroupIdType, sw-impl-policy=CONST  # Number of Routing Groups in Configuration.
