AUTOSAR XML (schema 4-2-2)
package /AUTOSAR_SoAd/BswImplementations
  bsw implementation SoAd: programming-language=C, sw-version=10.0.0, ar-release-version=4.2.2, behavior=BswInternalBehavior
    code-descriptors:
      code CodeDescriptor: artifact-descriptors=autosar-engineering-object={short-label=ArEngObj, category=SWSRC}
package /AUTOSAR_SoAd/BswModuleDescriptions
  bsw module description SoAd
    bsw internal behavior BswInternalBehavior
      bsw schedulable entity SE_MainFunction: implemented-entry=SoAd_MainFunction
      bsw timing event EV_SE_MainFunction: starts-on-event=SE_MainFunction, period=0.001
package /AUTOSAR_SoAd/Units
  unit NoUnit: display-name=noUnit, factor-si-to-unit=1.0, offset-si-to-unit=0.0, physical-dimension=NoUnit  # No Unit
package /AUTOSAR_SoAd/PhysicalDimensions
  physical dimension NoUnit: length-exp=0
