AUTOSAR XML (schema 4-3-0)
package /AUTOSAR_SoAd/TimingExtensions
  bsw module timing SoAd: behavior=BswInternalBehavior
    timing-descriptions:
      td event bsw internal behavior EOC_T_xxms: bsw-module-entity=SE_MainFunction
      td event bsw module EOC_SoAd_Init: bsw-module-description=SoAd, bsw-module-entry=SoAd_Init, td-event-bsw-module-type=BSW-M-ENTRY-CALLED
    timing-guarantees:
      execution order constraint EOC_T_xxms: execution-order-constraint-type=ORDINARY-EOC, is-event=true, permit-multiple-references-to-ee=false
        ordered-elements:
          eoc event ref EOCEventRef_SoAd_1: bsw-module-instance=SoAd, event=EV_SE_MainFunction, successor=EOCEventRef_TcpIp_1
