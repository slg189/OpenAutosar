AUTOSAR XML (schema 4-2-2)
package /AUTOSAR_StbM/BswModuleDescriptions
  bsw module description StbM: category=BSW_MODULE, module-id=160
    provided-entrys:
      StbM_BusSetGlobalTime
      StbM_GetCurrentTime
      StbM_BusGetCurrentTime
      StbM_GetCurrentTimeExtended
      StbM_GetCurrentVirtualLocalTime
      StbM_GetOffset
      StbM_GetVersionInfo
      StbM_Init
      StbM_SetGlobalTime
      StbM_SetOffset
      StbM_SetRateCorrection
      StbM_SetUserData
      StbM_TriggerTimeTransmission
      StbM_GetTimeBaseUpdateCounter
      StbM_UpdateGlobalTime
      StbM_GetSyncTimeRecordHead
      StbM_GetRateDeviation
      StbM_GetOffsetTimeRecordHead
      StbM_GetTimeBaseStatus
      StbM_GetTimeLeap
      StbM_GetMasterConfig
      StbM_StartTimer
    6 x bsw module dependency:
      Det: target-module-id=15
      Os: target-module-id=1
      Rte: target-module-id=2
      SchM: target-module-id=130
      NvM: target-module-id=20
      EthIf: target-module-id=65  # Note : This dependency is only applicable if the Rfc 70468 is used i.e if StbMRbSpecificRfcImplementation is STD_ON
package /AUTOSAR_StbM/BswModuleEntrys
  22 x bsw module entry, all with is-synchronous=true, call-type=REGULAR, execution-context=UNSPECIFIED, sw-service-impl-policy=STANDARD:
    StbM_BusSetGlobalTime: service-id=0x0f, is-reentrant=false  # Service to set the new Global Time received from different busses | This service allows the Timebase Provider Modules to forward a new Global Time to the StbM, which has been received from different busses
      return type ReturnValue: direction=OUT, implementation-data-type=Std_ReturnType  # E_OK is returned if the operation is successful. Otherwise, E_NOT_OK is returned.
      5 x sw service arg, all with direction=IN:
        timeBaseId: implementation-data-type=StbM_SynchronizedTimeBaseType  # This parameter refers the TimebaseID for which Global time will be set.
        globalTimePtr: category=DATA_REFERENCE, sw-pointer-target-props={target-category=STRUCTURE, implementation-data-type=StbM_TimeStampType, sw-impl-policy=CONST}  # This parameter points to new Global Time value.
        userDataPtr: category=DATA_REFERENCE, sw-pointer-target-props={target-category=STRUCTURE, implementation-data-type=StbM_UserDataType, sw-impl-policy=CONST}  # This parameter points to the structure with the updated user data that has to be set.
        measureDataPtr: category=DATA_REFERENCE, sw-pointer-target-props={target-category=STRUCTURE, implementation-data-type=StbM_MeasurementType, sw-impl-policy=CONST}  # This parameter points to the structure with the updated measurement data that has to be set.
        localTimePtr: category=DATA_REFERENCE, sw-impl-policy=CONST, sw-pointer-target-props={target-category=STRUCTURE, implementation-data-type=StbM_VirtualLocalTimeType}  # This parameter points to the structure with the Value of the virtual Local Time associated to the new Global Time.
    StbM_GetCurrentTime: service-id=0x07, is-reentrant=false  # Service to get the current time value in standard format | This service returns a time value (Local Time Base derived from Global Time Base) in standard format.
      return type ReturnValue: direction=OUT, implementation-data-type=Std_ReturnType  # E_OK is returned if the operation is successful. Otherwise, E_NOT_OK is returned.
      sw service arg timeBaseId: direction=IN, implementation-data-type=StbM_SynchronizedTimeBaseType  # This parameter refers the TimebaseID for which current time will be read.
      sw service arg timeStamp: category=DATA_REFERENCE, direction=OUT, sw-pointer-target-props={target-category=STRUCTURE, implementation-data-type=StbM_TimeStampType}  # This parameter points to the Current time stamp that is valid at this time.
      sw service arg userData: category=DATA_REFERENCE, direction=OUT, sw-pointer-target-props={target-category=STRUCTURE, implementation-data-type=StbM_UserDataType}  # This parameter points to the user variable which receives the userdata of the timebase.
    StbM_BusGetCurrentTime: service-id=0x07, is-reentrant=false  # Service to get the current Time Tuple, status and User Data of the Time Base | This service returns the current Time Tuple, status and User Data of the Time Base
      return type ReturnValue: direction=OUT, implementation-data-type=Std_ReturnType  # E_OK is returned if the operation is successful. Otherwise, E_NOT_OK is returned.
      4 x sw service arg:
        timeBaseID: direction=IN, implementation-data-type=StbM_SynchronizedTimeBaseType  # This parameter refers the TimebaseID for which current TIme will be read.
        globalTimePtr: category=DATA_REFERENCE, direction=OUT, sw-pointer-target-props={target-category=VALUE, implementation-data-type=StbM_TimeStampType}  # This parameter holds the value of the local instance of the Global Time, which is sampled when the function is called
        localTimePtr: category=DATA_REFERENCE, direction=OUT, sw-pointer-target-props={target-category=STRUCTURE, implementation-data-type=StbM_VirtualLocalTimeType}  # This parameter refers the Value of the Virtual Local Time, which is sampled when the function is called
        userData: category=DATA_REFERENCE, direction=OUT, sw-pointer-target-props={target-category=STRUCTURE, implementation-data-type=StbM_UserDataType}  # This parameter points to the user variable which receives the userdata of the timebase.
    StbM_GetCurrentTimeExtended: service-id=0x09, is-reentrant=false  # Service to get the current time value in extended format | This service returns a time value (Local Time Base derived from Global Time Base) in extended format.The existence of this service is pre-compile time configurable by the configuration parameter StbMGetCurrentTimeExtendedAvailable.
      return type ReturnValue: direction=OUT, implementation-data-type=Std_ReturnType  # E_OK is returned if the operation is successful. Otherwise, E_NOT_OK is returned.
      sw service arg timeBaseId: direction=IN, implementation-data-type=StbM_SynchronizedTimeBaseType  # This parameter refers the TimebaseID for which Global time should be read.
      sw service arg timeStamp: category=DATA_REFERENCE, direction=OUT, sw-pointer-target-props={target-category=STRUCTURE, implementation-data-type=StbM_TimeStampExtendedType}  # This parameter points to the Current time stamp that is valid at this time.
      sw service arg userData: category=DATA_REFERENCE, direction=OUT, sw-pointer-target-props={target-category=STRUCTURE, implementation-data-type=StbM_UserDataType}  # This parameter points to the user variable which receives the userdata.
    StbM_GetCurrentVirtualLocalTime: service-id=0x1e, is-reentrant=false  # Service to get the Virtual Local Time of the referenced Time Base. | This service returns the Virtual Local Time of the referenced Time Base.
      return type ReturnValue: direction=OUT, implementation-data-type=Std_ReturnType  # E_OK is returned if the operation is successful. Otherwise, E_NOT_OK is returned.
      sw service arg timeBaseID: direction=IN, implementation-data-type=StbM_SynchronizedTimeBaseType  # This parameter refers the TimebaseID for which Virtual Local TIme will be read.
      sw service arg localTimePtr: category=DATA_REFERENCE, direction=OUT, sw-pointer-target-props={target-category=STRUCTURE, implementation-data-type=StbM_VirtualLocalTimeType}  # The parameter holds the current Virtual Local Time value
    StbM_GetOffset: service-id=0x0e, is-reentrant=false  # Service to set the Offset time value | This service allows the Timebase Provider Modules to get the current offset time.
      return type ReturnValue: direction=OUT, implementation-data-type=Std_ReturnType  # E_OK is returned if the operation is successful. Otherwise, E_NOT_OK is returned.
      sw service arg timeBaseId: direction=IN, implementation-data-type=StbM_SynchronizedTimeBaseType  # This parameter refers to the TimebaseID for which Offset time value should be referenced.
      sw service arg timeStamp: category=DATA_REFERENCE, direction=OUT, sw-pointer-target-props={target-category=STRUCTURE, implementation-data-type=StbM_TimeStampType}  # This parameter points to the Current Offset Time value.
      sw service arg userData: category=DATA_REFERENCE, direction=OUT, sw-pointer-target-props={target-category=STRUCTURE, implementation-data-type=StbM_UserDataType}  # This parameter points to the Current User Data.
    StbM_GetVersionInfo: service-id=0x05, is-reentrant=true  # Service to get the Version information of the StbM module. | This service returns the version information of this module.The existence of this service is pre-compile time configurable by the configuration parameter StbMVersionInfo.
      return type ReturnValue: direction=OUT, implementation-data-type=Std_ReturnType  # E_OK is returned if the operation is successful. Otherwise, E_NOT_OK is returned.
      sw service arg versioninfo: category=DATA_REFERENCE, direction=OUT, sw-pointer-target-props={target-category=VALUE, implementation-data-type=Std_VersionInfoType}  # This parameter points to the user variable which shall receive the version information of this module (vendor ID, module ID and software version). Please refer to the description of the Std_VersionInfoType for details
    StbM_Init: service-id=0x00, is-reentrant=false  # Service to initialize the StbM module | StbM_Init( const StbM_ConfigType* ConfigPtr ) ,This service initializes the Synchronized Time-base Manager. StbM_ConfigType is a implementation specific Configuration data structure of the StbM module.
    StbM_SetGlobalTime: service-id=0x0b, is-reentrant=false  # Service to set the Global time value | This service allows the Customers to set the new global time that has to be valid for the system, which will be sent to the busses and modify HW registers behind the providers, if supported. This function will be used if a Time Master is present in this ECU.
      return type ReturnValue: direction=OUT, implementation-data-type=Std_ReturnType  # E_OK is returned if the operation is successful. Otherwise, E_NOT_OK is returned
      sw service arg timeBaseId: direction=IN, implementation-data-type=StbM_SynchronizedTimeBaseType  # This parameter refers to the TimebaseID for which Global time value should be set.
      sw service arg timeStamp: category=DATA_REFERENCE, direction=IN, sw-pointer-target-props={target-category=STRUCTURE, implementation-data-type=StbM_TimeStampType, sw-impl-policy=CONST}  # This parameter points to the structure with the updated time value that has to be set.
      sw service arg userData: category=DATA_REFERENCE, direction=IN, sw-pointer-target-props={target-category=STRUCTURE, implementation-data-type=StbM_UserDataType, sw-impl-policy=CONST}  # This parameter points to the structure with the updated user data that has to be set.
    StbM_SetOffset: service-id=0x0d, is-reentrant=false  # Service to set the Offset time value. | This service allows the Customers and the Timebase Provider Modules to set the offset time.
      return type ReturnValue: direction=OUT, implementation-data-type=Std_ReturnType  # E_OK is returned if the operation is successful. Otherwise, E_NOT_OK is returned
      sw service arg timeBaseId: direction=IN, implementation-data-type=StbM_SynchronizedTimeBaseType  # This parameter refers to the TimebaseID for which Offset time value should be set.
      sw service arg timeStamp: category=DATA_REFERENCE, direction=IN, sw-pointer-target-props={target-category=STRUCTURE, implementation-data-type=StbM_TimeStampType, sw-impl-policy=CONST}  # This parameter points to the structure with the new offset timestamp value that has to be set.
      sw service arg userData: category=DATA_REFERENCE, direction=IN, sw-pointer-target-props={target-category=STRUCTURE, implementation-data-type=StbM_UserDataType, sw-impl-policy=CONST}  # This parameter points to the structure with the updated new user data.
    StbM_SetRateCorrection: service-id=0x12, is-reentrant=true  # Service to set the Rate of a Synchronized Time Base. | This service allows to set rate of a synchronized Time Base(being either a Pure Local Time Base or not
      return type ReturnValue: direction=OUT, implementation-data-type=Std_ReturnType  # E_OK is returned if the operation is successful. Otherwise, E_NOT_OK is returned
      sw service arg timeBaseId: direction=IN, implementation-data-type=StbM_SynchronizedTimeBaseType  # This parameter refers to the TimebaseID for which rate corrected time should be set.
      sw service arg rateDeviation: direction=IN, implementation-data-type=StbM_RateDeviationType, sw-impl-policy=CONST  # This parameter refers to value applied as rate deviation.
    StbM_SetUserData: service-id=0x0c, is-reentrant=false  # Service to set the user data. | This service allows the Customers to set the new user data that has to be valid for the system, which will be sent to the busses.
      return type ReturnValue: direction=OUT, implementation-data-type=Std_ReturnType  # E_OK is returned if the operation is successful. Otherwise, E_NOT_OK is returned.
      sw service arg timeBaseId: direction=IN, implementation-data-type=StbM_SynchronizedTimeBaseType  # This parameter refers to the TimebaseID for which user data should be set.
      sw service arg userData: category=DATA_REFERENCE, direction=IN, sw-pointer-target-props={target-category=STRUCTURE, implementation-data-type=StbM_UserDataType, sw-impl-policy=CONST}  # This parameter points to the structure with the updated new user data that has to be set.
    StbM_TriggerTimeTransmission: service-id=0x1c, is-reentrant=false  # Service to increment the global array timeBaseUpdateCounter | Allows the Customers to force the Timesync Modules to transmit the current Time Base due to an incremented timeBaseUpdateCounter
      return type ReturnValue: direction=OUT, implementation-data-type=Std_ReturnType  # E_OK is returned if the operation is successful. Otherwise, E_NOT_OK is returned.
      sw service arg timeBaseId: direction=IN, implementation-data-type=StbM_SynchronizedTimeBaseType  # This parameter refers to the TimebaseID for which value should be referenced.
    StbM_GetTimeBaseUpdateCounter: service-id=0x1b, is-reentrant=false  # Service to get the global array timeBaseUpdateCounter | Allows the Timesync Modules to detect, whether a Time Base should be transmitted immediately in the subsequent <Bus>TSyn_MainFunction() cycle.
      return type ReturnValue: direction=OUT, implementation-data-type=uint8  # Counter value belonging to the Time Base, that indicates a Time Base update to the Timesync Modules is returned.
      sw service arg timeBaseId: direction=IN, implementation-data-type=StbM_SynchronizedTimeBaseType  # This parameter refers to the TimebaseID for which the counter value should be updated.
    StbM_GetMasterConfig: service-id=0x1d, is-reentrant=false  # Service to indicate whether the functionality for a system wide master is available or not | This service indicates if the functionality for a system wide master (e.g. StbM_SetGlobalTime) for a given Time Base is available or not.
      return type ReturnValue: direction=OUT, implementation-data-type=Std_ReturnType  # E_OK is returned if the operation is successful. Otherwise, E_NOT_OK is returned.
      sw service arg timeBaseId: direction=IN, implementation-data-type=StbM_SynchronizedTimeBaseType  # This parameter refers the TimebaseID for which StbM_MasterConfigType will be set.
      sw service arg masterConfig: category=DATA_REFERENCE, direction=OUT, sw-pointer-target-props={target-category=VALUE, implementation-data-type=StbM_MasterConfigType}  # This parameter indicates, if system wide master functionality is supported
    StbM_GetTimeLeap: service-id=0x13, is-reentrant=true  # Service to get the value of Time Leap, if StbMTimeLeapFuture/PastThreshold is exceeded | This service returns value of Time Leap, if StbMTimeLeapFuture/PastThreshold is exceeded.
      return type ReturnValue: direction=OUT, implementation-data-type=Std_ReturnType  # E_OK is returned if the operation is successful. Otherwise, E_NOT_OK is returned.
      sw service arg timeBaseId: direction=IN, implementation-data-type=StbM_SynchronizedTimeBaseType  # This parameter refers to the TimebaseID for which TimeDiff should be set.
      sw service arg timeJump: category=DATA_REFERENCE, direction=OUT, sw-pointer-target-props={target-category=STRUCTURE, implementation-data-type=StbM_TimeDiffType}  # This parameter points to the structure with the time leap value
    StbM_UpdateGlobalTime: service-id=0x10, is-reentrant=false  # Service to set the Global time value without leading to an immediate transmission of the Global Time | This service allows the Customers to set the Global Time that will be sent to the buses.This function will be used if a Time Master is present in this ECU.Using UpdateGlobalTime will not lead to an immediate transmission of the Global Time.
      return type ReturnValue: direction=OUT, implementation-data-type=Std_ReturnType  # E_OK is returned if the operation is successful. Otherwise, E_NOT_OK is returned.
      sw service arg timeBaseId: direction=IN, implementation-data-type=StbM_SynchronizedTimeBaseType  # This parameter refers to the TimebaseID for which TimeStampValue should be set.
      sw service arg timeStamp: category=DATA_REFERENCE, direction=IN, sw-pointer-target-props={target-category=STRUCTURE, implementation-data-type=StbM_TimeStampType, sw-impl-policy=CONST}  # This parameter points to the structure with the updated new time stamp value that has to be set
      sw service arg userData: category=DATA_REFERENCE, direction=IN, sw-pointer-target-props={target-category=STRUCTURE, implementation-data-type=StbM_UserDataType, sw-impl-policy=CONST}  # This parameter points to the structure with the updated new user data that has to be set
    StbM_GetSyncTimeRecordHead: service-id=0x16, is-reentrant=false  # Service to access the recorded snapshot data Header of the table belonging to the Synchronized Time Base. | This service allows to access the recorded snapshot data Header of the table belonging to the Synchronized Time Base.
      return type ReturnValue: direction=OUT, implementation-data-type=Std_ReturnType  # E_OK is returned if the operation is successful. Otherwise, E_NOT_OK is returned.
      sw service arg timeBaseId: direction=IN, implementation-data-type=StbM_SynchronizedTimeBaseType  # This parameter refers to the TimebaseID for which SyncRecordTableHead should be set.
      sw service arg syncRecordTableHead: category=DATA_REFERENCE, direction=IN, sw-pointer-target-props={target-category=STRUCTURE, implementation-data-type=StbM_SyncRecordTableHeadType}  # This parameter refers to Synchronized Time Base Record Table Header
    StbM_GetRateDeviation: service-id=0x11, is-reentrant=true  # Service to Return value of the current rate deviation of a time base. | Returns value of the current rate deviation of a Time Base
      return type ReturnValue: direction=OUT, implementation-data-type=Std_ReturnType  # E_OK is returned if the operation is successful. Otherwise, E_NOT_OK is returned.
      sw service arg timeBaseId: direction=IN, implementation-data-type=StbM_SynchronizedTimeBaseType  # This parameter refers to the TimebaseID for which RateDeviation should be set.
      sw service arg rateDeviation: category=DATA_REFERENCE, direction=OUT, sw-pointer-target-props={target-category=VALUE, implementation-data-type=StbM_RateDeviationType}  # This parameter gives Value of the current rate deviation of a Time Base
    StbM_GetOffsetTimeRecordHead: service-id=0x17, is-reentrant=false  # Service to access the recorded snapshot data Header of the table belonging to the Offset Time Base. | This service allows to access the recorded snapshot data Header of the table belonging to the Offset Time Base
      return type ReturnValue: direction=OUT, implementation-data-type=Std_ReturnType  # E_OK is returned if the operation is successful. Otherwise, E_NOT_OK is returned.
      sw service arg timeBaseId: direction=IN, implementation-data-type=StbM_SynchronizedTimeBaseType  # This parameter refers to the TimebaseID for which OffsetRecordTableHead should be set.
      sw service arg offsetRecordTableHead: category=DATA_REFERENCE, direction=OUT, sw-pointer-target-props={target-category=STRUCTURE, implementation-data-type=StbM_OffsetRecordTableHeadType}  # This parameter refers to Offset Time Base Record Table Header
    StbM_StartTimer: service-id=0x19, is-reentrant=false  # Service to notify the customers,when a timebase related event occurs. | The callback notifies the customers, when a TimeBase related event occurs, which is enabled by the notification mask.
      return type ReturnValue: direction=OUT, implementation-data-type=Std_ReturnType  # E_OK is returned if the operation is successful. Otherwise, E_NOT_OK is returned.
      sw service arg timeBaseId: direction=IN, implementation-data-type=StbM_SynchronizedTimeBaseType  # This parameter refers to the TimebaseID for which timer should be set.
      sw service arg customerId: direction=IN, implementation-data-type=StbM_CustomerIdType  # This parameter refers the TimebaseID for which the timer will be set
      sw service arg expireTime: category=DATA_REFERENCE, direction=IN, sw-pointer-target-props={target-category=STRUCTURE, implementation-data-type=StbM_TimeStampType, sw-impl-policy=CONST}  # This parameter points to the structure with the Time value relative to current Time Base value of the Notification Customer, when the Timer shall expire
    StbM_GetTimeBaseStatus: service-id=0x14, is-reentrant=true  # Returns the detailed status of the Time Base. | Returns the detailed status of the Time Base. For Offset Time Bases the status of the Offset Time Base itself and the status of the underlying Synchronized Time Base is returned.
      return type ReturnValue: direction=OUT, implementation-data-type=Std_ReturnType  # E_OK is returned if the operation is successful. Otherwise, E_NOT_OK is returned.
      sw service arg timeBaseId: direction=IN, implementation-data-type=StbM_SynchronizedTimeBaseType  # This parameter refers to the TimebaseID for which TimeBaseStatus should be set.
      sw service arg syncTimeBaseStatus: category=DATA_REFERENCE, direction=OUT, sw-pointer-target-props={target-category=STRUCTURE, implementation-data-type=StbM_TimeBaseStatusType}  # This parameter points to the structure with the status of the Synchronized or pure local Time Base
      sw service arg offsetTimeBaseStatus: category=DATA_REFERENCE, direction=IN, sw-pointer-target-props={target-category=STRUCTURE, implementation-data-type=StbM_TimeBaseStatusType}  # This parameter points to the structure with the status of the Offset Time base
package /AUTOSAR_StbM/ImplementationDataTypes
  impl type StbM_VirtualLocalTimeType: category=STRUCTURE, type-emitter=GLOBAL  # Variables of this type store time stamps of the Virtual Local Time. | Variables of this type store time stamps of the Virtual Local Time. Note : Refer SWS for other implementation data types (StbM_TimeBaseStatusType,StbM_TimeStampType,StbM_TimeStampExtendedType,StbM_UserDataType,StbM_SynchronizedTimeBaseType)
    element nanosecondsHi: implementation-data-type=uint32
    element nanosecondsLo: implementation-data-type=uint32
  impl type StbM_MeasurementType: category=STRUCTURE, type-emitter=GLOBAL  # Structure which contains additional measurement data. | Structure which contains additional measurement data Note : Refer SWS for other implementation data types (Ex:StbM_TimeDiffType,StbM_TimeStampType,StbM_TimeStampExtendedType,StbM_UserDataType,StbM_SynchronizedTimeBaseType)
    element pathDelay: implementation-data-type=uint32
