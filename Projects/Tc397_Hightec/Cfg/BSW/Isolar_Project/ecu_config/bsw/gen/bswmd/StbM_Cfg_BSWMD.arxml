AUTOSAR XML (schema 4-2-2)
package /AUTOSAR_StbM/BswImplementations
  bsw implementation StbM: programming-language=C, swc-bsw-mapping=SwcBswMapping_StbM, ar-release-version=4.3.0, behavior=IB_StbM
    code-descriptors:
      code CodeDescriptor: artifact-descriptors=autosar-engineering-object={short-label=ArEngObj, category=SWSRC}
    resource consumption StbM_ResourceConsumption
      10 x memory section:
        STBM_CODE: prefix=STBM, sw-addrmethod=CODE, symbol=CODE
        StbM_CODE: prefix=StbM, sw-addrmethod=CODE, symbol=CODE
        STBM_CONST_UNSPECIFIED: alignment=UNSPECIFIED, prefix=STBM, sw-addrmethod=CONST, symbol=CONST_UNSPECIFIED
        STBM_VAR_CLEARED_16: alignment=16, prefix=STBM, sw-addrmethod=VAR_CLEARED, symbol=VAR_CLEARED_16
        STBM_VAR_CLEARED_32: alignment=32, prefix=STBM, sw-addrmethod=VAR_CLEARED, symbol=VAR_CLEARED_32
        STBM_VAR_CLEARED_8: alignment=8, prefix=STBM, sw-addrmethod=VAR_CLEARED, symbol=VAR_CLEARED_8
        STBM_VAR_CLEARED_UNSPECIFIED: alignment=UNSPECIFIED, prefix=STBM, sw-addrmethod=VAR_CLEARED, symbol=VAR_CLEARED_UNSPECIFIED
        STBM_VAR_INIT_8: alignment=8, prefix=STBM, sw-addrmethod=VAR_INIT, symbol=VAR_INIT_8
        STBM_VAR_INIT_UNSPECIFIED: alignment=UNSPECIFIED, prefix=STBM, sw-addrmethod=VAR_INIT, symbol=VAR_INIT_UNSPECIFIED
        STBM_VAR_SAVED_ZONE_UNSPECIFIED: alignment=UNSPECIFIED, prefix=STBM, sw-addrmethod=VAR_SAVED_ZONE, symbol=VAR_SAVED_ZONE_UNSPECIFIED
      section name prefix StbM
      section name prefix STBM
package /AUTOSAR_StbM/BswModuleDescriptions
  bsw module description StbM: category=BSW_MODULE, module-id=160, provided-entrys=StbM_MainFunction
    bsw internal behavior IB_StbM
      bsw called entity CE_StbM_Init: implemented-entry=StbM_Init
      bsw schedulable entity SE_MainFunction: implemented-entry=StbM_MainFunction
      bsw timing event TE_StbM_MainFunction: starts-on-event=SE_MainFunction, period=0.01
package /AUTOSAR_StbM/BswModuleEntrys
  bsw module entry StbM_MainFunction: service-id=4, is-reentrant=true, is-synchronous=true, call-type=SCHEDULED, execution-context=TASK, sw-service-impl-policy=STANDARD
