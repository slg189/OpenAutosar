AUTOSAR XML (schema 4-2-2)
package /AUTOSAR_StbM/TimingExtensions
  bsw module timing StbM_BswModuleTiming
    timing-requirements:
      execution order constraint EOC_EcuM_Init: execution-order-constraint-type=ORDINARY-EOC, is-event=false, permit-multiple-references-to-ee=false
        ordered-elements:
          eoc executable entity ref EOCEERef_BSWCE_StbM_Init: bsw-module-instance=StbM, executable=CE_StbM_Init
      execution order constraint EOC_T_xxms: execution-order-constraint-type=ORDINARY-EOC, is-event=true
        ordered-elements:
          eoc event ref EOCEventRef_StbM_MainFunction: bsw-module-instance=StbM, event=TE_StbM_MainFunction
