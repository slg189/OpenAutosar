AUTOSAR XML (schema 4-0-3)
package /AUTOSAR_TcpIp/BswModuleDescriptions
  bsw module description TcpIp: category=BSW_MODULE, module-id=170  # TCP/IP Stack
    provided-entrys:
      TcpIp_MainFunction
      TcpIp_Init
      TcpIp_GetVersionInfo
      TcpIp_UpGetSocket
      TcpIp_Bind
      TcpIp_Close
      TcpIp_UdpTransmit
      TcpIp_UdpTransmitMetaData
      TcpIp_TcpTransmit
      TcpIp_TcpReceived
      TcpIp_TcpConnect
      TcpIp_TcpListen
      TcpIp_IcmpTransmit
      TcpIp_ReadArpTable
      TcpIp_ChangeParameter
      TcpIp_RequestIpAddrAssignment
      TcpIp_ReleaseIpAddrAssignment
      TcpIp_GetIpAddr
      TcpIp_GetPhysAddr
      TcpIp_DhcpWriteOption
      TcpIp_DhcpReadOption
      TcpIp_AllocBaseIpAddr
      TcpIp_RequestComMode
      TcpIp_GetCtrlIdx
      TcpIp_GetAndResetMeasurementData
      TcpIp_ZeroCopyUdpTransmit
      TcpIp_ZeroCopyReset
    outgoing-callbacks:
      TcpIp_RxIndication
      TcpIp_ZeroCopyTxConfirmation
      TcpIp_LocalIpAddrAssignmentChg
      TcpIp_DuplicateAddressIndication
package /AUTOSAR_TcpIp/BswModuleEntrys
  31 x bsw module entry, all with sw-service-impl-policy=STANDARD:
    TcpIp_MainFunction: is-reentrant=false, is-synchronous=true, call-type=SCHEDULED, execution-context=TASK  # This service schedules the TcpIp stack. | The service schedules all TcpIp submodules and operates the effects of the TcpIp state machine.
    TcpIp_RxIndication: is-reentrant=true, is-synchronous=true, call-type=CALLBACK, execution-context=UNSPECIFIED  # This service indicates the reception of a frame. | The service forwards the received frame to the concerned modules for processing of the received data.
      6 x sw service arg, all with direction=IN:
        CtrlIdx: implementation-data-type=uint8  # Index of the EthIf Controller on which Rx Indication is triggered.
        FrameType: implementation-data-type=Eth_FrameType  # Frame type of the received frame.
        IsBroadcast: implementation-data-type=boolean  # Variable to indicate whether the received frame is broadcast.
        PhysAddrPtr: category=DATA_REFERENCE, sw-pointer-target-props={target-category=VALUE, implementation-data-type=uint8}  # Pointer to Physical source address (MAC address in network byte order) of received Ethernet frame.
        DataPtr: category=DATA_REFERENCE, sw-pointer-target-props={target-category=VALUE, implementation-data-type=uint8}  # Pointer to payload of the received Ethernet frame (i.e. Ethernet header is not provided).
        LenByte: implementation-data-type=uint16  # Length of received data.
    TcpIp_ZeroCopyTxConfirmation: is-reentrant=false, is-synchronous=true, call-type=CALLBACK, execution-context=UNSPECIFIED  # This callback function invoked when a transmission marked with TxId is completed. This is a trigger to release the previously allocated headers.
      sw service arg EthIfCtrlIdx_u8: direction=IN, implementation-data-type=uint8  # Index of the EthIf controller.
      sw service arg TxId_u32: direction=IN, implementation-data-type=uint32  # TxId which identify the transmission which is now completed.
    TcpIp_LocalIpAddrAssignmentChg: is-reentrant=true, is-synchronous=true, call-type=CALLBACK, execution-context=UNSPECIFIED  # This API is callback function called from modules such as AutoIp or DHCP after a new IP address has been created. | This API is a callback function triggered from modules such as AutoIp or DHCP after a new IP address has been created. The new IP address is assigned to the corresponding local address id.
      5 x sw service arg, all with direction=IN:
        LocalAddrId_u8: implementation-data-type=TcpIp_LocalAddrIdType  # IP address index specifying the IP address for which an assignment shall be initiated.
        State_en: implementation-data-type=TcpIp_IpAddrStateType  # IP address is assigned or unassigned.
        IPAddrParam_pcun: category=DATA_REFERENCE, sw-pointer-target-props={target-category=VALUE, implementation-data-type=TcpIp_IPAddrParamType_tun, sw-impl-policy=CONST}  # Pointer to a structure containing the assigned IP address, net mask and default router IP address.
        IPAddrAssignMethod_en: implementation-data-type=TcpIp_IpAddrAssignmentType  # IP address assignment method - DHCP / AutoIp.
        IpDomainType_cu32: implementation-data-type=TcpIp_DomainType, sw-impl-policy=CONST  # Domain of provided IP address.
    TcpIp_DuplicateAddressIndication: is-reentrant=true, is-synchronous=true, call-type=CALLBACK, execution-context=UNSPECIFIED  # This API is callback function called from Ipv6 modules when it has to inform TcpIp about the assigned IP address is Duplicate or Unique.
      4 x sw service arg, all with direction=IN:
        LocalAddrId_u8: implementation-data-type=TcpIp_LocalAddrIdType  # IP address identifier representing the local IP address.
        DadState_en: implementation-data-type=TcpIp_DadStateType_ten  # IP address is unique or duplicate.
        IPAddrParam_pcun: category=DATA_REFERENCE, sw-pointer-target-props={target-category=VALUE, implementation-data-type=TcpIp_IPAddrParamType_tun, sw-impl-policy=CONST}  # Pointer to a memory where the conflicted IP address is stored.
        RemotePhysAddrPtr_pcu8: category=DATA_REFERENCE, sw-pointer-target-props={target-category=VALUE, implementation-data-type=uint8, sw-impl-policy=CONST}  # Pointer to the memory where the remote physical address (MACaddress) related to the specified IP address is stored in network byte order.
    TcpIp_Init: is-reentrant=false, is-synchronous=true, call-type=REGULAR, execution-context=UNSPECIFIED  # This service initializes the TcpIp stack. | The service initializes global variables, RAM data structures and all TcpIp submodules.
      sw service arg ConfigPtr: category=DATA_REFERENCE, direction=IN, sw-pointer-target-props={target-category=VALUE, implementation-data-type=TcpIp_ConfigType, sw-impl-policy=CONST}  # Pointer to the configuration data of the TcpIp module.
    TcpIp_GetVersionInfo: is-reentrant=true, is-synchronous=true, call-type=REGULAR, execution-context=UNSPECIFIED  # This services fetches the software version information of the TcpIp module. | The software major, minor and patch version of the TcpIp module is put out.
      sw service arg versioninfo: category=DATA_REFERENCE, direction=OUT, sw-pointer-target-props={target-category=VALUE, implementation-data-type=Std_VersionInfoType}  # Pointer to store the version information of this module.
    TcpIp_UpGetSocket: is-reentrant=true, is-synchronous=true, call-type=REGULAR, execution-context=UNSPECIFIED  # This configurable service allocates a new socket. | For each configured TcpIpSocketOwner TcpIp provides separate TcpIp_<Up>GetSocket API by replacing the tag <Up> with 'SoAd', if TcpIpSocketOwnerUpperLayerType set to 'SOAD', or with the short name of the TcpIpSocketOwner container, if TcpIpSocketOwnerUpperLayerType set to 'CDD'. Through this service TcpIp allocates an available socket to the requesting upper layer and requested domain and transport protocol.
      return type ReturnValue: direction=OUT, implementation-data-type=Std_ReturnType  # Returns E_OK, if socket allocation is successful. Otherwise E_NOT_OK is returned.
      sw service arg Domain: direction=IN, implementation-data-type=TcpIp_DomainType  # Specifies the IP domain of the socket to be allocated.
      sw service arg Protocol: direction=IN, implementation-data-type=TcpIp_ProtocolType  # Specifies the transport protocol of the socket to be allocated.
      sw service arg SocketIdPtr: category=DATA_REFERENCE, direction=OUT, sw-pointer-target-props={target-category=VALUE, implementation-data-type=TcpIp_SocketIdType}  # Pointer to store the allocated socket ID number.
    TcpIp_Bind: is-reentrant=true, is-synchronous=true, call-type=REGULAR, execution-context=UNSPECIFIED  # This service binds a socket to a LocalAddrId and port. | This service binds a TCP or UDP socket to a port number and LocalAddrId, specifying its IP address and TcpIp controller. Sockets that shall be switched in a listening state later on must be bound to a local resource. Optionally this API can be used to specify the local IP address and port used by later calls of TcpIp_TcpConnect() or TcpIp_UdpTransmit().
      return type ReturnValue: direction=OUT, implementation-data-type=Std_ReturnType  # Returns E_OK, if socket is bound successful. Otherwise E_NOT_OK is returned.
      sw service arg SocketId: direction=IN, implementation-data-type=TcpIp_SocketIdType  # Specifies the socket number of the local socket resource.
      sw service arg LocalAddrId: direction=IN, implementation-data-type=TcpIp_LocalAddrIdType  # IP address identifier representing the local IP address and EthIf controller to bind the socket to. Note: wildcard for local IP address and LocalAddrId are currently not supported.
      sw service arg PortPtr: category=DATA_REFERENCE, direction=INOUT, sw-pointer-target-props={target-category=VALUE, implementation-data-type=uint16}  # Local port to which the socket shall be bound. In case the parameter is specified as wildcard (TCPIP_PORT_ANY), the TCP/IP stack chooses the local port automatically.
    TcpIp_Close: is-reentrant=true, is-synchronous=false, call-type=REGULAR, execution-context=UNSPECIFIED  # This service closes a socket and releases all related resources. | By this API service the TCP/IP stack is requested to close the socket and release all related resources. | The service TcpIp_Close() shall perform the following actions for the socket specified by SocketId in case it is a TCP socket: If the connection is active and abort = FALSE: the connection shall be terminated after performing a regular connection termination handshake and releasing all related resources. abort = TRUE: connection shall immediately be terminated by sending a RST-Segment and releasing all related resources. If the socket is in the Listen state, the Listen state shall be left immediately and related resources shall be released. The service TcpIp_Close() shall release all related resources immediately for the socket specified by SocketId in case it is a UDP socket.
      return type ReturnValue: direction=OUT, implementation-data-type=Std_ReturnType  # Returns E_OK, if socket is closed/ request for closure is accepted. Otherwise E_NOT_OK is returned.
      sw service arg SocketId: direction=IN, implementation-data-type=TcpIp_SocketIdType  # Specifies the socket number of the socket resource to be closed.
      sw service arg Abort: direction=IN, implementation-data-type=boolean  # Specifies whether a TCP socket should be closed immediately or not.
    TcpIp_UdpTransmit: is-reentrant=true, is-synchronous=true, call-type=REGULAR, execution-context=UNSPECIFIED  # This service transmits data via UDP to a remote node via calling TcpIp_UdpTransmitMetaData() with MetaDataPtr as Null Pointer. | This service transmits data via UDP to a remote node via calling TcpIp_UdpTransmitMetaData() with MetaDataPtr as Null Pointer. The transmission of the data is immediately performed with this function call by forwarding it to EthIf.
      return type ReturnValue: direction=OUT, implementation-data-type=TcpIp_ReturnType  # TCPIP_OK is returned, if transmission is successful. E_NOT_OK is returned, if transmission is unsuccessful. TCPIP_E_ARP_CACHE_MISS is returned, if ARP entry of remote node is not available.
      4 x sw service arg, all with direction=IN:
        SocketId: implementation-data-type=TcpIp_SocketIdType  # Specifies the socket number of the local socket resource.
        DataPtr: category=DATA_REFERENCE, sw-pointer-target-props={target-category=VALUE, implementation-data-type=uint8, sw-impl-policy=CONST}  # Pointer to a linear buffer of TotalLength bytes containing the data to be transmitted.
        RemoteAddrPtr: category=DATA_REFERENCE, sw-pointer-target-props={target-category=STRUCTURE, implementation-data-type=TcpIp_SockAddrType, sw-impl-policy=CONST}  # IP address and port of the remote host to transmit to.
        TotalLength: implementation-data-type=uint16  # Indicates the payload size of the UDP datagram.
    TcpIp_UdpTransmitMetaData: is-reentrant=true, is-synchronous=true, call-type=REGULAR, execution-context=UNSPECIFIED  # The service TcpIp_UdpTransmitMetaData() shall immediately transmit TotalLength data bytes via UDP and the socket specified by SocketId to a remote socket specified by RemoteAddrPtr with the possibility to provide metadata. | This service transmits data in parallel on the same socket via UDP to a remote node. The transmission of the data is immediately performed with this function call by forwarding it to EthIf.In case DataPtr is NULL pointer, the TcpIp will receive the data to be transmitted by triggering callback to Upper Layer. If Metadata is valid pointer then Up_CopyTxDataMetaData() will be called otherwise if NULL pointer then Up_CopyTxData is called.
      return type ReturnValue: direction=OUT, implementation-data-type=TcpIp_ReturnType  # TCPIP_OK is returned, if transmission is successful. E_NOT_OK is returned, if transmission is unsuccessful. TCPIP_E_ARP_CACHE_MISS is returned, if ARP entry of remote node is not available.
      5 x sw service arg, all with direction=IN:
        SocketId_u16: implementation-data-type=TcpIp_SocketIdType  # Specifies the socket number of the local socket resource.
        DataPtr_pcu8: category=DATA_REFERENCE, sw-pointer-target-props={target-category=VALUE, implementation-data-type=uint8, sw-impl-policy=CONST}  # Pointer to a linear buffer of TotalLength bytes containing the data to be transmitted.
        RemoteAddrPtr_pcst: category=DATA_REFERENCE, sw-pointer-target-props={target-category=STRUCTURE, implementation-data-type=TcpIp_SockAddrType, sw-impl-policy=CONST}  # IP address and port of the remote host to transmit to.
        TotalLength_u16: implementation-data-type=uint16  # Indicates the payload size of the UDP datagram.
        MetaDataPtr_pcv: category=DATA_REFERENCE, sw-pointer-target-props={target-category=VALUE, implementation-data-type=uint8, sw-impl-policy=CONST}  # MetaData provided by UpperLayer which will be given back within Up_CopyTxDataMetaData.
    TcpIp_TcpTransmit: is-reentrant=true, is-synchronous=true, call-type=REGULAR, execution-context=UNSPECIFIED  # This service requests transmission of data via TCP to a remote node. The transmission of the data is decoupled. | The service triggers internal API call to the rba_EthTcp submodule.
      return type ReturnValue: direction=OUT, implementation-data-type=Std_ReturnType  # E_OK is returned, if service is accepted. Otherwise E_NOT_OK is returned.
      4 x sw service arg, all with direction=IN:
        SocketId: implementation-data-type=TcpIp_SocketIdType  # Specifies the socket number of the local socket resource.
        DataPtr: category=DATA_REFERENCE, sw-pointer-target-props={target-category=VALUE, implementation-data-type=uint8, sw-impl-policy=CONST}  # Pointer to a linear buffer of TotalLength bytes containing the data to be transmitted.
        AvailableLength: implementation-data-type=uint32  # Available data for transmission in bytes.
        ForceRetrieve: implementation-data-type=boolean  # Indicates how the TCP/IP stack retrieves data from SoAd, if DataPtr is a NULL_PTR.
    TcpIp_TcpReceived: is-reentrant=true, is-synchronous=false, call-type=REGULAR, execution-context=UNSPECIFIED  # By this service the reception of socket data is confirmed to the TCP/IP stack. | The service triggers internal API call to the rba_EthTcp submodule.
      return type ReturnValue: direction=OUT, implementation-data-type=Std_ReturnType  # E_OK is returned, if service is accepted. Otherwise E_NOT_OK is returned.
      sw service arg SocketId: direction=IN, implementation-data-type=TcpIp_SocketIdType  # Specifies the socket number of the local socket resource.
      sw service arg Length: direction=IN, implementation-data-type=uint16  # Number of bytes finally consumed by the upper layer.
    TcpIp_TcpConnect: is-reentrant=true, is-synchronous=false, call-type=REGULAR, execution-context=UNSPECIFIED  # By this API service the TCP/IP stack is requested to establish a TCP connection to the configured peer. | The service triggers internal API call to the rba_EthTcp submodule.
      return type ReturnValue: direction=OUT, implementation-data-type=Std_ReturnType  # E_OK is returned, if service is accepted. Otherwise E_NOT_OK is returned.
      sw service arg SocketId: direction=IN, implementation-data-type=TcpIp_SocketIdType  # Specifies the socket number of the local socket resource.
      sw service arg RemoteAddrPtr: category=DATA_REFERENCE, direction=IN, sw-pointer-target-props={target-category=STRUCTURE, implementation-data-type=TcpIp_SockAddrType, sw-impl-policy=CONST}  # Pointer to IP address and port of the remote host to connect to.
    TcpIp_TcpListen: is-reentrant=true, is-synchronous=false, call-type=REGULAR, execution-context=UNSPECIFIED  # By this service the TCP/IP stack is requested to listen on the TCP socket specified by the socket identifier. | The service triggers internal API call to the rba_EthTcp submodule.
      return type ReturnValue: direction=OUT, implementation-data-type=Std_ReturnType  # E_OK is returned, if service is accepted. Otherwise E_NOT_OK is returned.
      sw service arg SocketId: direction=IN, implementation-data-type=TcpIp_SocketIdType  # Specifies the socket number of the local socket resource.
      sw service arg MaxChannels: direction=IN, implementation-data-type=uint16  # Maximum number of new parallel connections established on this listen connection.
    TcpIp_IcmpTransmit: is-reentrant=false, is-synchronous=true, call-type=REGULAR, execution-context=UNSPECIFIED  # By this API service the TCP/IP stack sends an ICMP message according to the specified parameters. | The service triggers internal API call to the rba_EthIcmp submodule.
      return type ReturnValue: direction=OUT, implementation-data-type=Std_ReturnType  # E_OK is returned, if ICMP message is transmitted successfully. Otherwise E_NOT_OK is returned.
      7 x sw service arg, all with direction=IN:
        LocalIpAddrId: implementation-data-type=TcpIp_LocalAddrIdType  # IP address identifier representing the local IP address and EthIf controller, which shall be used for transmission of the ICMP message.
        RemoteAddrPtr: category=DATA_REFERENCE, sw-pointer-target-props={target-category=STRUCTURE, implementation-data-type=TcpIp_SockAddrType, sw-impl-policy=CONST}  # Pointer to structure representing the remote address.
        Ttl: implementation-data-type=uint8  # Time to live value to be used for the ICMP message.
        Type: implementation-data-type=uint8  # Type field value to be used in the ICMP message.
        Code: implementation-data-type=uint8  # Code field value to be used in the ICMP message.
        DataLength: implementation-data-type=uint16  # Length of ICMP message.
        DataPtr: category=DATA_REFERENCE, sw-pointer-target-props={target-category=VALUE, implementation-data-type=uint8, sw-impl-policy=CONST}  # Pointer to data which shall be sent as ICMP message data.
    TcpIp_ReadArpTable: is-reentrant=false, is-synchronous=true, call-type=REGULAR, execution-context=UNSPECIFIED  # This API is used by the upper layer to read out the Arp table for the EthIfCrtl, which is indirectly specified by the LocalAddrId. | The service triggers internal API call to the rba_EthArp submodule.
      return type ReturnValue: direction=OUT, implementation-data-type=Std_ReturnType  # Returns E_OK, if service is accepted. Otherwise E_NOT_OK is returned.
      sw service arg LocalAddrId_u8: direction=IN, implementation-data-type=TcpIp_LocalAddrIdType  # IP address identifier EthIf controller for which Arp table shall be returned.
      sw service arg ArpTable_cpu8: category=DATA_REFERENCE, direction=OUT, sw-impl-policy=CONST, sw-pointer-target-props={target-category=VALUE, implementation-data-type=uint8}  # Pointer to first element of array, which contains the ARP table per EthIfCtrl indirectly specified by LocalAddrId.
      sw service arg NumberEntries_cpu16: category=DATA_REFERENCE, direction=INOUT, sw-impl-policy=CONST, sw-pointer-target-props={target-category=VALUE, implementation-data-type=uint16}  # Number of Arp table entries. As input parameter specifies the number of Arp table entries to be read (size of the provided buffer ArpTable_pu8 in entries). As output parameter contains the number of the returned Arp table entries.
    TcpIp_ChangeParameter: is-reentrant=true, is-synchronous=true, call-type=REGULAR, execution-context=UNSPECIFIED  # By this API service the TCP/IP stack is requested to change a parameter of a socket.
      return type ReturnValue: direction=OUT, implementation-data-type=Std_ReturnType  # Returns E_OK, if parameter change is successful. Otherwise E_NOT_OK is returned.
      sw service arg SocketId: direction=IN, implementation-data-type=TcpIp_SocketIdType  # Specifies the socket number of the local socket resource.
      sw service arg ParameterId: direction=IN, implementation-data-type=TcpIp_ParamIdType  # Identifier of the parameter to be changed.
      sw service arg ParameterValue: category=DATA_REFERENCE, direction=IN, sw-pointer-target-props={target-category=VALUE, implementation-data-type=uint8, sw-impl-policy=CONST}  # Pointer to memory containing the new parameter value.
    TcpIp_RequestIpAddrAssignment: is-reentrant=false, is-synchronous=false, call-type=REGULAR, execution-context=UNSPECIFIED  # By this API service the local IP address assignment for the IP address specified by LocalAddrId shall be initiated.
      return type ReturnValue: direction=OUT, implementation-data-type=Std_ReturnType  # Returns E_OK, if the request has been accepted. Otherwise E_NOT_OK is returned.
      5 x sw service arg, all with direction=IN:
        LocalAddrId: implementation-data-type=TcpIp_LocalAddrIdType  # IP address index specifying the IP address for which an assignment shall be initiated.
        Type: implementation-data-type=TcpIp_IpAddrAssignmentType  # Type of IP address assignment which shall be initiated.
        LocalIpAddrPtr: category=DATA_REFERENCE, sw-pointer-target-props={target-category=VALUE, implementation-data-type=TcpIp_SockAddrType, sw-impl-policy=CONST}  # Pointer to structure containing the IP address, which shall be assigned to EthIf controller indirectly specified via LocalAddrId. Note: This parameter is only used in case the parameters Type is set to TCPIP_IPADDR_ASSIGNMENT_STATIC.
        Netmask: implementation-data-type=uint8  # Network mask of IPv4 address or address prefix of IPv6 address in CIDR Notation. Note: This parameter is only used in case the parameter Type is set to TCPIP_IPADDR_ASSIGNMENT_STATIC.
        DefaultRouterPtr: category=DATA_REFERENCE, sw-pointer-target-props={target-category=VALUE, implementation-data-type=TcpIp_SockAddrType, sw-impl-policy=CONST}  # Pointer to structure containing the IP address of the default router (gateway) which shall be assigned. Note: This parameter is only used in case the parameter Type is set to TCPIP_IPADDR_ASSIGNMENT_STATIC, can be set to NULL_PTR otherwise.
    TcpIp_ReleaseIpAddrAssignment: is-reentrant=false, is-synchronous=false, call-type=REGULAR, execution-context=UNSPECIFIED  # By this API service all local IP addresses assigned to the LocalAddrId shall be released.
      return type ReturnValue: direction=OUT, implementation-data-type=Std_ReturnType  # Returns E_OK, if request has been accepted. Otherwise E_NOT_OK is returned.
      sw service arg LocalAddrId: direction=IN, implementation-data-type=TcpIp_LocalAddrIdType, sw-impl-policy=CONST  # IP address index specifying the IP address for which an assignment shall be released.
    TcpIp_GetIpAddr: is-reentrant=true, is-synchronous=true, call-type=REGULAR, execution-context=UNSPECIFIED  # Obtains the local IP address, netmask and default router actually used by LocalAddrId.
      return type ReturnValue: direction=OUT, implementation-data-type=Std_ReturnType  # E_OK: The request has been accepted. E_NOT_OK: The request has not been accepted.
      4 x sw service arg:
        LocalAddrId: direction=IN, implementation-data-type=TcpIp_LocalAddrIdType  # Local address identifier referring to the local IP address which shall be obtained.
        IpAddrPtr: category=DATA_REFERENCE, direction=OUT, sw-pointer-target-props={target-category=VALUE, implementation-data-type=TcpIp_SockAddrType}  # Pointer to a structure where the IP address is stored. Structure members not related to the IP address are of arbitrary value and shall not be used.
        NetmaskPtr: category=DATA_REFERENCE, direction=OUT, sw-pointer-target-props={target-category=VALUE, implementation-data-type=uint8}  # Pointer to memory where Network mask of IPv4 address or address prefix of IPv6 address in CIDR Notation is stored.
        DefaultRouterPtr: category=DATA_REFERENCE, direction=OUT, sw-pointer-target-props={target-category=VALUE, implementation-data-type=TcpIp_SockAddrType}  # Pointer to structure where the IP address of the default router (gateway) is stored (structure member 'port' is not used and of arbitrary value).
    TcpIp_GetPhysAddr: is-reentrant=true, is-synchronous=true, call-type=REGULAR, execution-context=UNSPECIFIED  # Obtains the physical source address used by the EthIf controller implicitly specified via LocalAddrId.
      return type ReturnValue: direction=OUT, implementation-data-type=Std_ReturnType  # E_OK: The request has been accepted. E_NOT_OK: The request was not successful.
      sw service arg LocalAddrId: direction=IN, implementation-data-type=TcpIp_LocalAddrIdType  # Local address identifier implicitly specifying the EthIf controller for which the physical address shall be obtained.
      sw service arg PhysAddrPtr: category=DATA_REFERENCE, direction=OUT, sw-pointer-target-props={target-category=VALUE, implementation-data-type=uint8}  # Pointer to the memory where the physical source address (MAC address) in network byte order is stored.
    TcpIp_GetCtrlIdx: is-reentrant=true, is-synchronous=true, call-type=REGULAR, execution-context=UNSPECIFIED  # API returns the index of the Ethernet Interface controller related to LocalAddrId.
      return type ReturnValue: direction=OUT, implementation-data-type=Std_ReturnType  # E_OK: The request was successful. E_NOT_OK: The request was not successful.
      sw service arg LocalAddrId: direction=IN, implementation-data-type=TcpIp_LocalAddrIdType  # Local address identifier implicitly specifying the EthIf controller that shall be returned.
      sw service arg CtrlIdxPtr: category=DATA_REFERENCE, direction=OUT, sw-pointer-target-props={target-category=VALUE, implementation-data-type=uint32}  # Pointer to the memory where the index of the controller related to LocalAddrId is stored.
    TcpIp_GetAndResetMeasurementData: is-reentrant=true, is-synchronous=true, call-type=REGULAR, execution-context=UNSPECIFIED  # With this API service the TCP/IP stack can read/reset the diagnostic measurement data.
      return type ReturnValue: direction=OUT, implementation-data-type=Std_ReturnType  # E_OK: The request was successful. E_NOT_OK: The request was not successful.
      sw service arg MeasurementIdx: direction=IN, implementation-data-type=TcpIp_MeasurementIdxType  # Data index of measurement data.
      sw service arg MeasurementResetNeeded: direction=IN, implementation-data-type=boolean  # Flag to trigger a reset of the measurement data.
      sw service arg MeasurementDataPtr: category=DATA_REFERENCE, direction=OUT, sw-pointer-target-props={target-category=VALUE, implementation-data-type=uint32}  # Reference to data buffer, where to copy measurement data.
    TcpIp_ZeroCopyUdpTransmit: is-reentrant=false, is-synchronous=true, call-type=REGULAR, execution-context=UNSPECIFIED  # This service transmits data via UDP ZeroCopy API to a remote node. The transmission of the data is immediately performed within this function call.
      return type ReturnValue: direction=OUT, implementation-data-type=TcpIp_ReturnType  # Returns TCPIP_OK if UDP datagram transmission successful. Returns TCPIP_E_NOT_OK if UDP datagram transmission failed (general failure). Returns TCPIP_E_ARP_CACHE_MISS if UDP datagram transmission failed because of ARP cache miss.
      6 x sw service arg:
        SocketId_u16: direction=IN, implementation-data-type=TcpIp_SocketIdType  # Socket identifier of the related local socket resource.
        ZeroCopyData_pcst: category=DATA_REFERENCE, direction=IN, sw-pointer-target-props={target-category=VALUE, implementation-data-type=Eth_ZeroCopyTxDataInfo_tst, sw-impl-policy=CONST}  # Structure containing the ZeroCopy UL data to be transmitted.
        RemoteAddr_pcst: category=DATA_REFERENCE, direction=IN, sw-pointer-target-props={target-category=VALUE, implementation-data-type=TcpIp_SockAddrType, sw-impl-policy=CONST}  # IP address and port of the remote host to transmit to.
        TxConfFlag_b: direction=IN, implementation-data-type=boolean  # Flag indicating if TxConf need to be monitored (if TRUE, TxId will be returned in out argument).
        ConnChanged_b: direction=IN, implementation-data-type=boolean  # Flag indicating if the connection parameters have changed (new Reuse header will be allocated).
        TxId_pu32: category=DATA_REFERENCE, direction=OUT, sw-pointer-target-props={target-category=VALUE, implementation-data-type=uint32}  # Out argument storing the TxId (valid only if TxConfFlag_b is set to TRUE).
    TcpIp_ZeroCopyReset: is-reentrant=false, is-synchronous=true, call-type=REGULAR, execution-context=UNSPECIFIED  # This function reset all ZeroCopy structures for a particular socket.
      sw service arg SocketId_u16: direction=IN, implementation-data-type=TcpIp_SocketIdType  # Socket id for which the ZeroCopy structures need to be cleared.
    TcpIp_DhcpWriteOption: is-reentrant=false, is-synchronous=true, call-type=REGULAR, execution-context=UNSPECIFIED  # By this API service the TCP/IP stack writes the DHCP option data identified by parameter option.
      return type ReturnValue: direction=OUT, implementation-data-type=Std_ReturnType  # Result of operation E_OK no error occurred. E_NOT_OK: DHCP option data could not be written.
      4 x sw service arg, all with direction=IN:
        LocalIpAddrId: implementation-data-type=TcpIp_LocalAddrIdType  # IP address identifier representing the local IP address and EthIf controller for which the DHCP option shall be written.
        Option: implementation-data-type=uint8  # DHCP option, e.g. Host Name.
        DataLength: implementation-data-type=uint8  # Length of DHCP option data.
        DataPtr: category=DATA_REFERENCE, sw-pointer-target-props={target-category=VALUE, implementation-data-type=uint8, sw-impl-policy=CONST}  # Pointer to memory containing DHCP option data.
    TcpIp_DhcpReadOption: is-reentrant=false, is-synchronous=true, call-type=REGULAR, execution-context=UNSPECIFIED  # By this API service the TCP/IP stack retrieves DHCP option data identified by parameter option for already received DHCP options.
      return type ReturnValue: direction=OUT, implementation-data-type=Std_ReturnType  # E_OK is returned, if service is accepted. Otherwise E_NOT_OK is returned.
      4 x sw service arg:
        LocalIpAddrId: direction=IN, implementation-data-type=TcpIp_LocalAddrIdType  # IP address identifier representing the local IP address and EthIf controller for which the DHCP option shall be read.
        Option: direction=IN, implementation-data-type=uint8  # DHCP option, e.g. Host Name.
        DataLength: category=DATA_REFERENCE, direction=INOUT, sw-pointer-target-props={target-category=VALUE, implementation-data-type=uint8}  # As input parameter, contains the length of the provided data buffer. Will be overwritten with the length of the actual data.
        DataPtr: category=DATA_REFERENCE, direction=OUT, sw-pointer-target-props={target-category=VALUE, implementation-data-type=uint8}  # Pointer to memory containing DHCP option data.
    TcpIp_AllocBaseIpAddr: is-reentrant=true, is-synchronous=true, call-type=REGULAR, execution-context=UNSPECIFIED  # This API is the interface for the upper layer to provide the Base IP Address to be used for the AutoIp IP address assignment. | This API can be used by SoAd to provide the Base IP Address stored in the NVM to the rba_EthAutoIp module.
      return type ReturnValue: direction=OUT, implementation-data-type=Std_ReturnType  # Result of operation E_OK - Request processed successfully. E_NOT_OK - Request NOT processed successfully.
      sw service arg LocalAddrId_u8: direction=IN, implementation-data-type=TcpIp_LocalAddrIdType  # Local address id reference to IPv4 address configuration and EthIf controller index.
      sw service arg IpAddrAsgnMethType_en: direction=IN, implementation-data-type=TcpIp_IpAddrAssignmentType  # Address assignment method (Static/DHCP/AutoIp) used by this LocalAddrId.
      sw service arg LocalIpAddr_pst: category=DATA_REFERENCE, direction=IN, sw-pointer-target-props={target-category=STRUCTURE, implementation-data-type=TcpIp_SockAddrType, sw-impl-policy=CONST}  # Pointer holding the BaseIp address to be used by the AutoIp.
    TcpIp_RequestComMode: is-reentrant=false, is-synchronous=false, call-type=REGULAR, execution-context=UNSPECIFIED  # By this API service the TCP/IP stack is requested to change the TcpIp state of the communication network identified by EthIf controller index.
      return type ReturnValue: direction=OUT, implementation-data-type=Std_ReturnType  # E_OK: The request has been accepted. E_NOT_OK: The request was not successful.
      sw service arg CtrlIdx: direction=IN, implementation-data-type=uint8  # EthIf controller index to identify the communication network where the TcpIp state is requested.
      sw service arg State: direction=IN, implementation-data-type=TcpIp_StateType  # Requested TcpIp state.
package /AUTOSAR_TcpIp/ImplementationDataTypes
  30 x impl type, all with type-emitter=HEADER_FILE:
    TcpIp_StateType: compu {1=TCPIP_STATE_ONLINE (TCP/IP stack state for a specific EthIf controller is ONLINE, i.e. communication via at least one IP address is possible.), 2=TCPIP_STATE_ONHOLD (TCP/IP stack state for a specific EthIf controller is ONHOLD, i.e. no communication is currently possible (e.g. link down).), 3=TCPIP_STATE_OFFLINE (TCP/IP stack state for a specific EthIf controller is OFFLINE, i.e. no communication is possible.), 4=TCPIP_STATE_STARTUP (TCP/IP stack state for a specific EthIf controller is STARTUP, i.e. IP address assignment in progress or ready for manual start, communication is currently not possible.), 5=TCPIP_STATE_SHUTDOWN (TCP/IP stack state for a specific EthIf controller is SHUTDOWN, i.e. release of resources using the EthIf controller, release of IP address assignment.)}, implementation-data-type=uint8  # Type specifying the TcpIp state for a specific EthIf controller. | Specifies the TcpIp state for a specific EthIf controller.
    TcpIp_ProtocolType: compu {0=TCPIP_IPPROTO_NONE (Initial value.), 1=TCPIP_IPPROTO_ICMP (ICMP protocol.), 6=TCPIP_IPPROTO_TCP (TCP protocol.), 17=TCPIP_IPPROTO_UDP (UDP protocol.), 58=TCPIP_IPPROTO_ICMPV6 (Icmpv6 protocol.)}, implementation-data-type=uint8  # Protocol type used by a socket.
    TcpIp_AddressType: compu {0=TCPIP_NONE (For initialization), 1=TCPIP_UNICAST (IP Unicast), 2=TCPIP_MULTICAST (IP Multicast), 3=TCPIP_BROADCAST (IP Broadcast)}, implementation-data-type=uint8  # IP address type.
    TcpIp_IpAddrStateType: compu {0=TCPIP_IPADDR_STATE_INIT (Local IP address state is in Init state. Required for TcpIp_Init().), 1=TCPIP_IPADDR_STATE_ASSIGNED (Local IP address is assigned), 2=TCPIP_IPADDR_STATE_ONHOLD (Local IP address is assigned, but cannot be used as the network is not active.), 3=TCPIP_IPADDR_STATE_UNASSIGNED (Local IP address is unassigned.)}, implementation-data-type=uint8  # Specifies the state of local IP address assignment.
    TcpIp_DadStateType_ten: compu {0=TCPIP_DAD_FAIL (Duplicate IP address was found by the Duplicate Address Detection(DAD) algorithm.)}, implementation-data-type=uint8  # Duplicate Address Detection status.
    TcpIp_EventType: compu {1=TCPIP_TCP_RESET (TCP connection was reset, TCP socket and all related resources have been released.), 2=TCPIP_TCP_CLOSED (TCP connection was closed successfully, TCP socket and all related resources have been released.), 3=TCPIP_TCP_FIN_RECEIVED (A FIN signal was received on the TCP connection, TCP socket is still valid.), 4=TCPIP_UDP_CLOSED (UDP socket and all related resources have been released.), 5=TCPIP_TLS_HANDSHAKE_SUCCEEDED (TLS handshake successfully established, TLS connection available.), 254=TCPIP_TLS_HANDSHAKE_INITIATED (TLS hanshake is initiated in Remote node and is in progress.)}, implementation-data-type=uint8  # Events reported by TcpIp.
    TcpIp_IpAddrAssignmentType: compu {0=TCPIP_IPADDR_ASSIGNMENT_INVALID (Invalid value for initialization.), 1=TCPIP_IPADDR_ASSIGNMENT_STATIC (Static address assignment.), 2=TCPIP_IPADDR_ASSIGNMENT_LINKLOCAL_DOIP (Linklocal address assignment using DoIp parameters.), 3=TCPIP_IPADDR_ASSIGNMENT_DHCP (Address assignment via DHCP.), 4=TCPIP_IPADDR_ASSIGNMENT_LINKLOCAL (Linklocal address assignment.), 5=TCPIP_IPADDR_ASSIGNMENT_IPV6_ROUTER (Dynamic configured IPv4/IPv6 address by Router Advertisement.), 6=TCPIP_IPADDR_ASSIGNMENT_ALL (All configured TcpIp-AssignmentMethods with TcpIpAssignmentTrigger set to TCPIP_MANUAL)}, implementation-data-type=uint8  # Specification of IP address assignment policy.
    TcpIp_ReturnType: compu {0=TCPIP_OK (Operation completed successfully.), 1=TCPIP_E_NOT_OK (Operation failed.), 2=TCPIP_E_ARP_CACHE_MISS (Operation failed because of an ARP cache miss.)}, implementation-data-type=uint8  # TcpIp specific return type.
    TcpIp_ParamIdType: compu {0=TCPIP_PARAMID_TCP_RXWND_MAX (Specifies the maximum TCP receive window for the socket.), 1=TCPIP_PARAMID_FRAMEPRIO (Specifies the frame priority for outgoing frames on the socket.), 2=TCPIP_PARAMID_TCP_NAGLE (Specifies if the Nagle Algorithm according to IETF RFC 896 is enabled or not.), 3=TCPIP_PARAMID_TCP_KEEPALIVE (Specifies if TCP Keep Alive Probes are sent on the socket connection.), 4=TCPIP_PARAMID_TTL (Specifies the time to live value for outgoing frames on the socket.), 5=TCPIP_PARAMID_TCP_KEEPALIVE_TIME (Specifies the time in [s] between the last data packet sent (simple ACKs are not considered data) and the first Keep Alive probe.), 6=TCPIP_PARAMID_TCP_KEEPALIVE_PROBES_MAX (Specifies the number of Keep alive Probes allowed on the socket connection.), 7=TCPIP_PARAMID_TCP_KEEPALIVE_INTERVAL (Specifies the interval in [s] between subsequent Keep alive probes.), 10=TCPIP_PARAMID_FLOWLABEL (Specifies the 20-bit Flow Label according to IETF RFC 6437.), 11=TCPIP_PARAMID_DSCP (Specifies the 6-bit Differentiated Service Code Point according to IETF RFC 2474.), 13=TCPIP_PARAMID_TLS_CONNECTION_ASSIGNMENT (Specifies the TLS connection reference to a TCP socket.), 12=TCPIP_PARAMID_UDP_CHECKSUM (Specifies if UDP checksum handling shall be enabled (TRUE) or disabled (FALSE) on the related socket.), 128=TCPIP_PARAMID_VENDOR_SPECIFIC (Start of vendor specific range of parameter IDs.)}, implementation-data-type=uint8  # Type for the specification of all supported Parameter IDs.
    TcpIpIpAddrWildcardType: implementation-data-type=uint32  # IP address wildcard. | IP address wildcard..
    TcpIpIp6AddrWildcardType: implementation-data-type=uint32  # IPv6 address wildcard.
    TcpIpPortWildcardType: implementation-data-type=uint16  # In case port parameter is specified as TCPIP_PORT_ANY, the TCP/IP stack shall choose the local port automatically, from the range 49152(0xC000) to 65535(0xFFFF) and shall update the parameter to the chosen value.
    TcpIpLocalAddrIdWildcardType: implementation-data-type=TcpIp_LocalAddrIdType  # LocalAddrId wildcard.
    TcpIp_DomainType: implementation-data-type=uint32  # TcpIp address families. | TcpIp address families (IPv4 or IPv6).
    TcpIp_LocalAddrIdType: implementation-data-type=uint8  # Type for unique identification number of a TcpIpLocalAddr. | Type for unique identification number of a Local AddrId.
    TcpIp_TlsConnectionIdType: implementation-data-type=uint16  # Type for unique identification number of a TcpIp_TlsConnectionId. | Type for unique identification number of a Tls connection.
    TcpIp_MeasurementIdxType: implementation-data-type=uint8  # Index to select specific measurement data.
    TcpIp_SocketIdType: implementation-data-type=uint16  # Socket identifier type for unique identification of a TcpIp stack socket.
    TcpIp_SockAddrType: category=STRUCTURE  # Generic structure used by APIs to specify an IP address. (A specific address type can be derived from this structure via a cast to the specific structure type.).
      element domain: implementation-data-type=TcpIp_DomainType  # This is the code for the address format of this address.
    TcpIp_IpHeader_tst: category=STRUCTURE
      element ProtoType_en: implementation-data-type=TcpIp_ProtocolType  # protocol type: Udp/Tcp/Icmp.
      element FlowLabel_u32: implementation-data-type=uint32  # IPv6 flow label value.
      element Ttl_u8: implementation-data-type=uint8  # time to live value.
    TcpIp_IpAddr_tun: category=UNION  # Union to store either an IPv4 address or a pointer to an IPv6 address.
      element IPv4Addr_u32: implementation-data-type=uint32  # IPv4 address.
      element IPv6Addr_pcu32: category=DATA_REFERENCE, sw-pointer-target-props={target-category=TYPE_REFERENCE, implementation-data-type=uint32, sw-impl-policy=CONST}  # Pointer to IPv6 address.
    TcpIp_PseudoHdr_tst: category=STRUCTURE  # Structure contains pseudo header information ( protocol type, local IP and Remote IP in Tx/Rx buffer) required for Udp and Tcp checksum calculation.
      6 x element, all with category=TYPE_REFERENCE:
        IpDomainType_t: implementation-data-type=TcpIp_DomainType, sw-impl-policy=CONST  # Address family.
        ProtoType_en: implementation-data-type=TcpIp_ProtocolType  # Transport layer protocol.
        LocalIpAddr_un: implementation-data-type=TcpIp_IpAddr_tun  # Refers to source IP during Tx and refers destination IP during Rx.
        RemoteIpAddr_un: implementation-data-type=TcpIp_IpAddr_tun  # Refers to destination IP during Tx and refers source IP during Rx.
        IPv4HdrLen_u8: implementation-data-type=uint8  # IPv4 header length.
        IsRxFragmented_b: implementation-data-type=boolean  # Indication from IPv4 layer to transport layer that the received frame is reassembled one.
    TcpIp_IPv6Addr_tst: category=STRUCTURE  # Structure to hold IPv6 address.
      element Addr_au32: array-size=4, array-size-semantics=FIXED-SIZE, implementation-data-type=uint32  # IPv6 address.
    TcpIp_IPv6AddrParamType_tst: category=STRUCTURE  # This type contains IPv6 address including directly related parameters. | This type contains IPv6 address including directly related parameters: default router and netmask.
      element IpAddr_st: implementation-data-type=TcpIp_IPv6Addr_tst  # IPv6 address.
      element DftRtr_st: implementation-data-type=TcpIp_IPv6Addr_tst  # IPv6 address of default router (gateway).
      element NetMask_u8: implementation-data-type=uint8  # Network mask of IPv6 address.
    TcpIp_IPv4AddrParamType_tst: category=STRUCTURE  # This type contains IPv4 address including directly related parameters. | This type contains IPv4 address including directly related parameters: default router and netmask.
      element IpAddr_u32: implementation-data-type=uint32  # IPv4 address.
      element DftRtr_u32: implementation-data-type=uint32  # IPv4 address of default router (gateway).
      element NetMask_u32: implementation-data-type=uint32  # Network mask of IPv4 address.
    TcpIp_IPAddrParamType_tun: category=UNION  # IP version specific IP address parameters storage type. | IP version specific IP address parameters storage type that includes IP address, Default router and netmask. Note: as documentation generation from BSWMD is currently not working properly, type of the structure members is mentioned in the description. Complete type description is filled additionally manually the the chapter Data types.
      element IPv6Par_st: category=VALUE, base-type=void  # IPv6 address structure of type TcpIp_IPv6AddrParamType_tst. | IPv6 address structure that includes IP address, default router and netmask.
      element IPv4Par_st: category=VALUE, base-type=void  # IPv4 address structure of type TcpIp_IPv4AddrParamType_tst. | IPv4 address structure that includes IP address, default router and netmask.
    TcpIp_SockAddrInetType: category=STRUCTURE
      element domain: implementation-data-type=TcpIp_DomainType
      element addr: array-size=1, array-size-semantics=FIXED-SIZE, implementation-data-type=uint32
      element port: implementation-data-type=uint16
    TcpIp_SockAddrInet6Type: category=STRUCTURE
      element domain: implementation-data-type=TcpIp_DomainType
      element addr: array-size=4, array-size-semantics=FIXED-SIZE, implementation-data-type=uint32
      element port: implementation-data-type=uint16
    TcpIp_LocalAddrId_EthIfCtrl_tun: category=UNION
      element LocalAddrId_u8: implementation-data-type=TcpIp_LocalAddrIdType  # Local Address Id.
      element EthIfCtrlIdx_u8: implementation-data-type=uint8  # EthIf controller index.
    TcpIp_ConfigType: category=STRUCTURE  # Configuration data structure of the TcpIp module and all TcpIp sub-modules. | Note: as documentation generation from BSWMD is currently not working properly, type of the structure members is mentioned in the description. Complete type description is filled additionally manually the the chapter Data types.
      17 x element:
        EthUdpConfig_pco: category=VALUE, base-type=void  # Pointer to configuration data structure of the UDP module of type const rba_EthUdp_Config_to *.
        EthTcpConfig_pco: category=VALUE, base-type=void  # Pointer to configuration data structure of the TCP module of type const rba_EthTcp_Config_to *.
        EthTlsConfig_pco: category=VALUE, base-type=void  # Pointer to configuration data structure of the TLS module of type const rba_EthTls_Config_to *.
        EthIPv4Config_pco: category=VALUE, base-type=void  # Pointer to configuration data structure of the IPv4 module of type const rba_EthIPv4_Config_to *.
        EthIPv6Config_pco: category=VALUE, base-type=void  # Pointer to configuration data structure of the IPv6 module of type const rba_EthIPv6_Config_to *.
        EthArpConfig_pco: category=VALUE, base-type=void  # Pointer to configuration data structure of the ARP module of type const rba_EthArp_Config_to *.
        EthAutoIpConfig_pco: category=VALUE, base-type=void  # Pointer to configuration data structure of the AutoIp module of type const rba_EthAutoIp_Config_to *.
        EthDHCPConfig_pco: category=VALUE, base-type=void  # Pointer to configuration data structure of the Dhcpv4 module of type const rba_EthDHCP_Config_to *.
        EthIcmpConfig_pco: category=VALUE, base-type=void  # Pointer to configuration data structure of the Icmpv4 module of type const rba_EthIcmp_Config_to *.
        EthLocalAddrConfig_paco: category=VALUE, base-type=void  # Pointer to configuration data structure of the local IP addresses of type const TcpIp_LocalAddrConfig_to *.
        EthIcmpV6Config_pco: category=VALUE, base-type=void  # Pointer to configuration data structure of the Icmpv6 module of type const rba_EthIcmpV6_Config_to *.
        EthDHCPv6Config_pco: category=VALUE, base-type=void  # Pointer to configuration data structure of the Dhcpv6 module of type const rba_EthDHCPv6_Config_to *.
        EthNdpConfig_pco: category=VALUE, base-type=void  # Pointer to configuration data structure of the NDP module of type const rba_EthNdp_Config_to *.
        NumLocalAddrConfig_u8: implementation-data-type=uint8, sw-impl-policy=CONST  # Number of localAddress configured and internally generated by TcpIp for IPv6 TcpIpCtrls ( link local and all node multicast).
        NumLocalAddrUserConfigured_u8: implementation-data-type=uint8, sw-impl-policy=CONST  # Number of localAddress manually configured by the user.
        SockOwnerConfig_pacst: category=VALUE, base-type=void  # Pointer to configuration data structure containing upper layer callback function pointers of type const TcpIp_SockOwnerConfig_tst *.
        NumSockOwners_cu8: implementation-data-type=uint8, sw-impl-policy=CONST  # Number of upper layers to TcpIp configured.
