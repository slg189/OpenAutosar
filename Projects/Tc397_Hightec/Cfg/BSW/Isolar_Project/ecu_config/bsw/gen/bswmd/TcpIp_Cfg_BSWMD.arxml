AUTOSAR XML (schema 4-2-2)
package /AUTOSAR_TcpIp/ApplicationDataTypes
  application array data type TcpIp_StateType_au8_app: category=ARRAY, sw-calibration-access=READ-WRITE  # Array of TcpIp State Type
    element TcpIp_Array_Element_of_StateType: category=VALUE, type=TcpIp_StateType_Enum, max-number-of-elements=1
  app type TcpIp_StateType_Enum: category=VALUE, sw-calibration-access=READ-WRITE, compu {1=TCPIP_STATE_ONLINE, 2=TCPIP_STATE_ONHOLD, 3=TCPIP_STATE_OFFLINE, 4=TCPIP_STATE_STARTUP, 5=TCPIP_STATE_SHUTDOWN} "Enumeration for TcpIp State Type", range phys 0..255, display-format=%5.0f  # Enum for TcpIp State type
package /AUTOSAR_TcpIp/BswImplementations
  bsw implementation TcpIp: programming-language=C, sw-version=10.0.0, ar-release-version=4.2.2, behavior=BswInternalBehavior
    code-descriptors:
      code CodeDescriptor: artifact-descriptors=autosar-engineering-object={short-label=ArEngObj, category=SWSRC}
    resource consumption TcpIp_ResourceConsumption
      18 x memory section:
        TCPIP_CONST_8: alignment=8, prefix=TCPIP, sw-addrmethod=CONST, symbol=CONST_8
        TCPIP_CONST_16: alignment=16, prefix=TCPIP, sw-addrmethod=CONST, symbol=CONST_16
        TCPIP_CONST_32: alignment=32, prefix=TCPIP, sw-addrmethod=CONST, symbol=CONST_32
        TCPIP_CONST_UNSPECIFIED: alignment=UNSPECIFIED, prefix=TCPIP, sw-addrmethod=CONST, symbol=CONST_UNSPECIFIED
        TCPIP_VAR_CLEARED_8: alignment=8, prefix=TCPIP, sw-addrmethod=VAR_CLEARED, symbol=VAR_CLEARED_8
        TCPIP_VAR_CLEARED_16: alignment=16, prefix=TCPIP, sw-addrmethod=VAR_CLEARED, symbol=VAR_CLEARED_16
        TCPIP_VAR_CLEARED_32: alignment=32, prefix=TCPIP, sw-addrmethod=VAR_CLEARED, symbol=VAR_CLEARED_32
        TCPIP_VAR_CLEARED_UNSPECIFIED: alignment=UNSPECIFIED, prefix=TCPIP, sw-addrmethod=VAR_CLEARED, symbol=VAR_CLEARED_UNSPECIFIED
        TCPIP_CALLOUT_CODE: prefix=TCPIP, sw-addrmethod=CALLOUT_CODE, symbol=CALLOUT_CODE
        TCPIP_VAR_INIT_8: alignment=8, prefix=TCPIP, sw-addrmethod=VAR_INIT, symbol=VAR_INIT_8
        TCPIP_VAR_INIT_16: alignment=16, prefix=TCPIP, sw-addrmethod=VAR_INIT, symbol=VAR_INIT_16
        TCPIP_VAR_INIT_32: alignment=32, prefix=TCPIP, sw-addrmethod=VAR_INIT, symbol=VAR_INIT_32
        TCPIP_VAR_INIT_UNSPECIFIED: alignment=UNSPECIFIED, prefix=TCPIP, sw-addrmethod=VAR_INIT, symbol=VAR_INIT_UNSPECIFIED
        TcpIp_CODE: prefix=TcpIp, sw-addrmethod=CODE, symbol=CODE
        TCPIP_CODE: prefix=TCPIP, sw-addrmethod=CODE, symbol=CODE
        TCPIP_VAR_FAST_INIT_UNSPECIFIED: alignment=UNSPECIFIED, prefix=TCPIP, sw-addrmethod=VAR_FAST_INIT, symbol=VAR_FAST_INIT_UNSPECIFIED
        TCPIP_CODE_FAST: prefix=TCPIP, sw-addrmethod=CODE_FAST, symbol=CODE_FAST
        TCPIP_CONFIG_DATA_POSTBUILD_UNSPECIFIED: alignment=UNSPECIFIED, prefix=TCPIP, sw-addrmethod=CONFIG_DATA_POSTBUILD, symbol=CONFIG_DATA_POSTBUILD_UNSPECIFIED
      section name prefix TcpIp
      section name prefix TCPIP
package /AUTOSAR_TcpIp/BswModuleDescriptions
  bsw module description TcpIp
    bsw internal behavior BswInternalBehavior: data-type-mapping=DataTypeMappingSet
      static-memorys:
        data TcpIp_EthIfCtrlSt_aen: category=ARRAY, sw-addr-method=INTERNAL_VAR_CLEARED, sw-calibration-access=READ-ONLY, display-format=%5.1f, type=TcpIp_StateType_au8_app  # Gives Information about TCP/IP stack state for a specific EthIf controller (TCPIP_STATE_ONLINE i.e. communication via at least one IP address is possible, TCPIP_STATE_ONHOLD i.e. no communication is currently possible (e.g. link down), TCPIP_STATE_OFFLINE i.e. no communication is possible, TCPIP_STATE_STARTUP i.e. IP address assignment in progress or ready for manual start communication is currently not possible, TCPIP_STATE_SHUTDOWN i.e. release of resources using the EthIf controller, release of IP address assignment.)
      bsw schedulable entity SE_MainFunction: implemented-entry=TcpIp_MainFunction
      bsw timing event EV_SE_MainFunction: starts-on-event=SE_MainFunction, period=0.001
package /AUTOSAR_TcpIp/DataTypeMappingSets
  data type mapping set DataTypeMappingSet
    data-type-maps:
      application-data-type=TcpIp_StateType_au8_app, implementation-data-type=TcpIp_StateType_au8_impl
      application-data-type=TcpIp_StateType_Enum, implementation-data-type=TcpIp_StateType_Enum_impl
package /AUTOSAR_TcpIp/ImplementationDataTypes
  impl type TcpIp_StateType_au8_impl: category=ARRAY  # Array of StateType
    element TcpIp_Array_Element_of_StateType: array-size=1, array-size-semantics=FIXED-SIZE, implementation-data-type=TcpIp_StateType_Enum_impl
  impl type TcpIp_StateType_Enum_impl: implementation-data-type=uint8  # Enumeration for TcpIp State Type
package /AUTOSAR_TcpIp/Units
  unit NoUnit: display-name=noUnit, factor-si-to-unit=1.0, offset-si-to-unit=0.0, physical-dimension=NoUnit  # No Unit
package /AUTOSAR_TcpIp/PhysicalDimensions
  physical dimension NoUnit: length-exp=0
