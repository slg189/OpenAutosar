AUTOSAR XML (schema 4-3-0)
package /AUTOSAR_TcpIp/TimingExtensions
  bsw module timing TcpIp: behavior=BswInternalBehavior
    timing-descriptions:
      td event bsw internal behavior EOC_T_xxms: bsw-module-entity=SE_MainFunction
      td event bsw module EOC_TcpIp_Init: bsw-module-description=TcpIp, bsw-module-entry=TcpIp_Init, td-event-bsw-module-type=BSW-M-ENTRY-CALLED
    timing-requirements:
      execution order constraint EOC_T_xxms: execution-order-constraint-type=ORDINARY-EOC, is-event=true, permit-multiple-references-to-ee=false
        ordered-elements:
          eoc event ref EOCEventRef_TcpIp_1: bsw-module-instance=TcpIp, event=EV_SE_MainFunction, successor=EOCEventRef_EthIf_Tx_1
