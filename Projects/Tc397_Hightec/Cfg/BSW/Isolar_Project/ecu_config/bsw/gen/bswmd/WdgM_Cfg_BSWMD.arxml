AUTOSAR XML (schema 4-2-2)
package /AUTOSAR_WdgM/ModeDeclarationGroups
  mode declaration group WdgMSupervisionCycle: category=ALPHABETIC_ORDER, initial-mode=SUPERVISION_CYCLE_0
    mode SUPERVISION_CYCLE_0
  data type mapping set WdgM_ModeRequestTypeMap: mode-request-type-map{implementation-data-type=uint8, mode-group=WdgMSupervisionCycle}
package /AUTOSAR_WdgM/BswModuleEntry
  10 x bsw module entry, all with execution-context=TASK, sw-service-impl-policy=STANDARD:
    WdgM_Init: service-id=0, is-reentrant=false, is-synchronous=true, call-type=REGULAR  # Initializes the Watchdog Manager | This function initializes the Watchdog Manager. After execution of this function, supervision is activated according to the list of supervised Entities defined in the Initial Mode.
      sw service arg ConfigPtr: category=DATA_REFERENCE, direction=IN, sw-pointer-target-props={target-category=STRUCTURE, implementation-data-type=WdgM_ConfigType, sw-impl-policy=CONST}  # (In)Pointer to post-build configuration data. This parameter is not relevant for Pre-compile configuration. "NULL_PTR" can be passed in case of Pre-compile configuration.
    WdgM_DeInit: service-id=1, is-reentrant=false, is-synchronous=true, call-type=REGULAR  # Deinitialize the Watchdog manager module. | De-Initializes the Watchdog Manager if the WdgM Global status is OK.
    WdgM_SetMode: service-id=3, is-reentrant=false, is-synchronous=true, call-type=REGULAR  # Sets the mode of Watchdog Manager. | Service to switch between different modes of the Watchdog Manager.
      return type ReturnValue: direction=OUT, implementation-data-type=Std_ReturnType  # E_OK: Successfully changed to the new mode. E_NOT_OK: Changing to the new mode failed.
      sw service arg Mode: direction=IN, implementation-data-type=WdgM_ModeType  # (In)One of the configured Watchdog Manager modes.
    WdgM_GetMode: service-id=11, is-reentrant=true, is-synchronous=true, call-type=REGULAR  # Returns the current mode of the Watchdog Manager. | The WdgM_GetMode service returns the currently active mode of the Watchdog Manager.
      return type ReturnValue: direction=OUT, implementation-data-type=Std_ReturnType  # E_OK: Current mode successfully returned. E_NOT_OK: Returning mode failed.
      sw service arg Mode: category=DATA_REFERENCE, direction=OUT, sw-pointer-target-props={target-category=STRUCTURE, implementation-data-type=WdgM_ModeType}  # (Out)Current mode of the Watchdog Manager.
    WdgM_CheckpointReached: service-id=14, is-reentrant=true, is-synchronous=true, call-type=REGULAR  # Indicates to the Watchdog Manager that a Checkpoint within a Supervised Entity has been reached.
      return type ReturnValue: direction=OUT, implementation-data-type=Std_ReturnType  # E_OK: Successfully updated alive counter. E_NOT_OK: Update failed.
      sw service arg SEID: direction=IN, implementation-data-type=WdgM_SupervisedEntityIdType  # (In)Identifier of the Supervised Entity that reports a Checkpoint.
      sw service arg CheckpointID: direction=IN, implementation-data-type=WdgM_CheckpointIdType  # (In)Identifier of the Checkpoint within a Supervised Entity that has been reached.
    WdgM_GetLocalStatus: service-id=12, is-reentrant=true, is-synchronous=true, call-type=REGULAR  # Returns the supervision status of an individual Supervised Entity. | The WdgM_GetLocalStatus service returns the individual supervision status of the given Supervised Entity.
      return type ReturnValue: direction=OUT, implementation-data-type=Std_ReturnType  # E_OK: Current supervision status successfully returned. E_NOT_OK: Returning current supervision status failed.
      sw service arg SEID: direction=IN, implementation-data-type=WdgM_SupervisedEntityIdType  # (In)Identifier of the supervised entity whose supervision status shall be returned.
      sw service arg Status: category=DATA_REFERENCE, direction=OUT, sw-pointer-target-props={target-category=STRUCTURE, implementation-data-type=WdgM_LocalStatusType}  # (Out)Supervision status of the given supervised entity.
    WdgM_GetGlobalStatus: service-id=13, is-reentrant=true, is-synchronous=true, call-type=REGULAR  # Returns the Global supervision status of the Watchdog Manager. | The WdgM_GetGlobalStatus service returns the Global supervision status of the Watchdog Manager.
      return type ReturnValue: direction=OUT, implementation-data-type=Std_ReturnType  # E_OK: Current supervision status successfully returned. E_NOT_OK: Returning current supervision status failed.
      sw service arg Status: category=DATA_REFERENCE, direction=OUT, sw-pointer-target-props={target-category=STRUCTURE, implementation-data-type=WdgM_GlobalStatusType}  # (Out)Global supervision status of the Watchdog Manager.
    WdgM_PerformReset: service-id=15, is-reentrant=false, is-synchronous=true, call-type=REGULAR  # Instructs the Watchdog Manager to cause a watchdog reset. | The WdgM_PerformReset service instructs the Watchdog Manager to cause a watchdog reset.
    WdgM_GetFirstExpiredSEID: service-id=16, is-reentrant=true, is-synchronous=true, call-type=REGULAR  # Returns SEID(ID of the Supervised Entity)that first reached the state WDGM_LOCAL_STATUS_EXPIRED. | The WdgM_GetFirstExpiredSEID service returns the ID of the Supervised Entity that first reached the state WDGM_LOCAL_STATUS_EXPIRED.
      return type ReturnValue: direction=OUT, implementation-data-type=Std_ReturnType  # E_OK: SEID successfully returned. E_NOT_OK: Error when returning the SEID.
      sw service arg SEID: category=DATA_REFERENCE, direction=OUT, sw-pointer-target-props={target-category=STRUCTURE, implementation-data-type=WdgM_SupervisedEntityIdType}  # (Out)Identifier of the supervised entity that first reached the state WDGM_LOCAL_STATUS_EXPIRED.
    WdgM_MainFunction: service-id=8, call-type=SCHEDULED  # Performs the processing of the cyclic Watchdog Manager jobs. | The WdgM_MainFunction service performs the processing of the cyclic Watchdog Manager jobs. It is responsible to perform Monitoring analysis and provide servicing information to Wdg via WdgIf.
package /AUTOSAR_WdgM/BswModuleDescriptions
  bsw module description WdgM: category=BSW_MODULE, module-id=13
    provided-entrys:
      WdgM_Init
      WdgM_DeInit
      WdgM_SetMode
      WdgM_GetMode
      WdgM_CheckpointReached
      WdgM_GetLocalStatus
      WdgM_GetGlobalStatus
      WdgM_PerformReset
      WdgM_GetFirstExpiredSEID
      WdgM_MainFunction
    provided-mode-groups:
      mode declaration group prototype WdgMSupervisionCycle: type=WdgMSupervisionCycle
    required-mode-groups:
      mode declaration group prototype Current_WdgMSupervisionCycle: type=WdgMSupervisionCycle
    bsw internal behavior BswInternalBehavior: data-type-mapping=WdgM_ModeRequestTypeMap, bsw-mode-sender-policy{provided-mode-group=WdgMSupervisionCycle, queue-length=1}
      9 x bsw called entity:
        Init: implemented-entry=WdgM_Init
        DeInit: implemented-entry=WdgM_DeInit
        SetMode: accessed-mode-groups=Current_WdgMSupervisionCycle, implemented-entry=WdgM_SetMode, managed-mode-groups=WdgMSupervisionCycle
        GetMode: implemented-entry=WdgM_GetMode
        CheckpointReached: implemented-entry=WdgM_CheckpointReached
        GetLocalStatus: implemented-entry=WdgM_GetLocalStatus
        GetGlobalStatus: implemented-entry=WdgM_GetGlobalStatus
        PerformReset: implemented-entry=WdgM_PerformReset
        GetFirstExpiredSEID: implemented-entry=WdgM_GetFirstExpiredSEID
      bsw schedulable entity MainFunction: implemented-entry=WdgM_MainFunction
      bsw timing event TE_WdgMSupervisionCycle0: starts-on-event=MainFunction, period=0.01
package /AUTOSAR_WdgM/BswImplementations
  bsw implementation WdgM: programming-language=C, sw-version=8.1.0, ar-release-version=4.2.2, behavior=BswInternalBehavior
    code-descriptors:
      code CodeDescriptor: artifact-descriptors=autosar-engineering-object={short-label=ArEngObj, category=SWSRC}
    resource consumption WdgM_ResourceConsumption
      19 x memory section:
        WDGM_VAR_FAST_CLEARED_UNSPECIFIED: prefix=WDGM, sw-addrmethod=VAR_FAST_CLEARED, symbol=VAR_FAST_CLEARED_UNSPECIFIED
        WDGM_VAR_FAST_CLEARED_BOOLEAN: prefix=WDGM, sw-addrmethod=VAR_FAST_CLEARED, symbol=VAR_FAST_CLEARED_BOOLEAN
        WDGM_VAR_FAST_CLEARED_8: prefix=WDGM, sw-addrmethod=VAR_FAST_CLEARED, symbol=VAR_FAST_CLEARED_8
        WDGM_VAR_FAST_CLEARED_16: prefix=WDGM, sw-addrmethod=VAR_FAST_CLEARED, symbol=VAR_FAST_CLEARED_16
        WDGM_VAR_CLEARED_8: prefix=WDGM, sw-addrmethod=VAR_CLEARED, symbol=VAR_CLEARED_8
        WDGM_VAR_CLEARED_16: prefix=WDGM, sw-addrmethod=VAR_CLEARED, symbol=VAR_CLEARED_16
        WDGM_VAR_CLEARED_32: prefix=WDGM, sw-addrmethod=VAR_CLEARED, symbol=VAR_CLEARED_32
        WDGM_VAR_SLOW_INIT_BOOLEAN: prefix=WDGM, sw-addrmethod=VAR_SLOW_INIT, symbol=VAR_SLOW_INIT_BOOLEAN
        WDGM_VAR_FAST_INIT_8: prefix=WDGM, sw-addrmethod=VAR_FAST_INIT, symbol=VAR_FAST_INIT_8
        WDGM_VAR_POWER_ON_CLEARED_UNSPECIFIED: prefix=WDGM, sw-addrmethod=VAR_POWER_ON_CLEARED, symbol=VAR_POWER_ON_CLEARED_UNSPECIFIED
        WDGM_VAR_FAST_POWER_ON_CLEARED_UNSPECIFIED: prefix=WDGM, sw-addrmethod=VAR_FAST_POWER_ON_CLEARED, symbol=VAR_FAST_POWER_ON_CLEARED_UNSPECIFIED
        WDGM_VAR_FAST_POWER_ON_CLEARED_8: prefix=WDGM, sw-addrmethod=VAR_FAST_POWER_ON_CLEARED, symbol=VAR_FAST_POWER_ON_CLEARED_8
        WDGM_CONFIG_DATA_FAST_UNSPECIFIED: prefix=WDGM, sw-addrmethod=CONFIG_DATA_FAST, symbol=CONFIG_DATA_FAST_UNSPECIFIED
        WDGM_CONFIG_DATA_POSTBUILD_UNSPECIFIED: prefix=WDGM, sw-addrmethod=CONFIG_DATA_POSTBUILD, symbol=CONFIG_DATA_POSTBUILD_UNSPECIFIED
        WDGM_CODE: prefix=WDGM, sw-addrmethod=CODE, symbol=CODE
        WDGM_CODE_FAST: prefix=WDGM, sw-addrmethod=CODE_FAST, symbol=CODE_FAST
        WdgM_CODE_FAST: prefix=WdgM, sw-addrmethod=CODE_FAST, symbol=CODE_FAST
        WDGM_CODE_SLOW: prefix=WDGM, sw-addrmethod=CODE_SLOW, symbol=CODE_SLOW
        WdgM_CODE_SLOW: prefix=WdgM, sw-addrmethod=CODE_SLOW, symbol=CODE_SLOW
      section name prefix WDGM
      section name prefix WdgM
package /AUTOSAR_WdgM/ImplementationDataTypes
  15 x impl type:
    WdgM_ExternalPositionInGraph_ten: compu {1=WDGM_EXTERNALPOSNGRAPH_INITIAL_E (It means the Checkpoint configured as Initial Checkpoint in graph.), 2=WDGM_EXTERNALPOSNGRAPH_FINAL_E (It means the Checkpoint configured as Final Checkpoint in graph.), 3=WDGM_EXTERNALPOSNGRAPH_INTERMEDIATE_E (It means the Checkpoint configured as Intermediate Checkpoint in graph.)}, implementation-data-type=uint8, type-emitter=HEADER_FILE  # Logical Supervision uses this enumeration type to find the position of Checkpoint in graph. | The WdgM_ExternalPositionInGraph_ten values used to find position of Checkpoint in graph for logical Supervision.
    WdgM_ConfigType: category=STRUCTURE, type-emitter=HEADER_FILE  # WdgM configuration type contains all postbuild configurable parameters. | This structure contains all postbuild configurable parameters of the Watchdog Manager. A pointer to this structure is passed to the Watchdog Manager initialization function for configuration.
      8 x element, all with category=TYPE_REFERENCE:
        InitialMode: implementation-data-type=WdgM_ModeType
        NoOfMode: implementation-data-type=uint8
        ErrorSupervision: implementation-data-type=Dem_EventIdType
        ErrorSetMode: implementation-data-type=Dem_EventIdType
        PtrToRunningCounterValue: implementation-data-type=TickType
        PtrToDeadlineIndices: implementation-data-type=uint16
        PtrToMode: implementation-data-type=WdgM_PrvModeType
        PtrToExternalGraphsIndices: implementation-data-type=uint16
    TickType: implementation-data-type=uint32, type-emitter=HEADER_FILE
    Rte_ModeType_WdgMSupervisionCycle: implementation-data-type=uint8, type-emitter=HEADER_FILE
    WdgM_ModeType: implementation-data-type=uint8, type-emitter=RTE  # WdgM Mode type distinguishes the different modes. | This type distinguishes the different modes that were configured for the Watchdog Manager.
    WdgM_LocalStatusType: implementation-data-type=uint8, type-emitter=RTE  # Represent the current status of supervision for individual Supervised Entities. | This type to be used for variables that represent the current status of supervision for individual Supervised Entities. Range : WDGM_LOCAL_STATUS_OK - The supervision of this Supervised Entity has not shown any failures. WDGM_LOCAL_STATUS_FAILED - The supervision of this Supervised Entity has failed but can still be "healed". i.e., if the Supervised Entity returns to a normal behavior, its supervision state will also return to WDGM_LOCAL_STATUS_OK. Furthermore, the number of times that the supervision has failed has not yet exceeded a configurable limit. When this limit has been exceeded the state will change to WDGM_LOCAL_STATUS_EXPIRED. WDGM_LOCAL_STATUS_EXPIRED - The supervision of this Supervised Entity has failed permanently. This state cannot be left. WDGM_LOCAL_STATUS_DEACTIVATED - The supervision of this Supervised Entity is temporarily disabled.
    WdgM_GlobalStatusType: implementation-data-type=uint8, type-emitter=RTE  # Represent the global supervision status of the Watchdog Manager module. | This type to be used for variables that represent the global supervision status of the Watchdog Manager module. Range : WDGM_GLOBAL_STATUS_OK - Supervision did not show any failures. WDGM_GLOBAL_STATUS_FAILED - Supervision has failed but is still within the limit of allowed failures. WDGM_GLOBAL_STATUS_EXPIRED - Supervision has failed, the allowed limit of failures has been exceeded, but the Watchdog Driver has not yet been instructed to stop triggering. WDGM_GLOBAL_STATUS_STOPPED - Supervision has failed, the allowed limit of failures has been exceeded, and the Watchdog Driver has been instructed to stop triggering. A watchdog reset is about to happen. WDGM_GLOBAL_STATUS_DEACTIVATED - WdgM is not initialized and therefore will not manage the watchdogs.
    WdgM_PrvModeType: category=STRUCTURE, type-emitter=HEADER_FILE  # This type contains all Mode related configurable parameters. | This structure contains all Mode related configurable parameters of the Watchdog Manager. A pointer to this structure is passed to access all the configuration parameter of Mode.
      13 x element, all with category=TYPE_REFERENCE:
        ExpiredSupervisionCycleTol: implementation-data-type=uint16
        SchMWdgMSupervisionCycle: implementation-data-type=Rte_ModeType_WdgMSupervisionCycle
        SupervisionCycle: implementation-data-type=uint32
        NoOfAliveSupervision: implementation-data-type=uint16
        NoOfDeadlineSupervision: implementation-data-type=uint16
        NoOfLocalStatusParams: implementation-data-type=uint16
        NoOfTrigger: implementation-data-type=uint8
        PtrToAliveSupervision: implementation-data-type=WdgM_AliveSupervisionType
        PtrToDeadlineSupervision: implementation-data-type=WdgM_DeadlineSupervisionType
        PtrToLocalStatusParams: implementation-data-type=WdgM_LocalStatusParamsType
        PtrToTrigger: implementation-data-type=WdgM_TriggerType
        NoOfExternalGraphTransitions: implementation-data-type=uint16
        PtrToExternalGraph: implementation-data-type=WdgM_ExternalGraphType
    WdgM_TriggerType: category=STRUCTURE, type-emitter=HEADER_FILE  # This type contains all Watchdog trigger related configuration parameters. | This structure contains all configuration parameters needed for triggering of hardware watchdogs.
      element TriggerConditionValue: implementation-data-type=uint16
      element DeviceIdx: implementation-data-type=uint8
      element WdgMode: implementation-data-type=WdgIf_ModeType
    WdgM_ExternalGraphType: category=STRUCTURE, type-emitter=HEADER_FILE  # This contains all the configuration parameters of Logical Supervision. | This structure contains all Logical Supervision configurable parameters of the Watchdog Manager. A pointer to this structure is passed to access all the Logical Supervision configuration parameter for monitoring individual transition of Logical Supervision.
      7 x element, all with category=TYPE_REFERENCE:
        SourcePosnInGraph_en: implementation-data-type=WdgM_ExternalPositionInGraph_ten
        SourceSEId: implementation-data-type=WdgM_SupervisedEntityIdType
        SourceCPId: implementation-data-type=WdgM_CheckpointIdType
        DestSEId: implementation-data-type=WdgM_SupervisedEntityIdType
        DestCPId: implementation-data-type=WdgM_CheckpointIdType
        DestPosnInGraph_en: implementation-data-type=WdgM_ExternalPositionInGraph_ten
        ExternalGraphId: implementation-data-type=uint16
    WdgM_LocalStatusParamsType: category=STRUCTURE, type-emitter=HEADER_FILE  # TThis contains configuration parameters for the Local Status of a Supervised Entity. | This structure contains configuration parameters needed for evaluation of the Local Status of a Supervised Entity.
      element FailedAliveSupervisionRefCycleTol: implementation-data-type=uint8
      element SupervisedEntityId: implementation-data-type=WdgM_SupervisedEntityIdType
    WdgM_SupervisedEntityIdType: implementation-data-type=uint8, type-emitter=RTE  # WdgM SupervisedEntityId type identifies an individual Supervised Entity. | This type identifies an individual Supervised Entity for the Watchdog Manager. The datatype is unit8 or uint16, and it depends upon the number of configured WdgMSupervised Entity.
    WdgM_CheckpointIdType: implementation-data-type=uint8, type-emitter=RTE  # WdgM CheckpointId type identifies a Checkpoint in the context of a Supervised Entity. | This type identifies a Checkpoint in the context of a Supervised Entity for the Watchdog Manager. Note that an individual Checkpoint can only be identified by the pair of Supervised Entity ID and Checkpoint ID. The datatype is unit8 or uint16, and it depends upon the number of configured checkpoints.
    WdgM_DeadlineSupervisionType: category=STRUCTURE, type-emitter=HEADER_FILE  # This contains all configurable parameters of Deadline Supervision. | This structure contains all Deadline Supervision configurable parameters of the Watchdog Manager. A pointer to this structure is passed to access all the Deadline Supervision configuration parameter for monitoring individual Deadline Supervision.
      5 x element, all with category=TYPE_REFERENCE:
        StartCheckpointId: implementation-data-type=WdgM_CheckpointIdType
        StopCheckpointId: implementation-data-type=WdgM_CheckpointIdType
        SupervisedEntityId: implementation-data-type=WdgM_SupervisedEntityIdType
        DeadlineMin: implementation-data-type=TickType
        DeadlineMax: implementation-data-type=TickType
    WdgM_AliveSupervisionType: category=STRUCTURE, type-emitter=HEADER_FILE  # This contains all the configurable parameters of Alive Supervision. | This structure contains all Alive Supervision configurable parameters of the Watchdog Manager. A pointer to this structure is passed to access all the Alive Supervision configuration parameter for monitoring individual Alive Supervision.
      6 x element, all with category=TYPE_REFERENCE:
        MinMargin: implementation-data-type=uint16
        MaxMargin: implementation-data-type=uint16
        AliveSupervisionCheckpointId: implementation-data-type=WdgM_CheckpointIdType
        SupervisedEntityId: implementation-data-type=WdgM_SupervisedEntityIdType
        ExpectedAliveIndications: implementation-data-type=uint16
        SupervisionReferenceCycle: implementation-data-type=uint16
