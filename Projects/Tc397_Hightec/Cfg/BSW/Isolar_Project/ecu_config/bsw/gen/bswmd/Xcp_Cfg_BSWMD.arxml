AUTOSAR XML (schema 4-2-2)
package /AUTOSAR_Xcp/BswImplementations
  bsw implementation Xcp: programming-language=C, sw-version=10.0.0, ar-release-version=4.2.2, behavior=BswInternalBehavior
    code-descriptors:
      code CodeDescriptor: artifact-descriptors=autosar-engineering-object={short-label=ArEngObj, category=SWSRC}
    resource consumption Xcp_ResourceConsumption
      9 x memory section:
        XCP_VAR_POWER_ON_CLEARED_32: alignment=32, prefix=XCP, sw-addrmethod=VAR_POWER_ON_CLEARED, symbol=VAR_POWER_ON_CLEARED_32
        XCP_VAR_POWER_ON_CLEARED_UNSPECIFIED: alignment=UNSPECIFIED, prefix=XCP, sw-addrmethod=VAR_POWER_ON_CLEARED, symbol=VAR_POWER_ON_CLEARED_UNSPECIFIED
        XCP_VAR_CLEARED_UNSPECIFIED: alignment=UNSPECIFIED, prefix=XCP, sw-addrmethod=VAR_CLEARED, symbol=VAR_CLEARED_UNSPECIFIED
        XCP_VAR_INIT_32: alignment=32, prefix=XCP, sw-addrmethod=VAR_INIT, symbol=VAR_INIT_32
        XCP_CONST_32: alignment=32, prefix=XCP, sw-addrmethod=CONST, symbol=CONST_32
        XCP_CONST_UNSPECIFIED: alignment=UNSPECIFIED, prefix=XCP, sw-addrmethod=CONST, symbol=CONST_UNSPECIFIED
        Xcp_CODE: prefix=Xcp, sw-addrmethod=CODE, symbol=CODE
        XCP_CODE: prefix=XCP, sw-addrmethod=CODE, symbol=CODE
        XCP_CODE_FAST: prefix=XCP, sw-addrmethod=CODE_FAST, symbol=CODE_FAST
      section name prefix Xcp
      section name prefix XCP
package /AUTOSAR_Xcp/BswModuleDescriptions
  bsw module description Xcp: category=BSW_MODULE, module-id=212
    bsw internal behavior BswInternalBehavior
      bsw called entity CE_Init: implemented-entry=Xcp_Init
      5 x bsw schedulable entity:
        SE_MainFunction: implemented-entry=Xcp_MainFunction
        SE_EthMainFunctionTx: implemented-entry=Xcp_EthMainFunctionTx
        SE_EventChannel_10ms: implemented-entry=Xcp_EventChannel_10ms
        SE_EventChannel_100ms: implemented-entry=Xcp_EventChannel_100ms
        SE_EventChannel_50ms: implemented-entry=Xcp_EventChannel_50ms
      5 x bsw timing event:
        EV_SE_MainFunction: starts-on-event=SE_MainFunction, period=0.01
        EV_SE_EthMainFunctionTx: starts-on-event=SE_EthMainFunctionTx, period=0.001
        EV_SE_EventChannel_10ms: starts-on-event=SE_EventChannel_10ms, period=0.01
        EV_SE_EventChannel_100ms: starts-on-event=SE_EventChannel_100ms, period=0.1
        EV_SE_EventChannel_50ms: starts-on-event=SE_EventChannel_50ms, period=0.05
package /AUTOSAR_Xcp/Units
  unit NoUnit: display-name=noUnit, factor-si-to-unit=1.0, offset-si-to-unit=0.0, physical-dimension=NoUnit  # No Unit
package /AUTOSAR_Xcp/PhysicalDimensions
  physical dimension NoUnit: length-exp=0
