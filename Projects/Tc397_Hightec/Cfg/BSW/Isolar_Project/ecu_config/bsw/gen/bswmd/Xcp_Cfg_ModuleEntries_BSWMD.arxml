AUTOSAR XML (schema 4-0-3)
package /AUTOSAR_Xcp/BswModuleEntrys
  6 x bsw module entry, all with is-reentrant=false, is-synchronous=true, sw-service-impl-policy=STANDARD:
    Xcp_Init: call-type=REGULAR, execution-context=UNSPECIFIED
    Xcp_MainFunction: call-type=SCHEDULED, execution-context=TASK
    Xcp_EventChannel_10ms: call-type=SCHEDULED, execution-context=TASK
    Xcp_EventChannel_100ms: call-type=SCHEDULED, execution-context=TASK
    Xcp_EventChannel_50ms: call-type=SCHEDULED, execution-context=TASK
    Xcp_EthMainFunctionTx: call-type=SCHEDULED, execution-context=TASK
