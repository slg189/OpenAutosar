AUTOSAR XML (schema 4-2-2)
package /rba_CryptoHSM/SwAddrMethods
  4 x sw addr method, all with memory-allocation-keyword-policy=ADDR-METHOD-SHORT-NAME-AND-ALIGNMENT, section-type=VAR:
    VAR_HSM_SHARED_READONLY_INIT: section-initialization-policy=INIT  # Addressing method for exchange of Data with the Hardware Security Module. Restricted to Security
    VAR_HSM_SHARED_READONLY_CLEARED: section-initialization-policy=CLEARED  # Addressing method for exchange of Data with the Hardware Security Module. Restricted to Security
    VAR_HSM_SHARED_INIT: section-initialization-policy=INIT  # Addressing method for exchange of Data with the Hardware Security Module. Restricted to Security
    VAR_HSM_SHARED_CLEARED: section-initialization-policy=CLEARED  # Addressing method for exchange of Data with the Hardware Security Module. Restricted to Security
package /rba_CryptoHSM/BswImplementations
  bsw implementation rba_CryptoHSM: programming-language=C, sw-version=1.0.0, used-code-generator=rba_CryptoHSM.bamf, vendor-id=6, ar-release-version=4.3.0, behavior=BswInternalBehavior
    code-descriptors:
      code CodeDescriptor: artifact-descriptors=autosar-engineering-object={short-label=ArEngObj, category=SWSRC}
    resource consumption rba_CryptoHSM_ResourceConsumption
      22 x memory section:
        rba_CryptoHSM_CODE: prefix=rba_CryptoHSM, sw-addrmethod=CODE, symbol=CODE
        RBA_CRYPTOHSM_CODE: prefix=RBA_CRYPTOHSM, sw-addrmethod=CODE, symbol=CODE
        RBA_CRYPTOHSM_CONST_8: alignment=8, prefix=RBA_CRYPTOHSM, sw-addrmethod=CONST, symbol=CONST_8
        RBA_CRYPTOHSM_CONST_16: alignment=16, prefix=RBA_CRYPTOHSM, sw-addrmethod=CONST, symbol=CONST_16
        RBA_CRYPTOHSM_CONST_32: alignment=32, prefix=RBA_CRYPTOHSM, sw-addrmethod=CONST, symbol=CONST_32
        RBA_CRYPTOHSM_CONST_UNSPECIFIED: alignment=UNSPECIFIED, prefix=RBA_CRYPTOHSM, sw-addrmethod=CONST, symbol=CONST_UNSPECIFIED
        RBA_CRYPTOHSM_VAR_INIT_8: alignment=8, prefix=RBA_CRYPTOHSM, sw-addrmethod=VAR_INIT, symbol=VAR_INIT_8
        RBA_CRYPTOHSM_VAR_INIT_16: alignment=16, prefix=RBA_CRYPTOHSM, sw-addrmethod=VAR_INIT, symbol=VAR_INIT_16
        RBA_CRYPTOHSM_VAR_INIT_32: alignment=32, prefix=RBA_CRYPTOHSM, sw-addrmethod=VAR_INIT, symbol=VAR_INIT_32
        RBA_CRYPTOHSM_VAR_INIT_UNSPECIFIED: alignment=UNSPECIFIED, prefix=RBA_CRYPTOHSM, sw-addrmethod=VAR_INIT, symbol=VAR_INIT_UNSPECIFIED
        RBA_CRYPTOHSM_VAR_CLEARED_8: alignment=8, prefix=RBA_CRYPTOHSM, sw-addrmethod=VAR_CLEARED, symbol=VAR_CLEARED_8
        RBA_CRYPTOHSM_VAR_CLEARED_16: alignment=16, prefix=RBA_CRYPTOHSM, sw-addrmethod=VAR_CLEARED, symbol=VAR_CLEARED_16
        RBA_CRYPTOHSM_VAR_CLEARED_32: alignment=32, prefix=RBA_CRYPTOHSM, sw-addrmethod=VAR_CLEARED, symbol=VAR_CLEARED_32
        RBA_CRYPTOHSM_VAR_CLEARED_UNSPECIFIED: alignment=UNSPECIFIED, prefix=RBA_CRYPTOHSM, sw-addrmethod=VAR_CLEARED, symbol=VAR_CLEARED_UNSPECIFIED
        RBA_CRYPTOHSM_VAR_SAVED_ZONE_8: alignment=8, prefix=RBA_CRYPTOHSM, sw-addrmethod=VAR_SAVED_ZONE, symbol=VAR_SAVED_ZONE_8
        RBA_CRYPTOHSM_VAR_SAVED_ZONE_16: alignment=16, prefix=RBA_CRYPTOHSM, sw-addrmethod=VAR_SAVED_ZONE, symbol=VAR_SAVED_ZONE_16
        RBA_CRYPTOHSM_VAR_SAVED_ZONE_32: alignment=32, prefix=RBA_CRYPTOHSM, sw-addrmethod=VAR_SAVED_ZONE, symbol=VAR_SAVED_ZONE_32
        RBA_CRYPTOHSM_VAR_SAVED_ZONE_UNSPECIFIED: alignment=UNSPECIFIED, prefix=RBA_CRYPTOHSM, sw-addrmethod=VAR_SAVED_ZONE, symbol=VAR_SAVED_ZONE_UNSPECIFIED
        RBA_CRYPTOHSM_VAR_HSM_SHARED_INIT_UNSPECIFIED: alignment=UNSPECIFIED, prefix=RBA_CRYPTOHSM, sw-addrmethod=VAR_HSM_SHARED_INIT, symbol=VAR_HSM_SHARED_INIT_UNSPECIFIED
        RBA_CRYPTOHSM_VAR_HSM_SHARED_CLEARED_UNSPECIFIED: alignment=UNSPECIFIED, prefix=RBA_CRYPTOHSM, sw-addrmethod=VAR_HSM_SHARED_CLEARED, symbol=VAR_HSM_SHARED_CLEARED_UNSPECIFIED
        RBA_CRYPTOHSM_VAR_HSM_SHARED_READONLY_INIT_UNSPECIFIED: alignment=UNSPECIFIED, prefix=RBA_CRYPTOHSM, sw-addrmethod=VAR_HSM_SHARED_READONLY_INIT, symbol=VAR_HSM_SHARED_READONLY_INIT_UNSPECIFIED
        RBA_CRYPTOHSM_VAR_HSM_SHARED_READONLY_CLEARED_UNSPECIFIED: alignment=UNSPECIFIED, prefix=RBA_CRYPTOHSM, sw-addrmethod=VAR_HSM_SHARED_READONLY_CLEARED, symbol=VAR_HSM_SHARED_READONLY_CLEARED_UNSPECIFIED
      section name prefix rba_CryptoHSM
      section name prefix RBA_CRYPTOHSM
package /rba_CryptoHSM/BswModuleDescriptions
  bsw module description rba_CryptoHSM: category=BSW_MODULE, module-id=114  # Crypto Driver for HSM
    provided-entrys:
      rba_CryptoHSM_Init
      rba_CryptoHSM_Deinit
      rba_CryptoHSM_IsInitialized
      rba_CryptoHSM_Rb_StorePermanentData
      rba_CryptoHSM_MainFunction
    bsw module dependency Det: target-module-id=15
    bsw module dependency SchM: target-module-id=130
    bsw internal behavior BswInternalBehavior
      bsw called entity CE_Init: implemented-entry=rba_CryptoHSM_Init
      bsw called entity CE_Deinit: implemented-entry=rba_CryptoHSM_Deinit
      bsw schedulable entity BSWSE_MainFunction: implemented-entry=rba_CryptoHSM_MainFunction
      bsw timing event EV_MainFunction: starts-on-event=BSWSE_MainFunction, period=0.01
package /rba_CryptoHSM/BswModuleEntrys
  5 x bsw module entry, all with sw-service-impl-policy=STANDARD:
    rba_CryptoHSM_Init: service-id=0, is-reentrant=true, is-synchronous=true, call-type=REGULAR, execution-context=UNSPECIFIED  # Initializes the rba_CryptoHSM Driver.
    rba_CryptoHSM_Deinit: service-id=32, is-reentrant=true, is-synchronous=true, call-type=REGULAR, execution-context=UNSPECIFIED  # Deinitializes the rba_CryptoHSM Driver.
    rba_CryptoHSM_IsInitialized: service-id=255, is-reentrant=true, is-synchronous=true, call-type=REGULAR, execution-context=UNSPECIFIED  # Check if the initialization is already done.
      return type boolean: implementation-data-type=boolean  # TRUE: driver is already initialized FALSE: driver is not initialized
    rba_CryptoHSM_Rb_StorePermanentData: service-id=255, is-reentrant=false, is-synchronous=true, call-type=REGULAR, execution-context=UNSPECIFIED  # Triggers persistent data store if needed and returns the save operation status. | Triggers persistent data store if needed and returns the save operation status. The maintask must be called cyclically in order to work properly.
      return type Std_ReturnType: implementation-data-type=Std_ReturnType  # E_OK: persistent data successfully saved into the NvM E_NOT_OK: error occured CRYPTO_E_PENDING: operation in progress
    rba_CryptoHSM_MainFunction: service-id=12, is-reentrant=false, is-synchronous=false, call-type=SCHEDULED, execution-context=TASK  # Process the requested services asynchronously. | This function shall be called cyclically to process the requested services asynchronously.
