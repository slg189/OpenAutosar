AUTOSAR XML (schema 4-0-3)
package /RB/RBA/rba_EthArp/BswModuleDescriptions
  bsw module description rba_EthArp: category=BSW_MODULE, module-id=255  # Address Resolution Protocol
    provided-entrys:
      rba_EthArp_CleanArpTable
      rba_EthArp_GetArpTablesize
      rba_EthArp_GetDestEthAddr
      rba_EthArp_Init
      rba_EthArp_IpConflictDetection
      rba_EthArp_MainFunction
      rba_EthArp_ReadArpTable
      rba_EthArp_RxIndication
      rba_EthArp_SendArpFrame
      rba_EthArp_SendArpGratuitousFrame
      rba_EthArp_UpdateArpTable
    5 x bsw module dependency:
      Det: target-module-id=15
      EthIf: target-module-id=65
      rba_EthAutoIp: target-module-id=255
      rba_EthDHCP: target-module-id=255
      TcpIp: target-module-id=170
package /RB/RBA/rba_EthArp/BswModuleEntrys
  11 x bsw module entry, all with is-reentrant=false, call-type=REGULAR, execution-context=UNSPECIFIED, sw-service-impl-policy=STANDARD:
    rba_EthArp_CleanArpTable: service-id=4, is-synchronous=true  # This API is called to clean the ARP table. | This API is called to clean the ARP table corresponding to the EthIf controller defined by the input parameter.
      sw service arg EthIfCtrlIdxCurr_u8: direction=IN, implementation-data-type=uint8
    rba_EthArp_GetArpTablesize: service-id=15, is-synchronous=false  # This API Provides the max ARP Table size.
      sw service arg lArpTableSize_pu16: category=DATA_REFERENCE, direction=IN, sw-pointer-target-props={target-category=VALUE, implementation-data-type=uint16}
    rba_EthArp_GetDestEthAddr: service-id=5, is-synchronous=false  # This API is used to return the destination Ethernet MAC address associates to the IP address both contained into the ARP Table. | This API is used to return the destination Ethernet MAC address associates to the IP address both contained into the ARP Table An ARP request should be sent out, if no destination Ethernet address entry is found in the ARP table for the destination IPv4 address.
      sw service arg lCtrlIdx_u8: direction=IN, implementation-data-type=uint8
      sw service arg lDestIpAddr_u32: direction=IN, implementation-data-type=uint32
      sw service arg lDestEthAddr_au8: category=DATA_REFERENCE, direction=OUT, sw-pointer-target-props={target-category=VALUE, implementation-data-type=uint8}
    rba_EthArp_Init: service-id=1, is-synchronous=false  # By this API service the TCP/IP initializes the the ARP Tables of each EthIf Controller.
      sw service arg rba_EthArp_Config_cst: category=DATA_REFERENCE, direction=IN, sw-pointer-target-props={target-category=VALUE, implementation-data-type=rba_EthArp_Config_to}
    rba_EthArp_IpConflictDetection: service-id=6, is-synchronous=false  # This API is called to detect IP conflict. | This API is called by rba_EthArp_RxIndication() and rba_EthIPv4_RxIndication(). This function is called to check the Ip received in the frame and to detect if there is no conflict between Ip address.
      5 x sw service arg, all with direction=IN:
        lCtrlIdx_u8: implementation-data-type=uint8
        lRxSrcIpAddress_u32: implementation-data-type=uint32
        lRxDstIpAddress_u32: implementation-data-type=uint32
        lRxSrcEthAddress_au8: category=DATA_REFERENCE, sw-impl-policy=CONST, sw-pointer-target-props={target-category=VALUE, implementation-data-type=uint8}
        lTypeOfFrame_u16: implementation-data-type=uint16
    rba_EthArp_MainFunction: service-id=0x0a, is-synchronous=false  # This API is the scheduled function of the ARP Component. | This API is the scheduled function of the ARP Component integrates the State Machine. The function is called from the scheduled task TcpIp_MainFunction().
    rba_EthArp_ReadArpTable: service-id=0x03, is-synchronous=false  # This function is used to read out a given number of ARP table entries per EthIfCtrl. | This function is used to read out a given number of ARP table entries per EthIfCtrl. If given number is bigger then available ARP table entries in use, the function only returns the number of used ARP table entries.
      sw service arg EthIfCtrlIdx_u8: direction=IN, implementation-data-type=uint8
      sw service arg ArpTable_cpu8: category=DATA_REFERENCE, direction=IN, sw-pointer-target-props={target-category=VALUE, implementation-data-type=uint8, sw-impl-policy=CONST}  # number of Arp table entries. As input parameter specifies the number of Arp table entries to be read (size of the provided buffer ArpTable_cpu8 in entries). rba_EthArp shall update NumberEntries_cpu16 with the number of the returned Arp table entries.
      sw service arg NumberEntries_cpu16: category=DATA_REFERENCE, direction=INOUT, sw-pointer-target-props={target-category=VALUE, implementation-data-type=uint16, sw-impl-policy=CONST}  # Pointer to first element of array, which contains the ARP table per EthIfCtrl
    rba_EthArp_RxIndication: service-id=7, is-synchronous=false  # This API is called to process the ARP frames received. | This API is called to transmit the ARP frames to the ARP Component. In this API, the parsing and the verification of the information contained into the frame is done.
      sw service arg lCtrlIdx_u8: direction=IN, implementation-data-type=uint8
      sw service arg lRxDataPtr: category=DATA_REFERENCE, direction=IN, sw-impl-policy=CONST, sw-pointer-target-props={target-category=VALUE, implementation-data-type=uint8}
      sw service arg lRxDataLen_u16: direction=IN, implementation-data-type=uint16
    rba_EthArp_SendArpFrame: service-id=8, is-synchronous=false  # This API is used to send ARP Frames on the network (Reply/Request/Probe).
      5 x sw service arg, all with direction=IN:
        lCtrlIdx_u8: implementation-data-type=uint8
        lIndexTable_u16: implementation-data-type=uint16
        lDestIPv4Addr_u32: implementation-data-type=uint32
        lDestEthAddr_au8: category=DATA_REFERENCE, sw-impl-policy=CONST, sw-pointer-target-props={target-category=VALUE, implementation-data-type=uint8}
        lTypeFrame_u8: implementation-data-type=uint8
    rba_EthArp_SendArpGratuitousFrame: service-id=9, is-synchronous=false  # This API is called to send ARP Gratuitous Frame ( GRATUITOUS )
      sw service arg lCtrlIdx_u8: direction=IN, implementation-data-type=uint8
      sw service arg lSrcIPv4Addr_u32: direction=IN, implementation-data-type=uint32
    rba_EthArp_UpdateArpTable: service-id=2, is-synchronous=false  # This API is used to update the ARP Table with the IP and MAC Address received from IPv4. | This API is used to update the ARP Table with the IP and MAC Address received from IPv4. All the IP/MAC Addresses received are stored, even if we have to overwrite an entry. The update step is used too to check if an IP Conflict occurs. If it's the case, a GRATUITOUS frame is sent and the ARP Table is not updated.
      sw service arg lCtrlIdx_u8: direction=IN, implementation-data-type=uint8
      sw service arg lSrcEthAddr_au8: category=DATA_REFERENCE, direction=IN, sw-impl-policy=CONST, sw-pointer-target-props={target-category=VALUE, implementation-data-type=uint8}
      sw service arg lSrcIpAddr_u32: direction=IN, implementation-data-type=uint32
package /RB/RBA/rba_EthArp/CompuMethods
  compu method rba_EthArp_ArpTableEntryState_ten: 1=RBA_ETHARP_FREE_ENTRY (State of the entry when she is free/not used in the process), 2=RBA_ETHARP_REQ_TO_BE_SENT (State of the entry when a ARP request must be sent. This state appears when we cannot send the frame to the first time), 3=RBA_ETHARP_RPLY_TO_BE_SENT (State of the entry when a ARP reply must be sent for the ARP request received), 4=RBA_ETHARP_RPLY_PENDING (State of the entry when a request have been sent and that we are waiting a Reply), 5=RBA_ETHARP_ENTRY_USED (State of the entry when she is complete (IP and MAC address)), 6=RBA_ETHARP_TIME_OUT (State of the entry when she is Timed Out), 7=RBA_ETHARP_CONFLICT_DETECTED (State of the entry when a conflict is detected for the Assigned Ip Addr. Gratuitous Frame shall be triggered in the next mainfunction to defend the Ip Address)
  compu method rba_EthArp_EthAddrMatch_ten: 0=RBA_ETHARP_ETHADDR_INIT (Initialize Ethernet Address), 1=RBA_ETHARP_ETHADDR_MATCH (Type definition for variables to find ethernet address match.), 2=RBA_ETHARP_ETHADDR_NO_MATCH (Type definition for variables to find ethernet address not match.)
  compu method rba_EthArp_HdrByte_ten: 0=RBA_ETHARP_HWTYPE (Type Definition for variable to hold hardware address), 2=RBA_ETHARP_PROTOTYPE (Type definition for variables to hold prototype.), 4=RBA_ETHARP_HWADDRLENGTH (Type definition for variables to hold hardware address length), 5=RBA_ETHARP_PROTOLENGTH (Type definition for variables to hold prototype length), 6=RBA_ETHARP_ARPOPCODE (Type definition for variables to hold Arp OPCODE), 8=RBA_ETHARP_SRCHWADDR (Type definition for variables to hold Source hardware address), 14=RBA_ETHARP_SRCIPADDR (Type definition for variables to hold Source IP address), 18=RBA_ETHARP_DSTHWADDR (Type definition for variables to hold Destination hardware address), 24=RBA_ETHARP_DSTIPADDR (Type definition for variables to hold Destination IP address)
package /RB/RBA/rba_EthArp/ImplementationDataTypes
  4 x impl type, all with category=STRUCTURE, type-emitter=HEADER_FILE:
    rba_EthArp_Hdr_tst  # Arp Message Format
      9 x element, all with category=TYPE_REFERENCE:
        srcIpAddr_u32: implementation-data-type=uint32
        destIpAddr_u32: implementation-data-type=uint32
        hwType_u16: implementation-data-type=uint16
        protoType_u16: implementation-data-type=uint16
        arpOpCode_u16: implementation-data-type=uint16
        hwAddrLen_u8: implementation-data-type=uint8
        protoLen_u8: implementation-data-type=uint8
        srcHwAddr_au8: array-size=6, array-size-semantics=FIXED-SIZE, implementation-data-type=uint8
        destHwAddr_au8: array-size=6, array-size-semantics=FIXED-SIZE, implementation-data-type=uint8
    rba_EthArp_ArpTable_tst  # ARP Table Entry | Struct that contains the specific parameters to strore for one entry
      7 x element, all with category=TYPE_REFERENCE:
        procEntryState_en: implementation-data-type=uint8
        procIpAddrType_en: implementation-data-type=uint8
        procIpAssignMeth_en: implementation-data-type=uint8
        destIpAddr_u32: implementation-data-type=uint32
        procTimeOutEntryCnt_u32: implementation-data-type=uint32
        procTxFrameCnt_u16: implementation-data-type=uint16
        destHwAddr_au8: array-size=6, array-size-semantics=FIXED-SIZE, implementation-data-type=uint8
    rba_EthArp_SubConfig_to  # This container is a sub-container of rba_EthArp_Config_to and defines the specific configuration parameters of the ARP (Address Resolution Protocol) sub-module
      4 x element:
        ArpTable_past: category=DATA_REFERENCE, sw-pointer-target-props={target-category=TYPE_REFERENCE, implementation-data-type=rba_EthArp_ArpTable_tst}
        AgeingDisabled_cu8: implementation-data-type=uint8, sw-impl-policy=CONST
        EthIfCtrIdx_cu8: implementation-data-type=uint8, sw-impl-policy=CONST
        TcpIpCtrlFramePrio_cu8: implementation-data-type=uint8, sw-impl-policy=CONST
    rba_EthArp_Config_to  # This container is a sub-container of TcpIpConfig and specifies the configuration parameters of the ARP (Address Resolution Protocol) sub-module
      7 x element:
        ArpSubConfig_past: category=DATA_REFERENCE, sw-pointer-target-props={target-category=TYPE_REFERENCE, implementation-data-type=rba_EthArp_ArpTable_tst, sw-impl-policy=CONST}
        TableEntryTimeout_u32: implementation-data-type=uint32
        TablePendingEntryTimeout_u32: implementation-data-type=uint32
        TableSizeMax_u16: implementation-data-type=uint16
        MaxRequests_u16: implementation-data-type=uint16
        NumArpTbl_u8: implementation-data-type=uint8
        NumGratARPonStartup_u8: implementation-data-type=uint8
