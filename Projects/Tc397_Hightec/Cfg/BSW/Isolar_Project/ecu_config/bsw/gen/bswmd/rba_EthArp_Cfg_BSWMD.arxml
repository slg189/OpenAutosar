AUTOSAR XML (schema 4-2-2)
package /RB/RBA/rba_EthArp/BswImplementations
  bsw implementation rba_EthArp: programming-language=C, sw-version=10.0.0, ar-release-version=4.2.2, behavior=BswInternalBehavior
    code-descriptors:
      code CodeDescriptor: artifact-descriptors=autosar-engineering-object={short-label=ArEngObj, category=SWSRC}
    resource consumption rba_EthArp_ResourceConsumption
      5 x memory section:
        RBA_ETHARP_CONST_UNSPECIFIED: alignment=UNSPECIFIED, prefix=RBA_ETHARP, sw-addrmethod=CONST, symbol=CONST_UNSPECIFIED
        RBA_ETHARP_VAR_CLEARED_UNSPECIFIED: alignment=UNSPECIFIED, prefix=RBA_ETHARP, sw-addrmethod=VAR_CLEARED, symbol=VAR_CLEARED_UNSPECIFIED
        RBA_ETHARP_VAR_INIT_8: alignment=8, prefix=RBA_ETHARP, sw-addrmethod=VAR_INIT, symbol=VAR_INIT_8
        rba_EthArp_CODE: prefix=rba_EthArp, sw-addrmethod=CODE, symbol=CODE
        RBA_ETHARP_CODE: prefix=RBA_ETHARP, sw-addrmethod=CODE, symbol=CODE
      section name prefix rba_EthArp
      section name prefix RBA_ETHARP
package /RB/RBA/rba_EthArp/BswModuleDescriptions
  bsw module description rba_EthArp
    bsw internal behavior BswInternalBehavior
package /RB/RBA/rba_EthArp/Units
  unit NoUnit: display-name=noUnit, factor-si-to-unit=1.0, offset-si-to-unit=0.0, physical-dimension=NoUnit  # No Unit
package /RB/RBA/rba_EthArp/PhysicalDimensions
  physical dimension NoUnit: length-exp=0
