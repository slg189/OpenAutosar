AUTOSAR XML (schema 4-0-3)
package /RB/RBA/rba_EthAutoIp/BswModuleDescriptions
  bsw module description rba_EthAutoIp: category=BSW_MODULE, module-id=255
    provided-entrys:
      rba_EthAutoIp_AllocBaseIpAddr
      rba_EthAutoIp_GetIpAddress
      rba_EthAutoIp_Init
      rba_EthAutoIp_IpConflictDetected
      rba_EthAutoIp_MainFunction
      rba_EthAutoIp_Start
      rba_EthAutoIp_Stop
    4 x bsw module dependency:
      Det: target-module-id=15
      EthIf: target-module-id=65
      rba_EthArp: target-module-id=255
      TcpIp: target-module-id=170
package /RB/RBA/rba_EthAutoIp/BswModuleEntrys
  7 x bsw module entry, all with is-reentrant=false, is-synchronous=false, call-type=REGULAR, execution-context=UNSPECIFIED, sw-service-impl-policy=STANDARD:
    rba_EthAutoIp_AllocBaseIpAddr  # This function is called to provide the Base IP Address to be used for the assignment
      sw service arg lLocalAddrId_tu8: direction=IN, implementation-data-type=uint8
      sw service arg LocalIpAddr_pst: category=DATA_REFERENCE, direction=IN, sw-impl-policy=CONST, sw-pointer-target-props={target-category=VALUE, implementation-data-type=uint8, sw-impl-policy=CONST}
    rba_EthAutoIp_GetIpAddress  # This function is called to provide the current IP Address in process to ARP to do the IP Conflict detection internally
      sw service arg lCtrlIdx_u8: direction=IN, implementation-data-type=uint16
      sw service arg lLocalIpAddress_pu32: category=DATA_REFERENCE, direction=OUT, sw-pointer-target-props={target-category=VALUE, implementation-data-type=uint32}
      sw service arg lCurrentIpState_pen: category=DATA_REFERENCE, direction=OUT, sw-pointer-target-props={target-category=VALUE, implementation-data-type=uint8}
    rba_EthAutoIp_Init  # This function is called to initialize the module
      sw service arg rba_EthAutoIp_Config_cst: category=DATA_REFERENCE, direction=IN, sw-impl-policy=CONST, sw-pointer-target-props={target-category=VALUE, implementation-data-type=rba_EthAutoIp_Config_to, sw-impl-policy=CONST}
    rba_EthAutoIp_IpConflictDetected  # This API is called by rba_EthArp to inform the AutoIp component that an IP Conflict occurs on the specific Controller given as parameters.
      sw service arg lCtrlIdx_u8: direction=IN, implementation-data-type=uint8
    rba_EthAutoIp_MainFunction  # This Function is MainFunction for the component.
    rba_EthAutoIp_Start  # Start the sequence to create a Local Link Ip Address and check if there is no conflict with the IP generated.
      sw service arg lLocalAddrId_tu8: direction=IN, implementation-data-type=uint8
    rba_EthAutoIp_Stop  # Stop the Auto Ip sequence.
      sw service arg lLocalAddrId_tu8: direction=IN, implementation-data-type=uint8
package /RB/RBA/rba_EthAutoIp/CompuMethods
  compu method rba_EthAutoIp_AutoIpState_ten: 0=RBA_ETHAUTOIP_STATE_OFF (State of the component when it is OFF), 1=RBA_ETHAUTOIP_STATE_INIT (State of the component when it is initiated), 2=RBA_ETHAUTOIP_STATE_PROBING (State of the component when it starts probing), 3=RBA_ETHAUTOIP_STATE_ANNOUNCING (State of the component when it start announcing its presence.), 4=RBA_ETHAUTOIP_STATE_BOUND (State of the component when it in Bound state), 5=RBA_ETHAUTOIP_STATE_STOP (State of the component when she is Timed Out)
package /RB/RBA/rba_EthAutoIp/ImplementationDataTypes
  impl type rba_EthAutoIP_Table_tst: category=STRUCTURE, type-emitter=HEADER_FILE  # AutoIP TABLE
    17 x element, all with category=TYPE_REFERENCE:
      srcHwAddr_au8: array-size=6, array-size-semantics=FIXED-SIZE, implementation-data-type=uint8  # MAC addr : used to calculate random value (AutoIP addr / Random Time)
      entryState_en: implementation-data-type=uint8  # current AutoIP state-machine state
      autoIpState_en: implementation-data-type=uint8  # Assigned / unassigned
      localLinkIpAddr_u32: implementation-data-type=uint32  # the currently selected, probed, announced or used Link local IP-Address
      lastConflict_u32: implementation-data-type=uint32  # ticks until a conflict can be solved by defending
      timeToWait_u32: implementation-data-type=uint32  # ticks to wait, tick is AUTOIP_TMR_INTERVAL long
      initTimeOut_u32: implementation-data-type=uint32
      announceWait_u32: implementation-data-type=uint32  # Delay before announcing locally configured IP address
      announceInterval_u32: implementation-data-type=uint32  # Time between announcement messages
      probeWait_u32: implementation-data-type=uint32  # Time before first probe message afterlink became active (initial delay).
      probeMin_u32: implementation-data-type=uint32  # Minimum time between ARP probe messages
      probeMax_u32: implementation-data-type=uint32  # Maximum time between ARP probe messages
      probeNum_u8: implementation-data-type=uint8  # Number of probe messages.
      announceNum_u8: implementation-data-type=uint8  # Number of announcement messages
      triedLocalLinkIpAddr_u8: implementation-data-type=uint8  # total number of probed/used Link Local IP-Addresses
      sentArpFrameCnt_u8: implementation-data-type=uint8  # sent number of ARP probes or announces, dependent on state
      baseIpStatus_b: implementation-data-type=boolean  # Base IP address status to start the IP address assignment provided by upper layer
  impl type rba_EthAutoIp_Config_to: category=STRUCTURE, type-emitter=HEADER_FILE
    element subConfig_cst: category=DATA_REFERENCE, sw-pointer-target-props={target-category=TYPE_REFERENCE, implementation-data-type=uint8, sw-impl-policy=CONST}
    element initTimeout_u32: implementation-data-type=uint32  # The time in TickTime Auto-IP waits at startup, before beginning with ARP probing
    element procConfigured_u8: implementation-data-type=uint8  # Number of AutoIp process configured
  impl type rba_EthAutoIp_SubConfig_tst: category=STRUCTURE, type-emitter=HEADER_FILE  # AutoIP Subconfiguration
    5 x element:
      autoIpTable_pst: category=DATA_REFERENCE, sw-pointer-target-props={target-category=TYPE_REFERENCE, implementation-data-type=rba_EthAutoIP_Table_tst}  # AutoIp Table
      assignmentMethod_en: implementation-data-type=uint8  # Assignment Method (AUTO_IP or AUTO_IP_DOIP)
      localAddrId_tu8: implementation-data-type=uint8  # LocalAddrId assigned to the AutoIp process
      index_u8: implementation-data-type=uint8  # Index of the AutoIp process
      ctrlIdx_u8: implementation-data-type=uint8  # CtrlIdx matched to the LocalAddrId
