AUTOSAR XML (schema 4-2-2)
package /RB/RBA/rba_EthAutoIp/BswImplementations
  bsw implementation rba_EthAutoIp: programming-language=C, sw-version=10.0.0, ar-release-version=4.2.2, behavior=BswInternalBehavior
    code-descriptors:
      code CodeDescriptor: artifact-descriptors=autosar-engineering-object={short-label=ArEngObj, category=SWSRC}
    resource consumption rba_EthAutoIp_ResourceConsumption
      6 x memory section:
        RBA_ETHAUTOIP_CONST_UNSPECIFIED: alignment=UNSPECIFIED, prefix=RBA_ETHAUTOIP, sw-addrmethod=CONST, symbol=CONST_UNSPECIFIED
        RBA_ETHAUTOIP_VAR_CLEARED_8: alignment=8, prefix=RBA_ETHAUTOIP, sw-addrmethod=VAR_CLEARED, symbol=VAR_CLEARED_8
        RBA_ETHAUTOIP_VAR_CLEARED_UNSPECIFIED: alignment=UNSPECIFIED, prefix=RBA_ETHAUTOIP, sw-addrmethod=VAR_CLEARED, symbol=VAR_CLEARED_UNSPECIFIED
        RBA_ETHAUTOIP_VAR_INIT_UNSPECIFIED: alignment=UNSPECIFIED, prefix=RBA_ETHAUTOIP, sw-addrmethod=VAR_INIT, symbol=VAR_INIT_UNSPECIFIED
        rba_EthAutoIp_CODE: prefix=rba_EthAutoIp, sw-addrmethod=CODE, symbol=CODE
        RBA_ETHAUTOIP_CODE: prefix=RBA_ETHAUTOIP, sw-addrmethod=CODE, symbol=CODE
      section name prefix rba_EthAutoIp
      section name prefix RBA_ETHAUTOIP
package /RB/RBA/rba_EthAutoIp/BswModuleDescriptions
  bsw module description rba_EthAutoIp
    bsw internal behavior BswInternalBehavior
package /RB/RBA/rba_EthAutoIp/Units
  unit NoUnit: display-name=noUnit, factor-si-to-unit=1.0, offset-si-to-unit=0.0, physical-dimension=NoUnit  # No Unit
package /RB/RBA/rba_EthAutoIp/PhysicalDimensions
  physical dimension NoUnit: length-exp=0
