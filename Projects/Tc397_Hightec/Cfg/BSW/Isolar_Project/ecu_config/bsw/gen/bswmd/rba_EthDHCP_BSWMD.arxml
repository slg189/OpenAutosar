AUTOSAR XML (schema 4-0-3)
package /RB/RBA/rba_EthDHCP/BswModuleDescriptions
  bsw module description rba_EthDHCP: category=BSW_MODULE, module-id=255  # Dynamic Host Configuration
    provided-entrys:
      rba_EthDHCP_GetIpAddress
      rba_EthDHCP_Init
      rba_EthDHCP_IpConflictDetected
      rba_EthDHCP_MainFunction
      rba_EthDHCP_ReadOption
      rba_EthDHCP_RxIndication
      rba_EthDHCP_Start
      rba_EthDHCP_Stop
      rba_EthDHCP_WriteOption
    4 x bsw module dependency:
      Det: target-module-id=15
      rba_EthArp: target-module-id=255
      rba_EthUdp: target-module-id=255
      TcpIp: target-module-id=170
package /RB/RBA/rba_EthDHCP/BswModuleEntrys
  9 x bsw module entry, all with is-reentrant=false, is-synchronous=false, call-type=REGULAR, execution-context=UNSPECIFIED, sw-service-impl-policy=STANDARD:
    rba_EthDHCP_GetIpAddress  # This function is called to provide the current IP Address in process to ARP to realize the IP Conflict detection internally.
      sw service arg lCtrlIdx_u8: direction=IN, implementation-data-type=uint8
      sw service arg lLocalIpAddress_pu32: category=DATA_REFERENCE, direction=OUT, sw-pointer-target-props={target-category=VALUE, implementation-data-type=uint32}
      sw service arg lCurrentIpState_pen: category=DATA_REFERENCE, direction=OUT, sw-pointer-target-props={target-category=VALUE, implementation-data-type=uint8}
    rba_EthDHCP_Init  # Initialize the DHCP table (Client and Server) and the DHCP global variables.
      sw service arg rba_EthDHCP_Config_cst: category=DATA_REFERENCE, direction=IN, sw-impl-policy=CONST, sw-pointer-target-props={target-category=VALUE, implementation-data-type=rba_EthDHCP_Config_to, sw-impl-policy=CONST}
    rba_EthDHCP_IpConflictDetected  # This function is called to check the Ip received in the ARP frame and to detect if there is no conflict between Ip address.
      sw service arg lCtrlIdx_u8: direction=IN, implementation-data-type=uint8
    rba_EthDHCP_MainFunction  # This DHCP MainFunction is called from TcpIp_MainFunction.
    rba_EthDHCP_ReadOption  # Function called from TcpIp_DhcpReadOption().
      4 x sw service arg:
        LocalIpAddrId: direction=IN, implementation-data-type=uint8
        Option: direction=IN, implementation-data-type=uint8
        DataLength: category=DATA_REFERENCE, direction=IN, sw-pointer-target-props={target-category=VALUE, implementation-data-type=uint8}
        DataPtr: category=DATA_REFERENCE, direction=OUT, sw-pointer-target-props={target-category=VALUE, implementation-data-type=uint8}
    rba_EthDHCP_RxIndication  # This API service is called by the rba_EthUdp module on reception of a DHCP frame.
      4 x sw service arg, all with direction=IN:
        lSocketIdOut_u16: implementation-data-type=uint8
        lIPAddrPort_ps: category=DATA_REFERENCE, sw-impl-policy=CONST, sw-pointer-target-props={target-category=VALUE, implementation-data-type=uint8, sw-impl-policy=CONST}
        lBufPtr_pu8: category=DATA_REFERENCE, sw-impl-policy=CONST, sw-pointer-target-props={target-category=VALUE, implementation-data-type=uint8, sw-impl-policy=CONST}
        lLength_u16: implementation-data-type=uint16
    rba_EthDHCP_Start  # Start the DHCP sequence to get an IP address from DHCP server.
      sw service arg lLocalAddrId_tu8: direction=IN, implementation-data-type=uint8
    rba_EthDHCP_Stop  # Stop the DHCP sequence to get or to maintain an IP address from DHCP server .
      sw service arg lLocalAddrId_tu8: direction=IN, implementation-data-type=uint8
    rba_EthDHCP_WriteOption  # Function called from TcpIp_DhcpWriteOption().
      4 x sw service arg, all with direction=IN:
        LocalIpAddrId: implementation-data-type=uint8
        Option: implementation-data-type=uint8
        DataLength: implementation-data-type=uint8
        DataPtr: category=DATA_REFERENCE, sw-impl-policy=CONST, sw-pointer-target-props={target-category=VALUE, implementation-data-type=uint8, sw-impl-policy=CONST}
package /RB/RBA/rba_EthDHCP/CompuMethods
  compu method rba_EthDHCP_SockState_ten: 1=RBA_ETHDHCP_SOCK_BOUND (Type definition for variables to hold Socket States.), 2=RBA_ETHDHCP_SOCK_NOTBOUND (Type definition for variables to hold Socket States.)
  compu method rba_EthDHCPClient_State_ten: 0=RBA_ETHDHCP_CLNTOFF (Type definition for variables to hold DHCP client state.), 1=RBA_ETHDHCP_CLNTINIT (Type definition for variables to hold client initiate state), 2=RBA_ETHDHCP_CLNTSELECTING (Type definition for variables to select the client.), 3=RBA_ETHDHCP_CLNTREQUESTING (Type definition for variables to hold client request .), 4=RBA_ETHDHCP_CLNTPROBING (Type definition for variables to hold client probing.), 5=RBA_ETHDHCP_CLNTBOUND (Type definition for variables to hold client bound.), 6=RBA_ETHDHCP_CLNTRENEWING (Type definition for variables to renew client), 7=RBA_ETHDHCP_CLNTREBINDING (Type definition for variables to hold client rebinding.), 8=RBA_ETHDHCP_CLNTREBOOTING (Type definition for variables to client reboot), 9=RBA_ETHDHCP_CLNTINFORMING (Type definition for variables to client informing.), 10=RBA_ETHDHCP_CLNTDECLINE (Type definition for variables to hold client decline state .), 11=RBA_ETHDHCP_CLNTPERMANENT (Type definition for variables to hold cliet permanent state.), 12=RBA_ETHDHCP_CLNTSTOP (Type definition for variables to hold client stop state), 13=RBA_ETHDHCP_CLNTRELEASE (Type definition for variables to hold client release state.)
  compu method rba_EthDHCPServer_State_ten: 0=RBA_ETHDHCP_SRVROFF (Type definition for variables to hold DHCP Server states.), 1=RBA_ETHDHCP_SRVROFFER (Type definition for variables to hold Server offer.), 2=RBA_ETHDHCP_SRVRACK (Type definition for variables to hold Server acknowledgement.), 3=RBA_ETHDHCP_SRVRNACK (Type definition for variables to hold Server negative acknowledgement.), 4=RBA_ETHDHCP_SRVRWAITRESP (Type definition for variables to hold Server wait state.)
package /RB/RBA/rba_EthDHCP/ImplementationDataTypes
  7 x impl type, all with category=STRUCTURE, type-emitter=HEADER_FILE:
    rba_EthDHCP_Hdr_tst  # DHCP message format
      16 x element, all with category=TYPE_REFERENCE:
        xId_u32: implementation-data-type=uint32  # ID
        ciAddr_u32: implementation-data-type=uint32  # Client IP addr. only filled in if client is in BOUND, RENEW or REBINDING state and can respond to ARP requests
        yiAddr_u32: implementation-data-type=uint32  # your (client) IP address
        siAddr_u32: implementation-data-type=uint32  # Server IP address
        giAddr_u32: implementation-data-type=uint32  # Gateway IP address
        magicCookie_u32: implementation-data-type=uint32  # DHCP Magic Cookie
        secs_u16: implementation-data-type=uint16
        flags_u16: implementation-data-type=uint16  # Used to hold flag status.
        packetOpcode_u8: implementation-data-type=uint8  # Used to hold packet opcode.
        hwType_u8: implementation-data-type=uint8  # Used to hold Hardware type
        hwAddrLen_u8: implementation-data-type=uint8  # Ued to hold hardware address length
        hops_u8: implementation-data-type=uint32  # Used to hold number of hops
        clientHwAddr_au8: array-size=16, array-size-semantics=FIXED-SIZE, implementation-data-type=uint8  # Array to hold client hardware address
        serverName_au8: array-size=64, array-size-semantics=FIXED-SIZE, implementation-data-type=uint8  # Server host name
        bootFile_au8: array-size=128, array-size-semantics=FIXED-SIZE, implementation-data-type=uint8  # Bootfile name
        options_au8: array-size=312, array-size-semantics=FIXED-SIZE, implementation-data-type=uint8  # Vendor specific options
    rba_EthDHCP_Config_to  # This container is a sub-container of TcpIpConfig and specifies the configuration parameters of the DHCP sub-module
      element rba_EthDHCP_ClientConfig_cst: category=DATA_REFERENCE, sw-impl-policy=CONST, sw-pointer-target-props={target-category=TYPE_REFERENCE, implementation-data-type=uint8, sw-impl-policy=CONST}
    rba_EthDHCPClient_AssignmentParameters_tst  # Parameters got from the DHCP Server and used by TcpIP to use the dynamic IP Address assigned
      element clientIpAddress_u32: implementation-data-type=uint32  # Client IP Address
      element clientSubnetMask_u32: implementation-data-type=uint32  # Client Subnet Mask
      element clientIpRouter_u32: implementation-data-type=uint32  # Client Ip Router
    rba_EthDHCPClient_Table_tst  # DHCPClient table used to store the current status of the client and information received from the Server
      37 x element, all with category=TYPE_REFERENCE:
        procSocketState_ten: implementation-data-type=uint8  # State of the Client Socket
        procState_ten: implementation-data-type=uint8  # State of the DHCP Client entry
        serverRespType_ten: implementation-data-type=uint8  # Type of the latest response received from the server
        clientIpAddressState_en: implementation-data-type=uint8  # IP address state (assigned / unassigned)
        procCnt_u32: implementation-data-type=uint32  # Time Counter to temporize or to integrate delay in the process
        procReTransmissionTime_u32: implementation-data-type=uint32  # Retransmission time updated after each retransmission
        procCntLastConflict_u32: implementation-data-type=uint32  # Counter updated to calculate the min interval accepted after a conflict
        procCntTxFr_u32: implementation-data-type=uint32  # Counter to count the number of frames send in the case of retransmission
        clientXId_u32: implementation-data-type=uint32  # XiD generated by the client
        clientXIdInform_u32: implementation-data-type=uint32  # XiD generated by the client
        clientIpAddress_u32: implementation-data-type=uint32  # Offered address received from the server
        clientLeaseTickTime_u32: implementation-data-type=uint32  # Lease Time converted as Tick Time to use in the process
        clientRenewTickTime_u32: implementation-data-type=uint32  # Renew Time converted as Tick Time to use in the process
        clientRebindTickTime_u32: implementation-data-type=uint32  # Rebind Time converted as Tick Time to use in the process
        serverIpAddress_u32: implementation-data-type=uint32  # IP address of the server
        serverId_u32: implementation-data-type=uint32  # Server ID
        optionServerId_u32: implementation-data-type=uint32  # Optional Server ID
        optionLeaseTime_u32: implementation-data-type=uint32  # Optional Lease Time
        optionSubnetMaskId_u32: implementation-data-type=uint32  # Subnet Mask
        optionRouter_u32: implementation-data-type=uint32  # Option Router
        optionRenewalTime_u32: implementation-data-type=uint32  # Renewal Time
        optionRebindingTime_u32: implementation-data-type=uint32  # Rebinding Time
        optionClientId_u32: implementation-data-type=uint32  # Optional Client ID
        procSocketId_u16: implementation-data-type=uint16  # Client Socket Id
        clientHwAddr_au8: array-size=6, array-size-semantics=FIXED-SIZE, implementation-data-type=uint8  # DHCP Client MAC address
        procCntConflict_u8: implementation-data-type=uint8  # Count the number of conflicts
        procCntTxProbeFr_u8: implementation-data-type=uint8  # ARP Probe Frame sent counter
        procCntTxGratuFr_u8: implementation-data-type=uint8  # ARP Gratuitous Frame sent counter
        procCntTxRlsFrmAttempts_u8: implementation-data-type=uint8  # Number of release messages TX tried
        optionClientIdFlag_b: implementation-data-type=boolean  # Flag to disable enable Client Identification Option
        optionParamRqstListFlag_b: implementation-data-type=boolean  # Flag to disable enable Requested Parameter Option
        optionMessType_u8: implementation-data-type=uint8  # Message Type
        KwnHostNameLen_u8: implementation-data-type=uint8  # Holds the length of the Known Host name
        ReqHostNameLen_u8: implementation-data-type=uint8  # Holds the length of the Requested Host name
        optionParamRqstList_au8: array-size=6, array-size-semantics=FIXED-SIZE, implementation-data-type=uint8  # Parameter Request List
        KwnHostNameBuf_au8: array-size=6, array-size-semantics=FIXED-SIZE, implementation-data-type=uint8  # Known Host Name Buffer
        ReqHostNameBuf_au8: array-size=6, array-size-semantics=FIXED-SIZE, implementation-data-type=uint8  # Request HostName Buffer
    rba_EthDHCPClient_OptionsTable_tst  # DHCP Option table
      16 x element, all with category=TYPE_REFERENCE:
        rxOptionServerId_u32: implementation-data-type=uint32  # Server ID
        rxOptionLeaseTime_u32: implementation-data-type=uint32  # Lease Time
        rxOptionSubnetMaskId_u32: implementation-data-type=uint32  # Optional subnet mask ID
        rxOptionRouter_u32: implementation-data-type=uint32  # Option Router
        rxOptionRenewalTime_u32: implementation-data-type=uint32  # Renewal Time
        rxOptionRebindingTime_u32: implementation-data-type=uint32  # Rebinding Time
        rxOptionMessType_u8: implementation-data-type=uint8  # Message Type
        rxOptionHostNameLen_u8: implementation-data-type=uint8  # Host Name Length
        rxOptionMessTypeRxFlag_b: implementation-data-type=boolean  # Mess Type Flag
        rxOptionServerIdRxFlag_b: implementation-data-type=boolean  # Server ID Flag
        rxOptionLeaseTimeRxFlag_b: implementation-data-type=boolean  # Lease Time Flag
        rxOptionRenewalTimeRxFlag_b: implementation-data-type=boolean  # Renewal Time Flag
        rxOptionRebindingTimeRxFlag_b: implementation-data-type=boolean  # Rebinding Time Flag
        rxOptionSubnetMaskIdRxFlag_b: implementation-data-type=boolean  # Subnet mask ID Flag
        rxOptionRouterRxFlag_b: implementation-data-type=boolean  # Router Flag
        rxHostNameTempBufr_au8: array-size=6, array-size-semantics=FIXED-SIZE, implementation-data-type=uint8  # Subnet mask ID Flag
    rba_EthDHCP_ClntSubConfig_tst  # DHCP Client Config - Sub-Container of DHCP Config
      4 x element:
        ClntTable_s: category=DATA_REFERENCE, sw-pointer-target-props={target-category=TYPE_REFERENCE, implementation-data-type=rba_EthDHCPClient_Table_tst}  # DHCP Client Table
        ClntIndex_u8: implementation-data-type=uint8  # Index of the current DHCP Client
        ClntCtrlIdx_u8: implementation-data-type=uint8  # CtrlIdx matched to the LocalAddrId
        ClntLocalAddrId_u8: implementation-data-type=uint8  # LocalAddrId matched to the DHCP Client
    rba_EthDHCP_ClntConfig_tst  # DHCP Client General Config - Sub-Container of DHCP Config
      4 x element:
        rba_EthDHCP_ClientSubConfig_cst: category=DATA_REFERENCE, sw-pointer-target-props={target-category=TYPE_REFERENCE, implementation-data-type=rba_EthDHCP_ClntSubConfig_tst, sw-impl-policy=CONST}  # DHCP Client Configuration
        ClntWaitingServerRespTime_u32: implementation-data-type=uint32  # Time to wait before a retransmission if no response received
        ClntConfigured_u8: implementation-data-type=uint8  # Number of Clients configured
        ClntRetransmittedFrm_u8: implementation-data-type=uint8  # Number of retransmitted frames if no Server replies
