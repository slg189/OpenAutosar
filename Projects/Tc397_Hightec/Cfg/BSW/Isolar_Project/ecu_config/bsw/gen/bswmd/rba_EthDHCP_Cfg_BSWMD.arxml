AUTOSAR XML (schema 4-2-2)
package /RB/RBA/rba_EthDHCP/BswImplementations
  bsw implementation rba_EthDHCP: programming-language=C, sw-version=10.0.0, ar-release-version=4.2.2, behavior=BswInternalBehavior
    code-descriptors:
      code CodeDescriptor: artifact-descriptors=autosar-engineering-object={short-label=ArEngObj, category=SWSRC}
    resource consumption rba_EthDHCP_ResourceConsumption
      5 x memory section:
        RBA_ETHDHCP_CONST_UNSPECIFIED: alignment=UNSPECIFIED, prefix=RBA_ETHDHCP, sw-addrmethod=CONST, symbol=CONST_UNSPECIFIED
        RBA_ETHDHCP_VAR_CLEARED_8: alignment=8, prefix=RBA_ETHDHCP, sw-addrmethod=VAR_CLEARED, symbol=VAR_CLEARED_8
        RBA_ETHDHCP_VAR_CLEARED_UNSPECIFIED: alignment=UNSPECIFIED, prefix=RBA_ETHDHCP, sw-addrmethod=VAR_CLEARED, symbol=VAR_CLEARED_UNSPECIFIED
        rba_EthDHCP_CODE: prefix=rba_EthDHCP, sw-addrmethod=CODE, symbol=CODE
        RBA_ETHDHCP_CODE: prefix=RBA_ETHDHCP, sw-addrmethod=CODE, symbol=CODE
      section name prefix rba_EthDHCP
      section name prefix RBA_ETHDHCP
package /RB/RBA/rba_EthDHCP/BswModuleDescriptions
  bsw module description rba_EthDHCP
    bsw internal behavior BswInternalBehavior
package /RB/RBA/rba_EthDHCP/Units
  unit NoUnit: display-name=noUnit, factor-si-to-unit=1.0, offset-si-to-unit=0.0, physical-dimension=NoUnit  # No Unit
package /RB/RBA/rba_EthDHCP/PhysicalDimensions
  physical dimension NoUnit: length-exp=0
