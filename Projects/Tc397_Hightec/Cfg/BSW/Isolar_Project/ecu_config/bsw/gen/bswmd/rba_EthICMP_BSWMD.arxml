AUTOSAR XML (schema 4-0-3)
package /RB/RBA/rba_EthIcmp/BswModuleDescriptions
  bsw module description rba_EthIcmp: category=BSW_MODULE, module-id=255, provided-entrys=[rba_EthIcmp_Init, rba_EthIcmp_RxIndication, rba_EthIcmp_Transmit]
    6 x bsw module dependency:
      ComStack: target-module-id=50
      Dem: target-module-id=54
      Det: target-module-id=15
      rba_EthIPv4: target-module-id=255
      rba_EthTcp: target-module-id=255
      TcpIp: target-module-id=170
package /RB/RBA/rba_EthIcmp/BswModuleEntrys
  bsw module entry rba_EthIcmp_Init: is-reentrant=false, is-synchronous=false, call-type=REGULAR, execution-context=UNSPECIFIED, sw-service-impl-policy=STANDARD  # By this API service the TCP/IP initializes the configuration pointer of EthIcmp.
    sw service arg IcmpConfig_pco: category=DATA_REFERENCE, direction=IN, implementation-data-type=rba_EthIcmp_Config_to, sw-impl-policy=CONST
  bsw module entry rba_EthIcmp_RxIndication: is-reentrant=false, is-synchronous=false, call-type=REGULAR, execution-context=UNSPECIFIED, sw-service-impl-policy=STANDARD  # Function called by TCP/IP module when an ICMP frame is received. A received message is handled according to the ICMP frame type.
    5 x sw service arg, all with direction=IN:
      RmtIPAddr_u32: implementation-data-type=uint32
      LocalAddrId_u8: implementation-data-type=uint8
      RxData_pu8: category=DATA_REFERENCE, sw-pointer-target-props={target-category=VALUE, implementation-data-type=uint8}
      RxDataLen_u16: implementation-data-type=uint16
      IsBroadcast_b: implementation-data-type=boolean
  bsw module entry rba_EthIcmp_Transmit: is-reentrant=false, is-synchronous=false, call-type=REGULAR, execution-context=UNSPECIFIED, sw-service-impl-policy=STANDARD  # By this API service the TCP/IP stack sends an ICMP message according to the specified parameters.
    7 x sw service arg, all with direction=IN:
      LocalAddrId_u8: implementation-data-type=uint8
      RemoteAddr_pst: category=DATA_REFERENCE, sw-pointer-target-props={target-category=VALUE, implementation-data-type=TcpIp_SockAddrType}
      Ttl_u8: implementation-data-type=uint8
      Type_u8: implementation-data-type=uint8
      Code_u8: implementation-data-type=uint8
      DataLength_u16: implementation-data-type=uint16
      TxData_pu8: category=DATA_REFERENCE, sw-pointer-target-props={target-category=VALUE, implementation-data-type=uint8}
package /RB/RBA/rba_EthIcmp/CompuMethods
  compu method rba_EthIcmp_DestUnreach_ten: 0=RBA_ETHICMP_DEST_UNREACH_NET_E (Destination network unreachable), 1=RBA_ETHICMP_DEST_UNREACH_HOST_E (Destination host unreachable), 2=RBA_ETHICMP_DEST_UNREACH_PROTO_E (Destination protocol unreachable), 3=RBA_ETHICMP_DEST_UNREACH_PORT_E (Destination port unreachable), 4=RBA_ETHICMP_DEST_UNREACH_FRAG_E (Fragmentation required, and DF flag set), 5=RBA_ETHICMP_DEST_UNREACH_SRC_FAIL_E (Source route failed)
  compu method rba_EthIcmp_TimeExceed_ten: 0=RBA_ETHICMP_TIME_EXCEED_TTL_E (TTL expired in transit), 1=RBA_ETHICMP_TIME_EXCEED_FRAG_E (Fragment reassembly time exceeded)
  compu method rba_EthIcmp_CtrlMsgTyp_ten: 0=RBA_ETHICMP_ECHO_REPLY_E (Echo Reply), 1=RBA_ETHICMP_RESERVED_1_E (Reserved), 2=RBA_ETHICMP_RESERVED_2_E (Reserved), 3=RBA_ETHICMP_DEST_UNREACH_E (Destination Unreachable), 4=RBA_ETHICMP_SRC_QUENCH_E (Source Quench), 5=RBA_ETHICMP_REDIRECT_MSG_E (Redirect Message), 6=RBA_ETHICMP_ALT_HOST_ADDR_E (Alternate Host Address), 7=RBA_ETHICMP_RESERVED_7_E (Reserved), 8=RBA_ETHICMP_ECHO_REQ_E (Echo Request), 9=RBA_ETHICMP_ROUTER_ADVRTMNT_E (Router Advertisement), 10=RBA_ETHICMP_ROUTER_SOLICIT_E (Router Solicitation), 11=RBA_ETHICMP_TIME_EXCEED_E (Time Exceeded), 12=RBA_ETHICMP_PRM_PRBLM_E (Parameter Problem: Bad IP header), 13=RBA_ETHICMP_TIMESTAMP_E (Timestamp), 14=RBA_ETHICMP_TIMESTAMP_RPLY_E (Timestamp Reply), 15=RBA_ETHICMP_INFO_REQ_E (Information Request), 16=RBA_ETHICMP_INFO_RPLY_E (Information Reply), 17=RBA_ETHICMP_ADDR_MSK_REQ_E (Address Mask Request), 18=RBA_ETHICMP_ADDR_MSK_RPLY_E (Address Mask Reply), 30=RBA_ETHICMP_TRACE_ROUTE_E (Traceroute), 31=RBA_ETHICMP_DATA_CONV_ERR_E (Datagram Conversion Error), 33=RBA_ETHICMP_WHERE_ARE_YOU_E (Where-Are-You), 34=RBA_ETHICMP_HERE_I_AM_E (Here-I-Am), 37=RBA_ETHICMP_DOMAIN_NAME_REQ_E (Domain Name Request), 38=RBA_ETHICMP_DOMAIN_NAME_RPLY_E (Domain Name Reply)
package /RB/RBA/rba_EthIcmp/ImplementationDataTypes
  impl type rba_EthIcmp_SubConfig_to: category=STRUCTURE, type-emitter=HEADER_FILE  # This container is a sub-container of rba_EthIcmp_Config_to and defines the specific configuration parameters of the ICMP (Internet Control Message Protocol) sub-module
    element DemEventId_ConRefused_u16: implementation-data-type=uint16, sw-impl-policy=CONST  # Holds Id for TCPIP_E_CONNREFUSED if TCPIP_E_CONNREFUSED is configured. Holds 0 if TCPIP_E_CONNREFUSED is not configured
    element EchoBroadcastEn_cu8: implementation-data-type=uint8, sw-impl-policy=CONST  # Reply to Broadcast echo requests is enabled or not for each LocalAddrId
    element TcpIpCtrlFramePrio_cu8: implementation-data-type=uint8, sw-impl-policy=CONST  # Frame priority configured per TcpIpCtrl (TcpIpIpFramePrioDefault)
  impl type rba_EthIcmp_Config_to: category=STRUCTURE, type-emitter=HEADER_FILE  # This container is a sub-container of TcpIpConfig and specifies the configuration parameters of the ICMP sub-module
    element IcmpSubConfig_pco: category=DATA_REFERENCE, sw-pointer-target-props={target-category=TYPE_REFERENCE, implementation-data-type=rba_EthIcmp_SubConfig_to, sw-impl-policy=CONST}  # Pointer to ICMP SubConfig Structure
    element IcmpRxIndication_pfct: category=DATA_REFERENCE, sw-pointer-target-props={target-category=TYPE_REFERENCE, implementation-data-type=uint8}  # Rx Indication function pointer.
    element Ttl_u8: implementation-data-type=uint8
