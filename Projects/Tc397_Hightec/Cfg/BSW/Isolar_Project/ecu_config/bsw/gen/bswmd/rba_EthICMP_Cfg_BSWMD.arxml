AUTOSAR XML (schema 4-2-2)
package /RB/RBA/rba_EthICMP/BswImplementations
  bsw implementation rba_EthICMP: programming-language=C, sw-version=10.0.0, ar-release-version=4.2.2, behavior=BswInternalBehavior
    code-descriptors:
      code CodeDescriptor: artifact-descriptors=autosar-engineering-object={short-label=ArEngObj, category=SWSRC}
    resource consumption rba_EthICMP_ResourceConsumption
      6 x memory section:
        RBA_ETHICMP_CONST_UNSPECIFIED: alignment=UNSPECIFIED, prefix=RBA_ETHICMP, sw-addrmethod=CONST, symbol=CONST_UNSPECIFIED
        RBA_ETHICMP_VAR_CLEARED_16: alignment=16, prefix=RBA_ETHICMP, sw-addrmethod=VAR_CLEARED, symbol=VAR_CLEARED_16
        RBA_ETHICMP_VAR_INIT_8: alignment=8, prefix=RBA_ETHICMP, sw-addrmethod=VAR_INIT, symbol=VAR_INIT_8
        RBA_ETHICMP_VAR_INIT_UNSPECIFIED: alignment=UNSPECIFIED, prefix=RBA_ETHICMP, sw-addrmethod=VAR_INIT, symbol=VAR_INIT_UNSPECIFIED
        rba_EthICMP_CODE: prefix=rba_EthICMP, sw-addrmethod=CODE, symbol=CODE
        RBA_ETHICMP_CODE: prefix=RBA_ETHICMP, sw-addrmethod=CODE, symbol=CODE
      section name prefix rba_EthICMP
      section name prefix RBA_ETHICMP
package /RB/RBA/rba_EthICMP/BswModuleDescriptions
  bsw module description rba_EthICMP
    bsw internal behavior BswInternalBehavior
package /RB/RBA/rba_EthICMP/Units
  unit NoUnit: display-name=noUnit, factor-si-to-unit=1.0, offset-si-to-unit=0.0, physical-dimension=NoUnit  # No Unit
package /RB/RBA/rba_EthICMP/PhysicalDimensions
  physical dimension NoUnit: length-exp=0
