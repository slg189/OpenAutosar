AUTOSAR XML (schema 4-0-3)
package /RB/RBA/rba_EthIPv4/BswModuleDescriptions
  bsw module description rba_EthIPv4: category=BSW_MODULE, module-id=255, outgoing-callbacks=rba_EthIPv4_RxIndication  # IPv4 (Internet Protocol)
    provided-entrys:
      rba_EthIPv4_ChkIPv4AddrType
      rba_EthIPv4_GetIPMulticastDestEthAddr
      rba_EthIPv4_Init
      rba_EthIPv4_ProvideTxBuffer
      rba_EthIPv4_Transmit
      rba_EthIPv4_MainFunction
      rba_EthIPv4_GetAndResetMeasurementData
      rba_EthIPv4_CheckFragmentation
      rba_EthIPv4_ZeroCopyTransmit
      rba_EthIPv4_ZeroCopyFillHeader
package /RB/RBA/rba_EthIPv4/BswModuleEntrys
  11 x bsw module entry, all with is-synchronous=true, sw-service-impl-policy=STANDARD:
    rba_EthIPv4_ChkIPv4AddrType: is-reentrant=false, call-type=REGULAR, execution-context=UNSPECIFIED  # Public API rba_EthIPv4_ChkIPv4AddrType | Returns the IPv4 destination address type - Unicast / Broadcast / Multicast. | The service Returns the IPv4 destination address type Unicast / Broadcast / Multicast.
      return type ReturnValue: direction=OUT, implementation-data-type=TcpIp_AddressType  # Unicast OR Multicast OR Broadcast.
      sw service arg DestIpAddr_u32: direction=IN, implementation-data-type=uint32  # Destination IPv4 address type.
      sw service arg SrcIpAddr_u32: direction=IN, implementation-data-type=uint32  # Source IPv4 address type.
      sw service arg NetMask_u32: direction=IN, implementation-data-type=uint32  # NetMask of the LocalAddr Index.
    rba_EthIPv4_GetIPMulticastDestEthAddr: is-reentrant=false, call-type=REGULAR, execution-context=UNSPECIFIED  # Public API rba_EthIPv4_GetIPMulticastDestEthAddr | Return the multicast Ethernet address for multicast IPv4 destination address. Upper half of destination Ethernet address for multicast IP address is 01:00:5E. The lower half comes from the lower 23 bits of the multicast destination IP address. The 24th bit of the destination MAC address is always set to 0 for multicast IP address. | The service Returns the multicast Ethernet address for multicast IPv4 destination address.
      sw service arg DestMultiCastIpAddr_u32: direction=IN, implementation-data-type=uint32  # Destination multicast IPv4 address.
      sw service arg DestEthAddr_pau8: category=DATA_REFERENCE, direction=OUT, sw-pointer-target-props={target-category=VALUE, implementation-data-type=uint8}  # Destination multicast Ethernet/MAC address.
    rba_EthIPv4_Init: is-reentrant=false, call-type=REGULAR, execution-context=UNSPECIFIED  # Public API rba_EthIPv4_Init | This function Initializes the rba_EthIPv4 module. | The service initializes global variables, data structures and all rba_EthIPv4 submodules.
      sw service arg CurrConfig_pco: category=DATA_REFERENCE, direction=IN, sw-impl-policy=CONST, sw-pointer-target-props={target-category=VALUE, implementation-data-type=rba_EthIPv4_Config_to, sw-impl-policy=CONST}  # Configuration data structure for rba_EthIPv4 module.
    rba_EthIPv4_ProvideTxBuffer: is-reentrant=false, call-type=REGULAR, execution-context=UNSPECIFIED  # Public API rba_EthIPv4_ProvideTxBuffer | This API provides transmission buffer to the upper layer. | The service of This API provides transmission buffer to the upper layer and returns Result of buffer request.
      return type ReturnValue: direction=OUT, implementation-data-type=BufReq_ReturnType  # BUFREQ_OK: success. BUFREQ_E_NOT_OK: development error detected. BUFREQ_E_BUSY: all buffers in use. BUFREQ_E_OVFL: requested length is greater than buffer length.
      6 x sw service arg:
        LocalAddrId_u8: direction=IN, implementation-data-type=uint8  # Local address index on which data is to be transmitted.
        DestIpAddr_u32: direction=IN, implementation-data-type=uint32  # Destination IP address to which the data is to be transmitted.
        FramePrio_u8: direction=IN, implementation-data-type=uint8  # Priority value which shall be used for the 3-bit PCP field of the VLAN tag.
        BufIdx_pu8: category=DATA_REFERENCE, direction=OUT, sw-pointer-target-props={target-category=VALUE, implementation-data-type=uint8}  # Index to the buffer allocated by EthDrv.
        Buffer_ppu8: category=DATA_REFERENCE, direction=OUT, sw-pointer-target-props={target-category=VALUE, implementation-data-type=uint8}  # Starting address of the buffer.
        ReqLengthIn_pu16: category=DATA_REFERENCE, direction=INOUT, sw-pointer-target-props={target-category=VALUE, implementation-data-type=uint16}  # Length of buffer requested.
    rba_EthIPv4_MainFunction: is-reentrant=false, call-type=REGULAR, execution-context=TASK  # Public API rba_EthIPv4_MainFunction | rba_EthIPv4_MainFunction implements reassembly timeout handling. It is called from TcpIp_MainFunction. rba_EthIPv4_MainFunction is called entity and shall not be scheduled. | The service of This function decrements reassembly timer by value corresponding to TCPIP_MAIN_FUNCTIONPERIOD_MS releases the reassembly resources and triggers transmission of ICMP Time Exceeded message upon timeout.
    rba_EthIPv4_GetAndResetMeasurementData: is-reentrant=true, call-type=REGULAR, execution-context=UNSPECIFIED  # Public API rba_EthIPv4_GetAndResetMeasurementData | Get all MeasurementIdx's at once is not supported. TCPIP_MEAS_ALL shall only be used to reset all MeasurementIdx's at once. A NULL_PTR shall be provided for MeasurementDataPtr in this case. | The service of This function Allows to read and reset detailed measurement data for diagnostic purposes. Get all MeasurementIdx's at once is not supported.TCPIP_MEAS_ALL shall only be used to reset all MeasurementIdx's at once. A NULL_PTR shall be provided for MeasurementDataPtr in this case.
      sw service arg MeasurementIdx_u8: direction=IN, implementation-data-type=TcpIp_MeasurementIdxType  # Data index of measurement data.
      sw service arg MeasurementResetNeeded_b: direction=IN, implementation-data-type=boolean  # Flag to trigger a reset of the measurement data.
      sw service arg MeasurementDataPtr_pu32: category=DATA_REFERENCE, direction=OUT, sw-pointer-target-props={target-category=VALUE, implementation-data-type=uint32}  # Reference to data buffer, where to copy measurement data.
    rba_EthIPv4_CheckFragmentation: is-reentrant=true, call-type=REGULAR, execution-context=UNSPECIFIED  # Public API rba_EthIPv4_CheckFragmentation | The API returns the number of IPv4 fragments required to transmit the data with length provided in input parameter. | The service of the API is returns the number of IPv4 fragments required to transmit the data with length provided in input parameter.
      return type ReturnValue: direction=OUT, implementation-data-type=Std_ReturnType  # E_OK: successful; E_NOT_OK: failed
      sw service arg LocalAddrId_u8: direction=IN, implementation-data-type=uint8  # LocalAddrId on which data is to be transmitted.
      sw service arg DataLength_u16: direction=IN, implementation-data-type=uint16  # Data length to be transmitted.
      sw service arg NumOfIPFrags_pu8: category=DATA_REFERENCE, direction=OUT, sw-pointer-target-props={target-category=VALUE, implementation-data-type=uint8}  # Number of fragments required to transmit the frame.
    rba_EthIPv4_ZeroCopyFillHeader: is-reentrant=true, call-type=REGULAR, execution-context=UNSPECIFIED  # Public API rba_EthIPv4_ZeroCopyFillHeader | This API prefill the reusable part of the IPv4 header | The service of This API prefill the reusable part of the IPv4 header
      return type ReturnValue: direction=OUT, implementation-data-type=TcpIp_ReturnType  # Returns TCPIP_OK if IPv4 header filling successful. Returns TCPIP_E_NOT_OK if IPv4 header filling failed (general failure). Returns TCPIP_E_ARP_CACHE_MISS if IPv4 header filling failed because of ARP cache miss.
      6 x sw service arg, all with direction=IN:
        LocalAddrId_u8: implementation-data-type=uint8  # LocalAddrId on which data is to be transmitted.
        Priority_u8: implementation-data-type=uint8  # Priority value which shall be used for the 3-bit PCP field of the VLAN tag.
        DestIpAddr_u32: implementation-data-type=uint32  # Destination IP address to which the frame has to be transmitted.
        IpHeader_pcst: category=DATA_REFERENCE, sw-impl-policy=CONST, sw-pointer-target-props={target-category=VALUE, implementation-data-type=TcpIp_IpHeader_tst, sw-impl-policy=CONST}  # Data structure containing the fields of the IP header.
        UdpDataLength_u16: implementation-data-type=uint16  # Udp data length to be transmitted.
        ZeroCopyArg_pcst: category=DATA_REFERENCE, sw-impl-policy=CONST, sw-pointer-target-props={target-category=VALUE, implementation-data-type=Eth_ZeroCopyArg_tst, sw-impl-policy=CONST}  # ZeroCopy argument containing the allocated headers and the pointer to the UL data to be transmitted.
    rba_EthIPv4_ZeroCopyTransmit: is-reentrant=true, call-type=REGULAR, execution-context=UNSPECIFIED  # Public API rba_EthIPv4_ZeroCopyTransmit | This API executes the ZeroCopy transmission. | The service of This API executes the ZeroCopy transmission.
      return type ReturnValue: direction=OUT, implementation-data-type=TcpIp_ReturnType  # Returns TCPIP_OK if IPv4 packet transmission successful. Returns TCPIP_E_NOT_OK if IPv4 packet transmission failed (general failure). Returns TCPIP_E_ARP_CACHE_MISS if IPv4 datagram transmission failed because of ARP cache miss.
      4 x sw service arg:
        LocalAddrId_u8: direction=IN, implementation-data-type=uint8  # LocalAddrId on which data is to be transmitted.
        UdpDataLength_u16: direction=IN, implementation-data-type=uint16  # UDP data length to be transmitted.
        ZeroCopyArg_pcst: category=DATA_REFERENCE, direction=IN, sw-impl-policy=CONST, sw-pointer-target-props={target-category=VALUE, implementation-data-type=Eth_ZeroCopyArg_tst, sw-impl-policy=CONST}  # ZeroCopy argument containing the allocated headers and the pointer to the UL data to be transmitted.
        TxId_pu32: category=DATA_REFERENCE, direction=OUT, sw-pointer-target-props={target-category=VALUE, implementation-data-type=uint32}  # Unique identifier of the ZeroCopy transmission (valid only if ZeroCopyArg_pst->TxConfFlag_b is TRUE).
    rba_EthIPv4_RxIndication: is-reentrant=false, call-type=CALLBACK, execution-context=UNSPECIFIED  # Public API rba_EthIPv4_RxIndication | This API checks received frame for being valid and performs reassembly, if required. If frame is valid and complete, it is forwarded to the corresponding upper layer protocol. | The service of This API is called when an IPv4 packet is received.
      5 x sw service arg, all with direction=IN:
        EthIfCtrlIdx_u8: implementation-data-type=uint8  # Index of the EthIf controller on which theIPv4 packet is received.
        IsBroadcast_b: implementation-data-type=boolean  # parameter to indicate a broadcast frame.
        RmtPhysAddr_pu8: category=DATA_REFERENCE, sw-pointer-target-props={target-category=VALUE, implementation-data-type=uint8}  # Pointer to Physical source address (MAC address in network byte order) of the transmitting node.
        RxData_pu8: category=DATA_REFERENCE, sw-pointer-target-props={target-category=VALUE, implementation-data-type=uint8}  # Data pointer to the starting address of IPv4 header.
        RxDataLen_u16: implementation-data-type=uint16  # Length of IPv4 packet.
    rba_EthIPv4_Transmit: is-reentrant=false, call-type=REGULAR, execution-context=UNSPECIFIED  # Public API rba_EthIPv4_Transmit | This API performs fragmentation, if required, and triggers transmission of IPv4 packets. | The service of This API transmits an IPv4 packet.
      return type ReturnValue: direction=OUT, implementation-data-type=TcpIp_ReturnType  # Indicates whether data transmission was successful or not.
      6 x sw service arg, all with direction=IN:
        LocalAddrId_u8: implementation-data-type=uint8  # Local address index on which data is to be transmitted.
        DestIpAddr_u32: implementation-data-type=uint32  # Destination IP address to which the data is to be transmitted.
        Buffer_pu8: category=DATA_REFERENCE, sw-pointer-target-props={target-category=VALUE, implementation-data-type=uint8}  # Index to the buffer allocated by EthDrv.
        BufIdx_u8: implementation-data-type=uint8  # Starting address of the buffer.
        IpHeader_pcst: category=DATA_REFERENCE, sw-impl-policy=CONST, sw-pointer-target-props={target-category=VALUE, implementation-data-type=TcpIp_IpHeader_tst, sw-impl-policy=CONST}  # structure contains values required to fill out IPv4 header.
        TotLength_u16: implementation-data-type=uint16  # Total length of upper layer data.
package /RB/RBA/rba_EthIPv4/ImplementationDataTypes
  4 x impl type, all with category=STRUCTURE, type-emitter=HEADER_FILE:
    rba_EthIPv4_FragBufTbl_tst  # This structure holds information about amount of fragmentation buffer available per controller. | This structure holds information about amount of buffer available per controller.
      element FreeBufPos_u32: implementation-data-type=uint32  # Index pointing to the available buffer.
      element FreeBufLength_u32: implementation-data-type=uint32  # Number of bytes available from the index.
    rba_EthIPv4_ReassemblyBufDescriptor_tst  # This structure contains information about reassembly resources.
      9 x element:
        ReassemblyBuf_cpu16: category=DATA_REFERENCE, sw-impl-policy=CONST, sw-pointer-target-props={target-category=TYPE_REFERENCE, implementation-data-type=uint16}  # Pointer to reassembly buffer.
        ProtoType_en: implementation-data-type=TcpIp_ProtocolType  # Transport layer protocol of the received fragment. | TP layer protocol of the received fragment.
        SrcIp_u32: implementation-data-type=uint32  # Source IP of the received fragment.
        DstIp_u32: implementation-data-type=uint32  # Destination IP of the received fragment.
        TimerCurrentValue_u32: implementation-data-type=uint32  # Pending time out value for the current reassembly buffer. | Pending time out value for the current reassembly buffer in ticks (1 tick = TcpIp main function period).
        IcmpTimeExceededPayload_au8: array-size=68, array-size-semantics=FIXED-SIZE, implementation-data-type=uint8  # Payload of Icmp Time Exceeded message. | If a host reassembling a fragmented datagram cannot complete the reassembly due to missing fragments within its time limit, it discards the datagram and sends a time exceeded message containing as payload IPv4 header of the fragment zero (max 60 bytes) + first eight octets of the IPv4 payload. This structure member is only available, if Icmp is enabled.
        FrameId_u16: implementation-data-type=uint16  # Frame identifier of the received frame.
        FirstHolePos_u16: implementation-data-type=uint16  # Index of the first free hole in the reassembly buffer.
        TotalPalyloadLen_u16: implementation-data-type=uint16  # Total length of IPv4 payload before frame undergoing fragmentation.
    rba_EthIPv4_CtrlCfg_tst  # This structure contains IPv4 configuration per controller.
      13 x element, all with sw-impl-policy=CONST:
        ReassemblyBufDescriptor_cpst: category=DATA_REFERENCE, sw-pointer-target-props={target-category=TYPE_REFERENCE, implementation-data-type=rba_EthIPv4_ReassemblyBufDescriptor_tst}  # Pointer to reassembly buffer descriptor. | Pointer to reassembly buffer descriptor. NULL_PTR indicates reassembly is disabled for the TcpIpCtrl.
        ReassemblyTimeout_cu32: implementation-data-type=uint32  # Reassembly time out value configured. | Reassembly time out value configured, in ticks (1 tick = TcpIp main function period). Value of zero indicates reassembly is disabled for the TcpIpCtrl.
        ReassemblyBufSize_cu16: implementation-data-type=uint16  # Reassembly buffer size. | Reassembly buffer size. Value of zero indicates reassembly is disabled for the TcpIpCtrl.
        ReassemblyBufCnt_cu8: implementation-data-type=uint8  # Reassembly buffer count. | Reassembly buffer count. Value of zero indicates reassembly is disabled for the TcpIpCtrl.
        TxFragBuf_cpu8: category=DATA_REFERENCE, sw-pointer-target-props={target-category=TYPE_REFERENCE, implementation-data-type=uint8}  # Pointer to fragmentation buffer. | Pointer to fragmentation buffer. NULL_PTR indicates fragmentation is disabled for the TcpIpCtrl.
        TxFragBufSize_cu32: implementation-data-type=uint32  # Size of the fragmentation buffer for the TcpIp controller. | Size of the fragmentation buffer for the controller. In addition to configured Size it includes additional bytes required to store hidden header.
        TxFragBufTbl_cpst: category=DATA_REFERENCE, sw-pointer-target-props={target-category=TYPE_REFERENCE, implementation-data-type=rba_EthIPv4_FragBufTbl_tst}  # Pointer to fragmentation buffer handle table. | Pointer to buffer handle table. NULL_PTR indicates fragmentation is disabled for the TcpIpCtrl.
        TxFragBufTblSize_cu16: implementation-data-type=uint16  # Size of fragmentation buffer handle table. | Size of fragmentation buffer handle table. Table size is defined sufficient enough to handle all fragmentation buffer request.
        EthIfCtrlMtu_cu16: implementation-data-type=uint16  # Specifies the maximum transmission unit (MTU) of the EthIfCtrl in bytes.
        TtlEnabled_cb: implementation-data-type=boolean  # Flag indicating if TTL configuration is enabled or disabled for TcpIpCtrl. | Flag indicates, if TTL configuration is enabled or disabled for TcpIp controller.
        IPv4ChkSumOffloadingEnabled_cb: implementation-data-type=boolean  # Indicates whether IPv4 checksum offloading is enabled or not for the hardware referenced by the TcpIpCtrl.
        IcmpChkSumOffloadngEnabled_cb: implementation-data-type=boolean  # Indicates whether ICMP checksum offloading is enabled or not for the hardware referenced by the TcpIpCtrl.
        UDPChkSumOffloadingEnabled_cb: implementation-data-type=boolean  # Indicates whether UDP checksum offloading is enabled or not for the hardware referenced by the TcpIpCtrl.
    rba_EthIPv4_Config_to  # IPv4 configuration structure.
      element IPv4CtrlCfg_pco: category=DATA_REFERENCE, sw-pointer-target-props={target-category=TYPE_REFERENCE, implementation-data-type=rba_EthIPv4_CtrlCfg_tst, sw-impl-policy=CONST}  # Pointer to TcpIpCtrl configuration structure.
