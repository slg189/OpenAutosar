AUTOSAR XML (schema 4-2-2)
package /RB/RBA/rba_EthIPv4/BswImplementations
  bsw implementation rba_EthIPv4: programming-language=C, sw-version=10.0.0, ar-release-version=4.2.2, behavior=BswInternalBehavior
    code-descriptors:
      code CodeDescriptor: artifact-descriptors=autosar-engineering-object={short-label=ArEngObj, category=SWSRC}
    resource consumption rba_EthIPv4_ResourceConsumption
      8 x memory section:
        RBA_ETHIPV4_CONST_UNSPECIFIED: alignment=UNSPECIFIED, prefix=RBA_ETHIPV4, sw-addrmethod=CONST, symbol=CONST_UNSPECIFIED
        RBA_ETHIPV4_VAR_CLEARED_32: alignment=32, prefix=RBA_ETHIPV4, sw-addrmethod=VAR_CLEARED, symbol=VAR_CLEARED_32
        RBA_ETHIPV4_VAR_CLEARED_UNSPECIFIED: alignment=UNSPECIFIED, prefix=RBA_ETHIPV4, sw-addrmethod=VAR_CLEARED, symbol=VAR_CLEARED_UNSPECIFIED
        RBA_ETHIPV4_VAR_INIT_16: alignment=16, prefix=RBA_ETHIPV4, sw-addrmethod=VAR_INIT, symbol=VAR_INIT_16
        RBA_ETHIPV4_VAR_INIT_UNSPECIFIED: alignment=UNSPECIFIED, prefix=RBA_ETHIPV4, sw-addrmethod=VAR_INIT, symbol=VAR_INIT_UNSPECIFIED
        rba_EthIPv4_CODE: prefix=rba_EthIPv4, sw-addrmethod=CODE, symbol=CODE
        RBA_ETHIPV4_CODE: prefix=RBA_ETHIPV4, sw-addrmethod=CODE, symbol=CODE
        RBA_ETHIPV4_CODE_FAST: prefix=RBA_ETHIPV4, sw-addrmethod=CODE_FAST, symbol=CODE_FAST
      section name prefix rba_EthIPv4
      section name prefix RBA_ETHIPV4
package /RB/RBA/rba_EthIPv4/BswModuleDescriptions
  bsw module description rba_EthIPv4
    bsw internal behavior BswInternalBehavior
package /RB/RBA/rba_EthIPv4/Units
  unit NoUnit: display-name=noUnit, factor-si-to-unit=1.0, offset-si-to-unit=0.0, physical-dimension=NoUnit  # No Unit
package /RB/RBA/rba_EthIPv4/PhysicalDimensions
  physical dimension NoUnit: length-exp=0
