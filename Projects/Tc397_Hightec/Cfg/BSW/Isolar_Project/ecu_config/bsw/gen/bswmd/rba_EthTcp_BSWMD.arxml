AUTOSAR XML (schema 4-0-3)
package /RB/RBA/rba_EthTcp/BswModuleDescriptions
  bsw module description rba_EthTcp: category=BSW_MODULE, module-id=255
    provided-entrys:
      rba_EthTcp_AbortByLocalAddrId
      rba_EthTcp_Bind
      rba_EthTcp_ChangeParameter
      rba_EthTcp_Close
      rba_EthTcp_Connect
      rba_EthTcp_FindTcpSockId
      rba_EthTcp_GetSocket
      rba_EthTcp_Init
      rba_EthTcp_Listen
      rba_EthTcp_MainFunction
      rba_EthTcp_Received
      rba_EthTcp_RxIndication
      rba_EthTcp_Transmit
      rba_EthTcp_GetAndResetMeasurementData
      rba_EthTcp_SecureTransmit
      rba_EthTcp_GetAvailTxBuffSize
      rba_EthTcp_GetMSS
      rba_EthTcp_SecureClose
    4 x bsw module dependency:
      rba_EthIPv4: target-module-id=255
      SoAd: target-module-id=56
      TcpIp: target-module-id=170
      rba_EthTls: target-module-id=100
package /RB/RBA/rba_EthTcp/BswModuleEntrys
  18 x bsw module entry, all with call-type=REGULAR, execution-context=UNSPECIFIED, sw-service-impl-policy=STANDARD:
    rba_EthTcp_AbortByLocalAddrId: service-id=13, is-reentrant=false, is-synchronous=false  # By this API, Tcp is requested to terminate the connection using local address id
      sw service arg LocalAddrId_u8: direction=IN, implementation-data-type=TcpIp_LocalAddrIdType  # Local address id
    rba_EthTcp_Bind: service-id=11, is-reentrant=false, is-synchronous=false  # By this API service the TCP/IP stack is requested to bind a TCP socket to a local resource
      4 x sw service arg:
        TcpSockId_uo: direction=IN, implementation-data-type=TcpIp_SocketIdType  # Tcp socket id
        LocalAddrId_u8: direction=IN, implementation-data-type=TcpIp_LocalAddrIdType  # Local address identifier representing the local IP address and EthIf controller to bind the socket to
        PortPtr_pu16: category=DATA_REFERENCE, direction=OUT, sw-pointer-target-props={target-category=VALUE, implementation-data-type=uint16}  # Local port to which the socket shall be bound.
        FramePrio_u8: direction=IN, implementation-data-type=uint8  # Frame priority to be configured for the socket
    rba_EthTcp_ChangeParameter: service-id=4, is-reentrant=false, is-synchronous=false  # By this API, the rba_EthTcp module is requested to change a parameter of a socket. E.g. the Nagle algorithm may be controlled by this API
      sw service arg TcpSockId_uo: direction=IN, implementation-data-type=TcpIp_SocketIdType  # Tcp socket id
      sw service arg ParamId_u8: direction=IN, implementation-data-type=TcpIp_ParamIdType  # Identifier of the parameter to be changed
      sw service arg ParamValue_cpu8: category=DATA_REFERENCE, direction=IN, sw-pointer-target-props={target-category=VALUE, implementation-data-type=uint8}  # Pointer to memory containing the new parameter value
    rba_EthTcp_Close: service-id=10, is-reentrant=false, is-synchronous=false  # By this API, the rba_EthTcp module is requested to close socket and release all related resources
      sw service arg TcpSockId_uo: direction=IN, implementation-data-type=TcpIp_SocketIdType  # Tcp socket id
      sw service arg Abort_b: direction=IN, implementation-data-type=boolean  # This parameter specifies if the connection should be terminated immediately by sending a RST segment or be terminated after performing a regular connection termination handshake
    rba_EthTcp_Connect: service-id=5, is-reentrant=false, is-synchronous=false  # By this API, the rba_EthTcp module is requested to establish a TCP connection to the configured peer
      sw service arg TcpSockId_uo: direction=IN, implementation-data-type=TcpIp_SocketIdType  # Tcp socket id
      sw service arg RemoteAddr_cpst: category=DATA_REFERENCE, direction=IN, implementation-data-type=TcpIp_SockAddrType  # IP address and port of the remote host to connect to
    rba_EthTcp_FindTcpSockId: service-id=12, is-reentrant=false, is-synchronous=false  # By this API service the TCP stack is requested to find the index of the socket
      sw service arg LocalAddr_cpst: category=DATA_REFERENCE, direction=IN, implementation-data-type=TcpIp_SockAddrInetType  # Pointer to local address information
      sw service arg RemoteAddr_cpst: category=DATA_REFERENCE, direction=IN, implementation-data-type=TcpIp_SockAddrInetType  # Pointer to remote address information
      sw service arg SocketIdPtr_puo: category=DATA_REFERENCE, direction=OUT, implementation-data-type=TcpIp_SocketIdType  # Pointer to the found Tcp socket
    rba_EthTcp_GetSocket: service-id=3, is-reentrant=false, is-synchronous=false  # By this API service the TCP stack is requested a new TCP socket
      sw service arg Domain_u32: direction=IN, implementation-data-type=TcpIp_DomainType  # Internet domain( Address family AF_INET or AF_INET6 )
      sw service arg SocketIdPtr_puo: category=DATA_REFERENCE, direction=OUT, implementation-data-type=TcpIp_SocketIdType  # Pointer to Tcp socket id
    rba_EthTcp_Init: service-id=1, is-reentrant=false, is-synchronous=false  # By this API, the rba_EthTcp module is initialised if the configuration pointer is valid
      sw service arg TcpConfig_cpo: category=DATA_REFERENCE, direction=IN, implementation-data-type=rba_EthTcp_Config_to  # Pointer to the configuration data of the rba_EthTcp module
    rba_EthTcp_Listen: service-id=6, is-reentrant=false, is-synchronous=false  # By this API, the rba_EthTcp module is requested to listen on the TCP socket specified by the Tcp socket id
      sw service arg TcpSockId_uo: direction=IN, implementation-data-type=TcpIp_SocketIdType  # Tcp socket id
      sw service arg MaxChannels_u16: direction=IN, implementation-data-type=uint16  # Maximum number of new parallel connections established on this listen connection
    rba_EthTcp_MainFunction: service-id=2, is-reentrant=false, is-synchronous=false  # By this API, the rba_EthTcp module is requested to handle the TCP process and send TCP frame to rba_EthIpv4 submodule
    rba_EthTcp_Received: service-id=9, is-reentrant=false, is-synchronous=false  # By this API, the reception of data is confirmed to the rba_EthTcp module
      sw service arg TcpSockId_uo: direction=IN, implementation-data-type=TcpIp_SocketIdType  # Tcp socket id
      sw service arg DataLen_u16: direction=IN, implementation-data-type=uint16  # Number of bytes consumed by the upper layer
    rba_EthTcp_RxIndication: service-id=8, is-reentrant=false, is-synchronous=true  # By this API, the rba_EthTcp module gets an indication and the data of a received frame
      4 x sw service arg, all with direction=IN:
        PseudoHdr_cpst: category=DATA_REFERENCE, implementation-data-type=TcpIp_PseudoHdr_tst  # Contains source IP and destination IP addresses
        LocalAddrId_u8: implementation-data-type=TcpIp_LocalAddrIdType  # Local address id on which the frame is received
        RxData_pu8: category=DATA_REFERENCE, sw-pointer-target-props={target-category=VALUE, implementation-data-type=uint8}  # Pointer to the start of the Tcp frame
        LenByte_u16: implementation-data-type=uint16  # Total length of Tcp frame
    rba_EthTcp_Transmit: service-id=7, is-reentrant=false, is-synchronous=false  # This service requests transmission of TCP data to a remote node. The transmission of the data is decoupled. The parameter AvailableLength indicates the length of data to be transmitted. Tcp shall retrieve data from SoAd via one or more subsequent SoAd_CopyTxData() calls within the context of this transmit function call. Tcp shall retrieve exactly AvailableLength bytes from the SoAd if the parameter ForceRetrieve_b is TRUE, otherwise the Tcp may retrieve less data. Note: The Tcp segment(s) are sent dependent on runtime factors e.g. receive window) and configuration parameter(e.g. Nagle algorithm) .
      4 x sw service arg, all with direction=IN:
        TcpSockId_uo: implementation-data-type=TcpIp_SocketIdType  # Tcp socket id
        TxData_cpu8: category=DATA_REFERENCE, sw-pointer-target-props={target-category=VALUE, implementation-data-type=uint8}  # Pointer to a linear buffer containing the data to be transmitted
        AvlLen_u32: implementation-data-type=uint32  # Available data for transmission in bytes
        ForceRetrieve_b: implementation-data-type=boolean  # This parameter is only valid if TxData_pu8 is a NULL_PTR. Indicates how the TCP/IP stack retrieves data from SoAd if TxData_pu8 is a NULL_PTR.
    rba_EthTcp_GetAndResetMeasurementData: service-id=14, is-reentrant=true, is-synchronous=true  # This function is used to read and reset detailed measurement data for diagnostic purposes.It returns the number of all TCP datagrams which cannot be mapped to a valid local IP/Port .
      sw service arg MeasurementIdx: direction=IN, implementation-data-type=TcpIp_MeasurementIdxType  # Data index of measurement data
      sw service arg MeasurementResetNeeded: direction=IN, implementation-data-type=boolean  # Flag to trigger a reset of the measurement data.
      sw service arg MeasurementDataPtr: category=DATA_REFERENCE, direction=OUT, sw-pointer-target-props={target-category=VALUE, implementation-data-type=uint32}  # Reference to data buffer, where to copy measurement data
    rba_EthTcp_SecureTransmit: service-id=245, is-reentrant=true, is-synchronous=true  # This function is used store Tls encrypted data in Tcp buffer.
      4 x sw service arg:
        TcpSockId_uo: direction=IN, implementation-data-type=TcpIp_SocketIdType  # Tcp dynamic socket id
        TlsEncryptedData_cpu8: category=DATA_REFERENCE, direction=IN, sw-pointer-target-props={target-category=VALUE, implementation-data-type=uint8}  # Reference to encypted tls data buffer
        TlsEncryptedDataLength_u16: direction=IN, implementation-data-type=uint16  # Tls encypted data length
        TcpCopiedLength_pu16: category=DATA_REFERENCE, direction=OUT, sw-pointer-target-props={target-category=VALUE, implementation-data-type=uint16}  # Reference to length of Tls data copied in Tcp buffer
    rba_EthTcp_GetAvailTxBuffSize: service-id=247, is-reentrant=true, is-synchronous=true  # This function is used to return free length of tcp buffer.
      sw service arg TcpSockId_uo: direction=IN, implementation-data-type=TcpIp_SocketIdType  # Tcp dynamic socket id
      sw service arg TcpFreeTxBuffSize_pu16: category=DATA_REFERENCE, direction=OUT, sw-pointer-target-props={target-category=VALUE, implementation-data-type=uint16}  # Reference to encypted tls data buffer
    rba_EthTcp_GetMSS: service-id=246, is-reentrant=true, is-synchronous=true  # This function is used to return minimum of local and received mss.
      sw service arg TcpSockId_uo: direction=IN, implementation-data-type=TcpIp_SocketIdType  # Tcp dynamic socket id
      sw service arg TcpMssValue_pu16: category=DATA_REFERENCE, direction=OUT, sw-pointer-target-props={target-category=VALUE, implementation-data-type=uint16}  # Reference to Tcp mss
    rba_EthTcp_SecureClose: service-id=248, is-reentrant=true, is-synchronous=true  # This function requested by TLS to close tcp connection.
      sw service arg TcpSockId_uo: direction=IN, implementation-data-type=TcpIp_SocketIdType  # Tcp dynamic socket id
      sw service arg Abort_b: direction=IN, implementation-data-type=boolean  # Abort status
package /RB/RBA/rba_EthTcp/CompuMethods
  compu method rba_EthTcp_HdrPos_ten: 0=RBA_ETHTCP_POS_SRCPORT_E (Position of source port in TCP header), 2=RBA_ETHTCP_POS_DESTPORT_E (Position of destination port in TCP header), 4=RBA_ETHTCP_POS_SEQNUM_E (Position of sequence number in TCP header), 8=RBA_ETHTCP_POS_ACKNUM_E (Position of acknowledge number in TCP header), 12=RBA_ETHTCP_POS_OFFSET_E (Position of offset in TCP header), 13=RBA_ETHTCP_POS_FLAGS_E (Position of header flags like SYN, ACK, URG, FIN, RST in TCP header), 14=RBA_ETHTCP_POS_WNDSIZE_E (Position of window size in TCP header), 16=RBA_ETHTCP_POS_CHKSUM_E (Position of checksum in TCP header), 18=RBA_ETHTCP_POS_URGPTR_E (Position of urgent pointer in TCP header)
  compu method rba_EthTcp_HdrOpt_ten: 0=RBA_ETHTCP_POS_OPT_KIND_E (Position of Kind field in TCP option), 1=RBA_ETHTCP_POS_OPT_LEN_E (Position of Length field in TCP option), 2=RBA_ETHTCP_POS_OPT_VAL_E (Position of Value in TCP option)
  compu method rba_EthTcp_SocketType_ten: 0=RBA_ETHTCP_SOC_UNSPECIFIED_REMOTE_E (Socket with unspecified remote IP and Port (ANY)), 1=RBA_ETHTCP_SOC_SPECIFIED_REMOTE_E (Socket with specified remote IP and Port), 2=RBA_ETHTCP_SOC_NONE_E (No socket)
  compu method rba_EthTcp_SeqVal_ten: 0=RBA_ETHTCP_SEQ_VALID_E (Received sequence number is valid), 1=RBA_ETHTCP_SEQ_SPECIAL_ALLOWANCE_E (Received sequence number is valid (special allowance)), 2=RBA_ETHTCP_SEQ_OUT_OF_ORDER_E (Received sequence number is out of order), 3=RBA_ETHTCP_SEQ_INVALID_E (Received sequence number is invalid (out of the window))
  compu method rba_EthTcp_AckVal_ten: 0=RBA_ETHTCP_ACK_NEW_E (Received acknowledgment number is new), 1=RBA_ETHTCP_ACK_DUPLICATE_E (Received acknowledgment number is an old duplicate), 2=RBA_ETHTCP_ACK_INVALID_E (Received acknowledgment number is invalid (ack for data which is not sent yet))
package /RB/RBA/rba_EthTcp/ImplementationDataTypes
  14 x impl type, all with type-emitter=HEADER_FILE:
    rba_EthTcp_ConnState_ten: compu {0=RBA_ETHTCP_CONN_CLOSED_E (No connection at all), 1=RBA_ETHTCP_CONN_LISTEN_E (Wait for a Connection Request from any remote TCP), 2=RBA_ETHTCP_CONN_SYN_SENT_E (Wait for a SYN-ACK after having sent a connection request), 3=RBA_ETHTCP_CONN_SYN_RCVD_E (Wait for a Connection Request ACK after having both received and sent a connection request), 4=RBA_ETHTCP_CONN_ESTABLISHED_E (Data can be transmitted and received only in this state), 5=RBA_ETHTCP_CONN_FIN_WAIT_1_E (FIN frame has been sent, waiting for an ACK or Connection Termination Request from the Remote TCP), 6=RBA_ETHTCP_CONN_FIN_WAIT_2_E (Wait for Connection Termination Request from the Remote TCP), 7=RBA_ETHTCP_CONN_CLOSE_WAIT_E (Server TCP is waiting for Application to Close), 8=RBA_ETHTCP_CONN_CLOSING_E (Wait for a connection termination request acknowledgment from the remote TCP), 9=RBA_ETHTCP_CONN_LAST_ACK_E (Wait for Connection Termination request Ack from Client TCP), 10=RBA_ETHTCP_CONN_TIME_WAIT_E (Time to wait before closing TCP Connection)}, implementation-data-type=uint8  # Tcp socket state
    rba_EthTcp_SocketState_ten: compu {0=RBA_ETHTCP_SOCK_CLOSED_E (Socket is Closed i.e. socket is not in use), 1=RBA_ETHTCP_SOCK_RESERVED_E (Socket is reserved by Tcp to send an immediate frame in reply), 2=RBA_ETHTCP_SOCK_ALLOCATED_E (Socket is allocated i.e. socket is reserved for use), 3=RBA_ETHTCP_SOCK_BOUND_E (Socket is bound i.e. when local address is assigned to socket), 4=RBA_ETHTCP_SOCK_OPENED_E (Socket is opened for communication i.e. when Listen and Connect functions is called)}, implementation-data-type=uint8  # Flag to indicate in which state socket is
    rba_EthTcp_Flag_ten: compu {0=RBA_ETHTCP_NOTHING_E (Do Nothing in the next main function), 1=RBA_ETHTCP_SEND_RST_E ((Priority 1) Send a RST frame in the next main function), 2=RBA_ETHTCP_SEND_RST_ACK_E ((Priority 2) Send a RST ACK frame in the next main function), 3=RBA_ETHTCP_SEND_ACK_FOR_FIN_ACK_E ((Priority 3) Send an ACK for the received FIN ACK in the next main function), 4=RBA_ETHTCP_SEND_FIN_ACK_E ((Priority 4) Send a FIN ACK in the next main function), 5=RBA_ETHTCP_SEND_ACK_FOR_SYN_ACK_E ((Priority 5) Send ACK for the received SYN ACK in the next main function), 6=RBA_ETHTCP_SEND_SYN_ACK_E ((Priority 6) Send a SYN ACK for the received SYN in the next main function), 7=RBA_ETHTCP_SEND_SYN_E ((Priority 7) Send a SYN in the next main function), 8=RBA_ETHTCP_SEND_ZWP_E ((Priority 8) Send a Zero Window Probe in the next main function), 9=RBA_ETHTCP_SEND_DATA_E ((Priority 9) Send data in the next main function), 10=RBA_ETHTCP_SEND_ACK_E ((Priority 10) Send ACK for the data in the next main function), 11=RBA_ETHTCP_SEND_KEEP_ALIVE_E ((Priority 11) Send a Keep Alive in the next main function)}, implementation-data-type=uint8  # Flag to indicate what is to be done in next MainFunction
    rba_EthTcp_TmrSt_ten: compu {0=RBA_ETHTCP_TMR_STOPPED_E (No timer running), 1=RBA_ETHTCP_TMR_SYNSENT_E (Timer running in SYN SENT state), 2=RBA_ETHTCP_TMR_SYNRCVD_E (Timer running in SYN RCVD state), 3=RBA_ETHTCP_TMR_RETX_E (Retransmission timer), 4=RBA_ETHTCP_TMR_ZWP_E (Zero Window Probe timer), 5=RBA_ETHTCP_TMR_FINWAIT1_CLOSING_E (Timer running in FIN WAIT 1 or CLOSING state), 6=RBA_ETHTCP_TMR_FINWAIT2_E (Timer running in FIN WAIT 2 state), 7=RBA_ETHTCP_TMR_LASTACK_E (Timer running in LAST ACK state), 8=RBA_ETHTCP_TMR_TIMEWAIT_E (Timer running in TIME WAIT state), 9=RBA_ETHTCP_TMR_KEEPALIVE_E (Keep Alive timer), 10=RBA_ETHTCP_TMR_DLYACK_E (Delayed Ack timer), 11=RBA_ETHTCP_TMR_UTO_E (User Timeout timer)}, implementation-data-type=uint8  # Flag to indicate which General timer is currently running
    rba_EthTcp_IPAddr_tun: category=UNION  # IP address union (for storing either an IPv4 or an IPv6 address)
      element IPv6Addr_au32: implementation-data-type=uint32  # IPv6 Address
      element IPv4Addr_u32: implementation-data-type=uint32  # IPv4 Address
    rba_EthTcp_HeaderFields_tst: category=STRUCTURE  # Tcp standard header fields
      7 x element, all with category=TYPE_REFERENCE:
        SeqNum_u32: implementation-data-type=uint32  # Sequence number
        AckNum_u32: implementation-data-type=uint32  # Acknowledgment number
        SrcPort_u16: implementation-data-type=uint16  # Source port
        DestPort_u16: implementation-data-type=uint16  # Destination port
        HdrLen_u16: implementation-data-type=uint16  # Header length
        WndSize_u16: implementation-data-type=uint16  # Window size
        HdrFlag_u8: implementation-data-type=uint8, sw-impl-policy=CONST  # Header flags
    rba_EthTcp_OptionFields_tst: category=STRUCTURE  # Tcp option fields
      element Mss_u16: implementation-data-type=uint16  # MSS value
    rba_EthTcp_Frame_tst: category=STRUCTURE  # Tcp frame content
      8 x element, all with category=TYPE_REFERENCE:
        LocalAddrId_u8: implementation-data-type=uint8  # Local address id on which the frame is received
        LocalAddr_st: implementation-data-type=TcpIp_SockAddrInetType  # Local IP address and Port on which the frame is received
        RemoteAddr_st: implementation-data-type=TcpIp_SockAddrInetType  # Remote IP address and Port
        Header_st: implementation-data-type=rba_EthTcp_HeaderFields_tst  # Tcp standard header fields
        Options_st: implementation-data-type=rba_EthTcp_OptionFields_tst  # Tcp options
        PayloadLen_u16: implementation-data-type=uint16  # Payload length (counts the data and the sequence number space occupied by SYN or FIN)
        DataOffset_u16: implementation-data-type=uint16  # From where the data starts
        DataLen_u16: implementation-data-type=uint16  # Data length
    rba_EthTcp_IsnGeneratorContext_tst: category=STRUCTURE  # Context for ISN generation
      4 x element, all with category=TYPE_REFERENCE:
        IsnClock_u32: implementation-data-type=uint32  # Clock used for CLOCK_DRIVEN and CLOCK_HASH_BASED generation of the ISN
        IsnSecret_u32: implementation-data-type=uint32  # Current secret used for CLOCK_HASH_BASED generation of the ISN
        IsnSecretTimer_u16: implementation-data-type=uint16  # Timer for the regeneration of the secret after a predefined time
        IsnSecretUsageCntr_u8: implementation-data-type=uint8  # Number of time the secret has been used without changing
    rba_EthTcp_Config_to: category=STRUCTURE  # Configuration structure
      18 x element, all with category=TYPE_REFERENCE:
        SynRcvdTimeOut_u32: implementation-data-type=uint32  # waiting in SYN-RCVD for confirming connection request acknowledgment after having both received and sent a connection request
        ReTxTimeOut_u32: implementation-data-type=uint32  # Timeout in multiple of tcpIpMainFunctionPeriod before an unacknowledged TCP segment is sent again
        ReTxTimerLwrBound_u32: implementation-data-type=uint32  # Lower Boundary in multiple of tcpIpMainFunctionPeriod for the dynamic retransmission timeout
        ReTxTimerUprBound_u32: implementation-data-type=uint32  # Upper Boundary in multiple of tcpIpMainFunctionPeriod for the dynamic retransmission timeout
        KeepAlvTime_u32: implementation-data-type=uint32  # Specifies the time in multiple of tcpIpMainFunctionPeriod to wait before sending the first Keep Alive probe
        KeepAlvIntl_u32: implementation-data-type=uint32  # Specifies the interval in multiple of tcpIpMainFunctionPeriod between subsequent Keep Alive probes
        UserTimeOut_u32: implementation-data-type=uint32  # Maximum amount of time in multiple of tcpIpMainFunctionPeriod that transmitted data may remain unacknowledged before TCP forcefully closes the connection
        DlyAckTimeOut_u32: implementation-data-type=uint32  # Timeout in multiple of tcpIpMainFunctionPeriod before sending a delayed acknowledgment
        FinWait2TimeOut_u32: implementation-data-type=uint32  # Timeout in multiple of tcpIpMainFunctionPeriod to receive a FIN from the remote/ node (after this node has initiated connection termination), i.e. maximum time waiting in/ FINWAIT-2 for a connection termination request from the remote TCP
        TcpMsl_u32: implementation-data-type=uint32  # Maximum segment lifetime in multiple of tcpIpMainFunctionPeriod./ (Note: TIME-WAIT = 2 x TcpIpTcpMsl to ensure that the remote node received the acknowledgment to its connection termination request | Maximum segment lifetime in multiple of tcpIpMainFunctionPeriod./ (Note: TIME-WAIT = 2 x TcpIpTcpMsl to ensure that the remote node received the / acknowledgment to its connection termination request
        IsnClockFactor_u32: implementation-data-type=uint32  # Clock factor for the Initial Sequence Number generation (needed for the equivalant of the incrementation of the current ISN timer every 4 microseconds) This is used for Clock Driven or Cryptographic methods
        IsnSecretTimeOut_u32: implementation-data-type=uint32  # Timeout in multiple of tcpIpMainFunctionPeriod for the ISN secret
        RxWindowMax_u16: implementation-data-type=uint16  # Default Rx Window size advertised by TCP (size of virtual RX buffer)
        KeepAlvProbesMax_u16: implementation-data-type=uint16  # Maximum number of times that Keep Alive Probe is retransmitted when there is no response from the remote
        SynMaxRtx_u8: implementation-data-type=uint8  # Maximum number of times that a TCP SYN is retransmitted
        TcpMaxRtx_u8: implementation-data-type=uint8  # Maximum number of times that a TCP segment is retransmitted
        ZWPMaxRetries_u8: implementation-data-type=uint8  # Maximum number of times that Zero Window Probe is retransmitted when there is no response from the remote
        TcpTtl_u8: implementation-data-type=uint8  # Default Time-to-live value of outgoing TCP packets
    rba_EthTcp_SockOpt_tst: category=STRUCTURE  # Socket options structure
      6 x element, all with category=TYPE_REFERENCE:
        SOKeepAlvTime_u32: implementation-data-type=uint32  # Specifies the time in multiple of tcpIpMainFunctionPeriod to wait before sending the first Keep Alive probe
        SOKeepAlvIntl_u32: implementation-data-type=uint32  # Specifies the interval in multiple of tcpIpMainFunctionPeriod between subsequent Keep Alive probes
        SOKeepAlvProbesMax_u16: implementation-data-type=uint16  # Maximum number of times that Keep Alive Probe is retransmitted when there is no response from the remote
        SORxWindowMax_u16: implementation-data-type=uint16  # Specifies the default local window size
        SOKeepAlvEnad_u8: implementation-data-type=uint8  # Socket Option : Keep Alive Enable/Disable
        SONaglesEnad_u8: implementation-data-type=uint32  # Socket Option : Nagle's Algorithm Enable/Disable
    rba_EthTcp_TlsTxReqBuffInfo_tst: category=STRUCTURE  # union to store tx info for each transmit request
      element TlsAppDataLen_u16: implementation-data-type=uint16  # Specifies the length of data requested to be transmitted
      element TlsEncryptedDataLen_u16: implementation-data-type=uint16  # Specifies the length of total length of application requested data and additional data added by tls module
      element TlsTxReqBuffOccupied_b: implementation-data-type=boolean  # Specifies if current buffer is occupied.
    rba_EthTcp_TlsTxReqQInfo_tst: category=STRUCTURE  # structure to hold the queues information for tx requests
      4 x element:
        TlsTxReqBuff_pst: category=DATA_REFERENCE, sw-pointer-target-props={target-category=TYPE_REFERENCE, implementation-data-type=rba_EthTcp_TlsTxReqBuffInfo_tst}  # Pointer to the queue of buffers holdin tx requests
        TlsPreviouslyAckedDataLen_u16: implementation-data-type=uint16  # Specifies the length of data acked by revious frame but is not yet confirmed to ul
        WrIndex_u8: implementation-data-type=boolean  # Specifies if write index in queue.
        RdIndex_u8: implementation-data-type=boolean  # Specifies if read index in queue.
    rba_EthTcp_DynSockTblType_tst: category=STRUCTURE  # Dynamic socket table structure
      64 x element:
        TcpSockOpt_pst: category=DATA_REFERENCE, sw-pointer-target-props={target-category=TYPE_REFERENCE, implementation-data-type=rba_EthTcp_SockOpt_tst, sw-impl-policy=CONST}  # Pointer to the Tcp socket options
        TxWndStrt_pu8: category=DATA_REFERENCE, sw-pointer-target-props={target-category=TYPE_REFERENCE, implementation-data-type=uint8, sw-impl-policy=CONST}  # Pointer to the beginning of the Tx buffer per rba_EthTcp socket
        TxWndUnAckedData_pu8: category=DATA_REFERENCE, sw-pointer-target-props={target-category=TYPE_REFERENCE, implementation-data-type=uint8, sw-impl-policy=CONST}  # Pointer to the start of already available Tx data in Tcp buffer
        TxWndNxtSnd_pu8: category=DATA_REFERENCE, sw-pointer-target-props={target-category=TYPE_REFERENCE, implementation-data-type=uint8, sw-impl-policy=CONST}  # Pointer to next data to be send -> there could be data in the buffer which is already sent, but not yet acknowledged
        TxWndNxtFree_pu8: category=DATA_REFERENCE, sw-pointer-target-props={target-category=TYPE_REFERENCE, implementation-data-type=uint8, sw-impl-policy=CONST}  # Pointer to the start of next Tcp free buffer behind the available already available Tx Data in buffer
        SockState_en: implementation-data-type=rba_EthTcp_SocketState_ten  # Flag to indicate in which state socket is
        State_en: implementation-data-type=rba_EthTcp_ConnState_ten  # Tcp socket state
        PrevState_en: implementation-data-type=rba_EthTcp_ConnState_ten  # Previous state of the Tcp socket, used for unexpected flag handling
        TcpFlag_en: implementation-data-type=rba_EthTcp_Flag_ten  # Flag to indicate what is to be done in next MainFunction
        GeneralTmrSt_en: implementation-data-type=rba_EthTcp_TmrSt_ten  # Flag to indicate which General timer is currently running
        KeepAlvTmrSt_en: implementation-data-type=rba_EthTcp_TmrSt_ten  # Flag to indicate if Keep Alive timer is currently running
        DlyAckTmrSt_en: implementation-data-type=rba_EthTcp_TmrSt_ten  # Flag to indicate if Delayed Ack timer is currently running
        UtoTmrSt_en: implementation-data-type=rba_EthTcp_TmrSt_ten  # Flag to indicate if User Timeout timer is currently running
        DomainType_u32: implementation-data-type=TcpIp_DomainType  # Domain Type (INET or INET6)
        LocalIPv4Addr_u32: implementation-data-type=uint32  # Local IPV4 address
        RemoteIPv4Addr_u32: implementation-data-type=uint32  # Remote IPV4 address
        IniSndSeqNum_u32: implementation-data-type=uint32  # Initial Send Sequence Number | Initial Send Sequence Number)
        SndSeqNum_u32: implementation-data-type=uint32  # Next sequence number to be sent
        SndAckNum_u32: implementation-data-type=uint32  # Next Ack number to be sent
        IniRcvdSeqNum_u32: implementation-data-type=uint32  # Initial Receive Sequence Number
        RcvdSeqNum_u32: implementation-data-type=uint32  # Seq Num in the latest received Rx frame
        RcvdAckNum_u32: implementation-data-type=uint8  # Ack Num in the latest received Rx frame
        UnAckedSeqNum_u32: implementation-data-type=uint32  # Oldest sequence number for which ack is not yet received
        WndUpdSeqNum_u32: implementation-data-type=uint32  # Segment Sequence Number with last window update
        WndUpdAckNum_u32: implementation-data-type=uint32  # Segment Acknowledgment Number with last window update
        GeneralTmr_u32: implementation-data-type=uint32  # General timer for this socket
        SRtt_u32: implementation-data-type=uint32  # RTTVAR value used for RTO calculation
        RttVar_u32: implementation-data-type=uint32  # Flag to indicate if Delayed Ack timer is currently running
        Rto_u32: implementation-data-type=uint32  # Calculated RTO (ReTransmission Timeout)
        KeepAlvTmr_u32: implementation-data-type=uint32  # Keep alive timer
        UtoTmr_u32: implementation-data-type=uint32  # User Timeout timer
        SockFlowLabel_u32: implementation-data-type=uint32  # Flow label of the Ethernet frame
        SockDscp_u8: implementation-data-type=uint8  # Differentiated service code point of the Ethernet frame
        LocalPort_u16: implementation-data-type=uint16  # Local port number
        RemotePort_u16: implementation-data-type=uint16  # Remote port number | Remote port number)
        RemainChannels_u16: implementation-data-type=uint16  # Remaining channels in case the present socket is listening (remaining Tcp sockets that can be forked from this socket)
        LocalMss_u16: implementation-data-type=uint16  # Local Maximum Segment Size
        TxOccupiedSizeSnd_u16: implementation-data-type=uint16  # Size of data to be sent location in the Tcp Tx buffer
        TxOccupiedSizeUnacked_u16: implementation-data-type=uint16  # Size of unacknowledged data location in the Tcp Tx buffer
        SndWndSize_u16: implementation-data-type=uint16  # Advertised window size by this socket
        RcvdWndSize_u16: implementation-data-type=uint16  # Advertised window size in the Rx frame
        RcvdMss_u16: implementation-data-type=uint16  # Received Maximum Segment Size
        RcvdDataLen_u16: implementation-data-type=uint16  # Received data length
        RcvdDataOffset_u16: implementation-data-type=uint16  # Received data offset
        TotalRcvdDataLen_u16: implementation-data-type=uint16  # Total received data length since the last sending of ack number
        OldestUnackedSegmentLength_u16: implementation-data-type=uint16  # Oldest segment length for which the full acknowledgement has not been received yet
        KeepAlvRetryCntr_u16: implementation-data-type=uint16  # Retry counter
        TlsConnectionId_uo: implementation-data-type=TcpIp_TlsConnectionIdType  # Tls connection id
        TlsRequestedConnId_uo: implementation-data-type=TcpIp_TlsConnectionIdType  # Tls requested connection id
        TlsTxReqQueueIndex_uo: implementation-data-type=TcpIp_TlsConnectionIdType  # Index to map tcp socket to Tls request queue
        LocalAddrId_u8: implementation-data-type=uint8  # Local address id
        ListenTcpSockIdx_uo: implementation-data-type=TcpIp_SocketIdType  # Tcp socket index of the listening socket in case the present socket is forked
        SockFramePrio_u8: implementation-data-type=uint8  # Frame priority
        SndHdrFlag_u8: implementation-data-type=uint8  # Header flags in the Tx frame to be sent
        RcvdHdrFlag_u8: implementation-data-type=uint8  # Header flags in the received Rx frame
        DuplicateAckCntr_u8: implementation-data-type=uint8  # Received duplicate ACK counter since the last retransmission
        GeneralRetryCntr_u8: implementation-data-type=uint8  # Retry counter
        DlyAckTmr_u8: implementation-data-type=uint8  # Delay ACK timer
        PostponeSyn_b: implementation-data-type=boolean  # Flag indicating if a SYN needs to be postponed
        PostponeFin_b: implementation-data-type=boolean  # Flag indicating if a FIN needs to be postponed
        RetransmissionFlg_b: implementation-data-type=boolean  # Flag indicating if a retransmission is running
        RttInProgress_b: implementation-data-type=boolean  # Flag indicating if an RTT measurement is in progress
        TlsHandshakeCompleted_b: implementation-data-type=boolean  # Flag indicating if Tls handshake is completed
        TlsStaticSecureConnection_b: implementation-data-type=boolean  # Flag indicating that connection is secure and open Tls connection is requested before Tcp handshake is completed.
