AUTOSAR XML (schema 4-0-3)
package /RB/RBA/rba_EthUdp/BswModuleDescriptions
  bsw module description rba_EthUdp: category=BSW_MODULE, module-id=255, outgoing-callbacks=rba_EthUdp_RxIndication  # UDP (User Datagram Protocol)
    provided-entrys:
      rba_EthUdp_Init
      rba_EthUdp_ProvideTxBuffer
      rba_EthUdp_Transmit
      rba_EthUdp_GetSocket
      rba_EthUdp_Bind
      rba_EthUdp_Close
      rba_EthUdp_ChangeParameter
      rba_EthUdp_GetSocketInfo
      rba_EthUdp_TerminateSocUsingLocalAddr
      rba_EthUdp_GetAndResetMeasurementData
      rba_EthUdp_MainFunction
      rba_EthUdp_CheckFragmentation
      rba_EthUdp_ZeroCopyFillHeader
      rba_EthUdp_ZeroCopyTransmit
package /RB/RBA/rba_EthUdp/BswModuleEntrys
  15 x bsw module entry, all with execution-context=UNSPECIFIED, sw-service-impl-policy=STANDARD:
    rba_EthUdp_Init: is-reentrant=false, is-synchronous=true, call-type=REGULAR  # This function initializes the rba_EthUdp module.
      sw service arg CurrConfig_pcst: category=DATA_REFERENCE, direction=IN, sw-pointer-target-props={target-category=VALUE, implementation-data-type=rba_EthUdp_Config_to, sw-impl-policy=CONST}  # Configuration data structure for rba_EthUdp module.
    rba_EthUdp_ProvideTxBuffer: is-reentrant=true, is-synchronous=true, call-type=REGULAR  # This service provides access to a transmit buffer. | This function is called from TcpIp component to UDP layer to provide buffer to copy payload and then transmit this data by calling rba_EthUdp_Transmit(). rba_EthUdp adds the UDP header length before requesting for buffer.
      return type ReturnValue: direction=OUT, implementation-data-type=BufReq_ReturnType  # Returns BUFREQ_OK if buffer allocation is successful. Returns BUFREQ_E_NOT_OK if development error is detected. Returns BUFREQ_E_BUSY if all buffers are in use. Returns BUFREQ_E_OVFL if requested length is greater than the available buffer length.
      5 x sw service arg:
        SocketId_u16: direction=IN, implementation-data-type=TcpIp_SocketIdType  # Socket id on which data is to be transmitted.
        DestIPv4Addr_u32: direction=IN, implementation-data-type=uint32  # IP address of the destination node to which this node wants to transmit data.
        BufIdx_pu8: category=DATA_REFERENCE, direction=OUT, sw-pointer-target-props={target-category=VALUE, implementation-data-type=uint8}  # Index to the granted buffer resource. This shall be used during transmit request.
        Buffer_ppu8: category=DATA_REFERENCE, direction=OUT, sw-pointer-target-props={target-category=VALUE, implementation-data-type=uint8}  # Pointer to the granted buffer. A double pointer shall be passed and the address of the granted buffer shall be updated into this.
        GrantLength_pcu16: category=DATA_REFERENCE, direction=INOUT, sw-pointer-target-props={target-category=VALUE, implementation-data-type=uint16, sw-impl-policy=CONST}  # Requested buffer length. The lower layer can give a smaller buffer than requested.
    rba_EthUdp_RxIndication: is-reentrant=true, is-synchronous=true, call-type=CALLBACK  # This function is called from IP layer to UDP layer after reception of a UDP datagram. | This function is called from IPv4 or IPv6 components to UDP layer after reception of a UDP datagram.
      5 x sw service arg, all with direction=IN:
        PseudoHdr_pcst: category=DATA_REFERENCE, sw-pointer-target-props={target-category=VALUE, implementation-data-type=TcpIp_PseudoHdr_tst, sw-impl-policy=CONST}  # Pointer to pseudo header structure provided by IP layer. Contains protocol type, local and remote IP address, domain and IPv4 header length.
        LocalAddrId_CtrlIdx_un: implementation-data-type=TcpIp_LocalAddrId_EthIfCtrl_tun  # Provides the local addrId or EthIf CtrlIdx (if broadcast ) of the received frame.
        RxData_pu8: category=DATA_REFERENCE, sw-pointer-target-props={target-category=VALUE, implementation-data-type=uint8}  # Pointer to the received UDP datagram.
        RxDataLen_u16: implementation-data-type=uint16  # Length of the UDP datagram.
        IsBroadcast_b: implementation-data-type=boolean  # Indicates whether received frame is IPv4 broadcast frame or not.
    rba_EthUdp_Transmit: is-reentrant=true, is-synchronous=true, call-type=REGULAR  # This service transmits data over UDP. | This function is called from TcpIp component to transmit data over UDP. In this API UDP fills the UDP header and forwards a call to rba_EthIPv4 or rba_EthIPv6 module.
      return type ReturnValue: direction=OUT, implementation-data-type=TcpIp_ReturnType  # Returns TCPIP_OK if UDP datagram transmission successful. Returns TCPIP_E_NOT_OK if UDP datagram transmission failed (general failure). Returns TCPIP_E_ARP_CACHE_MISS if UDP datagram transmission failed because of ARP cache miss.
      7 x sw service arg, all with direction=IN:
        SocketId_u16: implementation-data-type=TcpIp_SocketIdType  # Socket id on which data is to be transmitted.
        RemoteAddr_pst: category=DATA_REFERENCE, sw-pointer-target-props={target-category=VALUE, implementation-data-type=TcpIp_SockAddrType, sw-impl-policy=CONST}  # Pointer to a structure containing remote IP address and remote port.
        DataPtr_pcu8: category=DATA_REFERENCE, sw-pointer-target-props={target-category=VALUE, implementation-data-type=uint8, sw-impl-policy=CONST}  # Pointer to the buffer pointing to the upper layer data.
        Buffer_pu8: category=DATA_REFERENCE, sw-pointer-target-props={target-category=VALUE, implementation-data-type=uint8}  # Pointer to the buffer where data to be transmitted is copied.
        BufIdx_u8: implementation-data-type=uint8  # Index to the buffer where the data is copied.
        BufLength_u16: implementation-data-type=uint16  # Length of data to be transmitted.
        MetaDataPtr_pcv: category=DATA_REFERENCE, sw-pointer-target-props={target-category=VALUE, implementation-data-type=uint8, sw-impl-policy=CONST}  # MetaData provided by UpperLayer which will be given back within Up_CopyTxDataMetaData.
    rba_EthUdp_GetSocket: is-reentrant=true, is-synchronous=true, call-type=REGULAR  # By this API service the rba_EthUdp is requested to allocate a new socket.
      return type ReturnValue: direction=OUT, implementation-data-type=Std_ReturnType  # E_OK or E_NOT_OK - Result of operation.
      sw service arg Domain_u32: direction=IN, implementation-data-type=TcpIp_DomainType  # IP address family.
      sw service arg SocketIdPtr_pu16: category=DATA_REFERENCE, direction=OUT, sw-pointer-target-props={target-category=VALUE, implementation-data-type=TcpIp_SocketIdType}  # Pointer to socket identifier representing the requested socket.
      sw service arg SocketOwner_u8: direction=IN, implementation-data-type=uint8  # Specifies the upper layer which has requested to allocate a new socket.
    rba_EthUdp_Bind: is-reentrant=true, is-synchronous=true, call-type=REGULAR  # By this API rba_EthUdp is requested to bind a UDP socket to a local resource.
      return type ReturnValue: direction=OUT, implementation-data-type=Std_ReturnType  # E_OK or E_NOT_OK - Result of operation.
      4 x sw service arg:
        SocketId_u16: direction=IN, implementation-data-type=TcpIp_SocketIdType  # Socket identifier of the related local socket resource.
        LocalAddrId_u8: direction=IN, implementation-data-type=TcpIp_LocalAddrIdType  # IP address identifier representing the local IP address and EthIf controller to bind the socket.
        Port_pu16: category=DATA_REFERENCE, direction=INOUT, sw-pointer-target-props={target-category=VALUE, implementation-data-type=uint16}  # Local port to which the socket shall be bound.
        FramePrio_u8: direction=IN, implementation-data-type=uint8  # Frame priority to be set the socket.
    rba_EthUdp_Close: is-reentrant=true, is-synchronous=false, call-type=REGULAR  # By this API service rba_EthUdp stack is requested to close the socket.
      sw service arg SocketId_u16: direction=IN, implementation-data-type=TcpIp_SocketIdType  # Socket identifier of the related local socket resource.
    rba_EthUdp_ChangeParameter: is-reentrant=true, is-synchronous=true, call-type=REGULAR  # By this API service the rba_EthUdp is requested to change a parameter of a socket.
      return type ReturnValue: direction=OUT, implementation-data-type=Std_ReturnType  # Result of operation. E_OK-The parameter has been changed successfully. E_NOT_OK-The parameter could not be changed.
      sw service arg SocketId_u16: direction=IN, implementation-data-type=TcpIp_SocketIdType  # Socket identifier of the related local socket resource.
      sw service arg ParameterId_en: direction=IN, implementation-data-type=TcpIp_ParamIdType  # Identifier of the parameter to be changed.
      sw service arg ParameterValue_pcu8: category=DATA_REFERENCE, direction=IN, sw-pointer-target-props={target-category=VALUE, implementation-data-type=uint8, sw-impl-policy=CONST}  # Pointer to memory containing the new parameter value.
    rba_EthUdp_GetSocketInfo: is-reentrant=true, is-synchronous=true, call-type=REGULAR  # By this API service rba_EthUdp is requested to return the LocalAddrId and local port mapped to the socket Id.
      return type ReturnValue: direction=OUT, implementation-data-type=Std_ReturnType  # E_OK or E_NOT_OK - Result of operation.
      sw service arg SocketId_u16: direction=IN, implementation-data-type=TcpIp_SocketIdType  # Socket identifier of the related local socket resource.
      sw service arg LocalAddrId_pu8: category=DATA_REFERENCE, direction=OUT, sw-pointer-target-props={target-category=VALUE, implementation-data-type=TcpIp_LocalAddrIdType}  # Pointer to local address ID bound to the socket.
      sw service arg LocalPort_pu16: category=DATA_REFERENCE, direction=INOUT, sw-pointer-target-props={target-category=VALUE, implementation-data-type=uint16}  # Pointer to Local port of the socket.
    rba_EthUdp_TerminateSocUsingLocalAddr: is-reentrant=true, is-synchronous=false, call-type=REGULAR  # This API closes all Udp sockets except Dhcp client if input parameter LocalAddrId_u8 is TCPIP_LOCALADDRID_INVALID else closes only sockets mapped to the LocalAddrId_u8.
      sw service arg LocalAddrId_u8: direction=IN, implementation-data-type=TcpIp_LocalAddrIdType  # Local address for which sockets needs to be closed.
    rba_EthUdp_GetAndResetMeasurementData: is-reentrant=true, is-synchronous=true, call-type=REGULAR  # This function allows to read and reset UDP measurement data for diagnostic purposes.
      return type ReturnValue: direction=OUT, implementation-data-type=Std_ReturnType  # E_OK: The request was successful. E_NOT_OK: The request was not successful.
      sw service arg MeasurementIdx_u8: direction=IN, implementation-data-type=TcpIp_MeasurementIdxType  # Data index of measurement data.
      sw service arg MeasurementResetNeeded_b: direction=IN, implementation-data-type=boolean  # Flag to trigger a reset of the measurement data.
      sw service arg MeasurementDataPtr_pu32: category=DATA_REFERENCE, direction=OUT, sw-pointer-target-props={target-category=VALUE, implementation-data-type=uint32}  # Reference to data buffer, where to copy measurement data.
    rba_EthUdp_MainFunction: is-reentrant=false, is-synchronous=true, call-type=REGULAR  # By this API, the rba_EthUdp module is requested to close the socket still in the CLOSING state
    rba_EthUdp_CheckFragmentation: is-reentrant=true, is-synchronous=true, call-type=REGULAR  # This API returns the number of IP fragments if fragmentation will occur.
      return type ReturnValue: direction=OUT, implementation-data-type=Std_ReturnType  # E_OK: successful; E_NOT_OK: failed
      sw service arg SocketId_u16: direction=IN, implementation-data-type=TcpIp_SocketIdType  # Socket id on which data is to be transmitted.
      sw service arg DataLength_u16: direction=IN, implementation-data-type=uint16  # Length of data that will be request for transmission.
      sw service arg NumberOfIpFragments_pu8: category=DATA_REFERENCE, direction=OUT, sw-pointer-target-props={target-category=VALUE, implementation-data-type=uint8}  # The number of IP fragments which will be formed by IP layer during transmission.
    rba_EthUdp_ZeroCopyFillHeader: is-reentrant=true, is-synchronous=true, call-type=REGULAR  # This API prefill the reusable part of the Udp header.
      return type ReturnValue: direction=OUT, implementation-data-type=TcpIp_ReturnType  # Returns TCPIP_OK if UDP datagram filling successful. Returns TCPIP_E_NOT_OK if UDP datagram filling failed (general failure). Returns TCPIP_E_ARP_CACHE_MISS if UDP datagram filling failed because of ARP cache miss.
      4 x sw service arg:
        SocketId_u16: direction=IN, implementation-data-type=TcpIp_SocketIdType  # Socket id on which data is to be transmitted.
        RemoteAddr_pcst: category=DATA_REFERENCE, direction=IN, sw-pointer-target-props={target-category=VALUE, implementation-data-type=TcpIp_SockAddrType, sw-impl-policy=CONST}  # Pointer to a structure containing remote IP address and remote port.
        ZeroCopyArg_pcst: category=DATA_REFERENCE, direction=IN, sw-pointer-target-props={target-category=VALUE, implementation-data-type=Eth_ZeroCopyArg_tst, sw-impl-policy=CONST}  # ZeroCopy argument containing the allocated headers and the pointer to the UL data to be transmitted.
        UL_SockOwnerIdx_pu8: category=DATA_REFERENCE, direction=OUT, sw-pointer-target-props={target-category=VALUE, implementation-data-type=uint8}  # Index of the Udp socket owner.
    rba_EthUdp_ZeroCopyTransmit: is-reentrant=true, is-synchronous=true, call-type=REGULAR  # This API execute the ZeroCopy transmission.
      return type ReturnValue: direction=OUT, implementation-data-type=TcpIp_ReturnType  # Returns TCPIP_OK if UDP datagram transmission successful. Returns TCPIP_E_NOT_OK if UDP datagram transmission failed (general failure). Returns TCPIP_E_ARP_CACHE_MISS if UDP datagram transmission failed because of ARP cache miss.
      4 x sw service arg:
        SocketId_u16: direction=IN, implementation-data-type=TcpIp_SocketIdType  # Socket id on which data is to be transmitted.
        RemoteAddr_pcst: category=DATA_REFERENCE, direction=IN, sw-pointer-target-props={target-category=VALUE, implementation-data-type=TcpIp_SockAddrType, sw-impl-policy=CONST}  # Pointer to a structure containing remote IP address and remote port.
        ZeroCopyArg_pcst: category=DATA_REFERENCE, direction=IN, sw-pointer-target-props={target-category=VALUE, implementation-data-type=Eth_ZeroCopyArg_tst, sw-impl-policy=CONST}  # ZeroCopy argument containing the allocated headers and the pointer to the UL data to be transmitted.
        TxId_pu32: category=DATA_REFERENCE, direction=OUT, sw-pointer-target-props={target-category=VALUE, implementation-data-type=uint32}  # Unique identifier of the ZeroCopy transmission (valid only if ZeroCopyArg_pst->TxConfFlag_b is TRUE).
package /RB/RBA/rba_EthUdp/ImplementationDataTypes
  impl type rba_EthUdp_SocketState_ten:  # Socket state in socket table.
    compu {0=RBA_ETHUDP_SOCK_CLOSED (Socket is free.), 1=RBA_ETHUDP_SOCK_OPEN (Socket is reserved by upper layer. (rba_EthUdp_GetSocket() is called ).), 2=RBA_ETHUDP_SOCK_BOUND (Socket is bound to particular localAddress ( rba_EthUdp_GetSocket() is called).), 3=RBA_ETHUDP_SOCK_REQ_CLOSE (Socket closing is requested but not possible to be executed immediately. Will be tried again in next MainFunction.), 4=RBA_ETHUDP_SOCK_CLOSING (Socket is being closed (reset of the socket fields in progress).)}
    implementation-data-type=uint8
    type-emitter=HEADER_FILE
  impl type rba_EthUdp_Config_to: category=STRUCTURE, type-emitter=HEADER_FILE  # This container is a sub-container of TcpIpConfig and specifies the configuration parameters of the UDP (User Datagram Protocol) sub-module.
    element Ttl_u8: implementation-data-type=uint8  # Default Time-to-live value of outgoing UDP packets.
  impl type rba_EthUdp_DynSockTblType_tst: category=STRUCTURE, type-emitter=HEADER_FILE  # Structure template for Udp sockets.
    10 x element, all with category=TYPE_REFERENCE:
      DomainType_u32: implementation-data-type=TcpIp_DomainType  # Domain - IPv4/IPv6.
      SockState_en: implementation-data-type=rba_EthUdp_SocketState_ten  # Indicates the socket state.
      LocalPort_u16: implementation-data-type=uint16  # Local port used for the communication on the current socket.
      LocalAddrId_u8: implementation-data-type=TcpIp_LocalAddrIdType  # LocalAddrId used for the communication on the current socket.
      SockFramePrio_u8: implementation-data-type=uint8  # Frame priority to be used for all the transmission on the current socket.
      UL_SockOwnerIdx_u8: implementation-data-type=uint8  # Specifies the upper layer owning the socket. | Specifies the upper layer for which the socket was allocated.
      OperationOngoing_u8: implementation-data-type=uint8  # Number of currently ongoing socket operations. | Number of currently ongoing socket operations (number of APIs using global socket resources which are executed concurrently).
      SockFlowLabel_u32: implementation-data-type=uint32  # Flow label to be used for all the transmission on the current socket.
      SockDiffServiceCodePoint_u8: implementation-data-type=uint8  # Specifies the Differentiated service code point(DSCP) value for the communication on the current socket.
      SockChecksumEnabled_u8: implementation-data-type=uint8  # Specifies if the SW UDP checksum have to be computed or skipped for a specific socket connection.
