AUTOSAR XML (schema 4-2-2)
package /RB/RBA/rba_EthUdp/BswImplementations
  bsw implementation rba_EthUdp: programming-language=C, sw-version=10.0.0, ar-release-version=4.2.2, behavior=BswInternalBehavior
    code-descriptors:
      code CodeDescriptor: artifact-descriptors=autosar-engineering-object={short-label=ArEngObj, category=SWSRC}
    resource consumption rba_EthUdp_ResourceConsumption
      14 x memory section:
        RBA_ETHUDP_CONST_8: alignment=8, prefix=RBA_ETHUDP, sw-addrmethod=CONST, symbol=CONST_8
        RBA_ETHUDP_CONST_16: alignment=16, prefix=RBA_ETHUDP, sw-addrmethod=CONST, symbol=CONST_16
        RBA_ETHUDP_CONST_32: alignment=32, prefix=RBA_ETHUDP, sw-addrmethod=CONST, symbol=CONST_32
        RBA_ETHUDP_CONST_UNSPECIFIED: alignment=UNSPECIFIED, prefix=RBA_ETHUDP, sw-addrmethod=CONST, symbol=CONST_UNSPECIFIED
        RBA_ETHUDP_VAR_CLEARED_8: alignment=8, prefix=RBA_ETHUDP, sw-addrmethod=VAR_CLEARED, symbol=VAR_CLEARED_8
        RBA_ETHUDP_VAR_CLEARED_16: alignment=16, prefix=RBA_ETHUDP, sw-addrmethod=VAR_CLEARED, symbol=VAR_CLEARED_16
        RBA_ETHUDP_VAR_CLEARED_32: alignment=32, prefix=RBA_ETHUDP, sw-addrmethod=VAR_CLEARED, symbol=VAR_CLEARED_32
        RBA_ETHUDP_VAR_CLEARED_UNSPECIFIED: alignment=UNSPECIFIED, prefix=RBA_ETHUDP, sw-addrmethod=VAR_CLEARED, symbol=VAR_CLEARED_UNSPECIFIED
        RBA_ETHUDP_VAR_INIT_8: alignment=8, prefix=RBA_ETHUDP, sw-addrmethod=VAR_INIT, symbol=VAR_INIT_8
        RBA_ETHUDP_VAR_INIT_16: alignment=16, prefix=RBA_ETHUDP, sw-addrmethod=VAR_INIT, symbol=VAR_INIT_16
        RBA_ETHUDP_VAR_INIT_UNSPECIFIED: alignment=UNSPECIFIED, prefix=RBA_ETHUDP, sw-addrmethod=VAR_INIT, symbol=VAR_INIT_UNSPECIFIED
        rba_EthUdp_CODE: prefix=rba_EthUdp, sw-addrmethod=CODE, symbol=CODE
        RBA_ETHUDP_CODE: prefix=RBA_ETHUDP, sw-addrmethod=CODE, symbol=CODE
        RBA_ETHUDP_CODE_FAST: prefix=RBA_ETHUDP, sw-addrmethod=CODE_FAST, symbol=CODE_FAST
      section name prefix rba_EthUdp
      section name prefix RBA_ETHUDP
package /RB/RBA/rba_EthUdp/BswModuleDescriptions
  bsw module description rba_EthUdp
    bsw internal behavior BswInternalBehavior
package /RB/RBA/rba_EthUdp/Units
  unit NoUnit: display-name=noUnit, factor-si-to-unit=1.0, offset-si-to-unit=0.0, physical-dimension=NoUnit  # No Unit
package /RB/RBA/rba_EthUdp/PhysicalDimensions
  physical dimension NoUnit: length-exp=0
