AUTOSAR XML (schema 4-2-2)
package /RB/UBK/Project/EcucModuleConfigurationValuess
  module config rba_ArxmlGen
    EthIf (rba_ArxmlGen_Comp):
      rba_ArxmlGen_CompCategory = BswModule
      rba_ArxmlGen_CompId = 65
      rba_ArxmlGen_CompIsConfigurable = true
      rba_ArxmlGen_CompIsStandalone = false
      rba_ArxmlGen_CompIsStandardized = true
      rba_ArxmlGen_CompLongName = Ethernet Interface
      SE_MainFunctionTx (rba_ArxmlGen_ExecEntity): rba_ArxmlGen_ExecEntityCategory=Schedulable, rba_ArxmlGen_ExecEntityImplEntryRef=EthIf_MainFunctionTx
      SE_MainFunctionState (rba_ArxmlGen_ExecEntity): rba_ArxmlGen_ExecEntityCategory=Schedulable, rba_ArxmlGen_ExecEntityImplEntryRef=EthIf_MainFunctionState
      5 x rba_ArxmlGen_Memsection:
        ETHIF_CONST: rba_ArxmlGen_MemsectionDatatype_08=true, rba_ArxmlGen_MemsectionDatatype_16=true, rba_ArxmlGen_MemsectionDatatype_32=true, rba_ArxmlGen_MemsectionDatatype_UNSPECIFIED=true, rba_ArxmlGen_MemsectionAddrMethodRef=CONST
        ETHIF_VAR_CLEARED: rba_ArxmlGen_MemsectionDatatype_08=true, rba_ArxmlGen_MemsectionDatatype_16=true, rba_ArxmlGen_MemsectionDatatype_32=true, rba_ArxmlGen_MemsectionDatatype_UNSPECIFIED=true, rba_ArxmlGen_MemsectionAddrMethodRef=VAR_CLEARED
        ETHIF_VAR_INIT: rba_ArxmlGen_MemsectionDatatype_08=true, rba_ArxmlGen_MemsectionDatatype_16=true, rba_ArxmlGen_MemsectionDatatype_32=true, rba_ArxmlGen_MemsectionDatatype_UNSPECIFIED=true, rba_ArxmlGen_MemsectionAddrMethodRef=VAR_INIT
        ETHIF_CODE: rba_ArxmlGen_MemsectionAddrMethodRef=CODE
        ETHIF_CODE_FAST: rba_ArxmlGen_MemsectionAddrMethodRef=CODE_FAST
