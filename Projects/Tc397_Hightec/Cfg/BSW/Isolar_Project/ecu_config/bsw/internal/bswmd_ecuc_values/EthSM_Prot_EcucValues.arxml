AUTOSAR XML (schema 4-2-2)
package /RB/UBK/Project/EcucModuleConfigurationValuess
  module config rba_ArxmlGen
    EthSM (rba_ArxmlGen_Comp):
      rba_ArxmlGen_CompCategory = BswModule
      rba_ArxmlGen_CompId = 143
      rba_ArxmlGen_CompIsConfigurable = true
      rba_ArxmlGen_CompIsStandalone = false
      rba_ArxmlGen_CompIsStandardized = true
      rba_ArxmlGen_CompLongName = Ethernet State Manager
      EthSM_NetworkModeStateType_Enum (rba_ArxmlGen_ApplDataType):
        rba_ArxmlGen_ApplDataTypeCategory = Simple
        rba_ArxmlGen_ApplDataTypeDispFormat = %5.0f
        rba_ArxmlGen_ApplDataTypeLongName = Enum for NetworkMode StateType
        rba_ArxmlGen_ApplDataTypeCompuMethodOwnRef = EthSM_Enum_NetworkModeStateType
        rba_ArxmlGen_ApplDataTypeDataConstrOwnRef = EthSM_DataConstraint_u8
        rba_ArxmlGen_ApplDataTypeImplOwnRef = EthSM_NetworkModeStateType_Enum_impl
      EthSM_NetworkModeStateType_au8_app (rba_ArxmlGen_ApplDataType):
        rba_ArxmlGen_ApplDataTypeCategory = Array
        rba_ArxmlGen_ApplDataTypeLongName = Array of NetworkMode StateType
        rba_ArxmlGen_ApplDataTypeImplOwnRef = EthSM_NetworkModeStateType_au8_impl
        EthSM_Array_Element_of_NetworkModeStateType (rba_ArxmlGen_ApplDataTypeSub): rba_ArxmlGen_ApplDataTypeSubOwnRef=EthSM_NetworkModeStateType_Enum
      EthSM_Enum_NetworkModeStateType (rba_ArxmlGen_CompuMethod): rba_ArxmlGen_CompuMethodCategory=TextTable, rba_ArxmlGen_CompuMethodLongName=Enumeration for EthSM Network Mode State Type
        6 x rba_ArxmlGen_CompuMethodTextEntry, all with rba_ArxmlGen_CompuMethodTENumVals=1:
          rba_ArxmlGen_CompuMethodTextEntry_0: rba_ArxmlGen_CompuMethodTEIntVal=0, rba_ArxmlGen_CompuMethodTEText=ETHSM_STATE_OFFLINE
          rba_ArxmlGen_CompuMethodTextEntry_1: rba_ArxmlGen_CompuMethodTEIntVal=1, rba_ArxmlGen_CompuMethodTEText=ETHSM_STATE_WAIT_TRCVLINK
          rba_ArxmlGen_CompuMethodTextEntry_2: rba_ArxmlGen_CompuMethodTEIntVal=2, rba_ArxmlGen_CompuMethodTEText=ETHSM_STATE_WAIT_ONLINE
          rba_ArxmlGen_CompuMethodTextEntry_3: rba_ArxmlGen_CompuMethodTEIntVal=3, rba_ArxmlGen_CompuMethodTEText=ETHSM_STATE_ONLINE
          rba_ArxmlGen_CompuMethodTextEntry_4: rba_ArxmlGen_CompuMethodTEIntVal=4, rba_ArxmlGen_CompuMethodTEText=ETHSM_STATE_ONHOLD
          rba_ArxmlGen_CompuMethodTextEntry_5: rba_ArxmlGen_CompuMethodTEIntVal=5, rba_ArxmlGen_CompuMethodTEText=ETHSM_STATE_WAIT_OFFLINE
      EthSM_DataConstraint_u8 (rba_ArxmlGen_DataConstraint):
        rba_ArxmlGen_DataConstraintCategory = Physical
        rba_ArxmlGen_DataConstraintLower = 0
        rba_ArxmlGen_DataConstraintUpper = 255
        rba_ArxmlGen_DataConstraintUnitRef = NoUnit
      SE_MainFunction (rba_ArxmlGen_ExecEntity): rba_ArxmlGen_ExecEntityCategory=Schedulable, rba_ArxmlGen_ExecEntityImplEntryRef=EthSM_MainFunction
      EthSM_NetworkModeStateType_Enum_impl (rba_ArxmlGen_ImplDataType):
        rba_ArxmlGen_ImplDataTypeCategory = Simple
        rba_ArxmlGen_ImplDataTypeLongName = Enumeration for EthSM Network Mode State Type
        rba_ArxmlGen_ImplDataTypeBaseRef = uint8
      EthSM_NetworkModeStateType_au8_impl (rba_ArxmlGen_ImplDataType): rba_ArxmlGen_ImplDataTypeCategory=Array, rba_ArxmlGen_ImplDataTypeLongName=Array of NetworkModeStateType
        EthSM_Array_Element_of_NetworkModeStateType (rba_ArxmlGen_ImplDataTypeSub): rba_ArxmlGen_ImplDataTypeSubOwnRef=EthSM_NetworkModeStateType_Enum_impl
      EthSM_NetState_aen (rba_ArxmlGen_Measurement):
        rba_ArxmlGen_MeasCategory = Array
        rba_ArxmlGen_MeasDispFormat = %5.1f
        rba_ArxmlGen_MeasLongName = Gives information about states defined internally for EthSM Networks (ETHSM_STATE_OFFLINE - EthSM is initialized in this state, ETHSM_STATE_WAIT_TRCVLINK - ComM requests COMM_FULL_COMMUNICATION in this state, Ctrl and Trcv will be initialized and set to ACTIVE. EthSM waits for transceiver link state (ACTIVE),ETHSM_STATE_WAIT_ONLINE - Transceiver link state is ACTIVE. EthSM waits for IP communication (TcpIP state = ONLINE), ETHSM_STATE_ONLINE - IP communication is availabe ComM state COMM_FULL_COMMUNICATION is reached, ETHSM_STATE_ONHOLD - EthSM lost active transceiver link state, TcpIP state is still online, ETHSM_STATE_WAIT_OFFLINE - ComM requests COMM_NO_COMMUNICATION in this state)
        rba_ArxmlGen_MeasAddrMethodRef = INTERNAL_VAR_CLEARED
        rba_ArxmlGen_MeasApplDataTypeOwnRef = EthSM_NetworkModeStateType_au8_app
      5 x rba_ArxmlGen_Memsection:
        ETHSM_CONST: rba_ArxmlGen_MemsectionDatatype_08=true, rba_ArxmlGen_MemsectionDatatype_16=true, rba_ArxmlGen_MemsectionDatatype_32=true, rba_ArxmlGen_MemsectionDatatype_UNSPECIFIED=true, rba_ArxmlGen_MemsectionAddrMethodRef=CONST
        ETHSM_VAR_CLEARED: rba_ArxmlGen_MemsectionDatatype_08=true, rba_ArxmlGen_MemsectionDatatype_16=true, rba_ArxmlGen_MemsectionDatatype_32=true, rba_ArxmlGen_MemsectionDatatype_UNSPECIFIED=true, rba_ArxmlGen_MemsectionAddrMethodRef=VAR_CLEARED
        ETHSM_VAR_INIT: rba_ArxmlGen_MemsectionDatatype_08=true, rba_ArxmlGen_MemsectionDatatype_16=true, rba_ArxmlGen_MemsectionDatatype_UNSPECIFIED=true, rba_ArxmlGen_MemsectionAddrMethodRef=VAR_INIT
        ETHSM_CODE: rba_ArxmlGen_MemsectionAddrMethodRef=CODE
        ETHSM_CODE_FAST: rba_ArxmlGen_MemsectionAddrMethodRef=CODE_FAST
