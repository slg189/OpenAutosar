AUTOSAR XML (schema 4-2-2)
package /RB/UBK/Project/EcucModuleConfigurationValuess
  module config rba_ArxmlGen
    EthTSyn (rba_ArxmlGen_Comp):
      rba_ArxmlGen_CompCategory = BswModule
      rba_ArxmlGen_CompId = 164
      rba_ArxmlGen_CompIsConfigurable = true
      rba_ArxmlGen_CompIsStandalone = false
      rba_ArxmlGen_CompIsStandardized = true
      rba_ArxmlGen_CompLongName = EthernetTimeSynchronization
      SE_MainFunction (rba_ArxmlGen_ExecEntity): rba_ArxmlGen_ExecEntityCategory=Schedulable, rba_ArxmlGen_ExecEntityImplEntryRef=EthTSyn_MainFunction
      4 x rba_ArxmlGen_Memsection:
        ETHTSYN_START_SEC_CONST_UNSPECIFIED: rba_ArxmlGen_MemsectionDatatype_UNSPECIFIED=true, rba_ArxmlGen_MemsectionAddrMethodRef=CONST
        ETHTSYN_START_SEC_VAR_CLEARED_UNSPECIFIED: rba_ArxmlGen_MemsectionDatatype_UNSPECIFIED=true, rba_ArxmlGen_MemsectionAddrMethodRef=VAR_CLEARED
        ETHTSYN_START_SEC_VAR_INIT_UNSPECIFIED: rba_ArxmlGen_MemsectionDatatype_UNSPECIFIED=true, rba_ArxmlGen_MemsectionAddrMethodRef=VAR_INIT
        ETHTSYN_START_SEC_CODE: rba_ArxmlGen_MemsectionAddrMethodRef=CODE
