AUTOSAR XML (schema 4-2-2)
package /RB/UBK/Project/EcucModuleConfigurationValuess
  module config rba_ArxmlGen
    TcpIp (rba_ArxmlGen_Comp):
      rba_ArxmlGen_CompCategory = BswModule
      rba_ArxmlGen_CompId = 170
      rba_ArxmlGen_CompIsConfigurable = true
      rba_ArxmlGen_CompIsStandalone = false
      rba_ArxmlGen_CompIsStandardized = true
      rba_ArxmlGen_CompLongName = Transport Control Protocol / Internet Protocol
      TcpIp_StateType_Enum (rba_ArxmlGen_ApplDataType):
        rba_ArxmlGen_ApplDataTypeCategory = Simple
        rba_ArxmlGen_ApplDataTypeDispFormat = %5.0f
        rba_ArxmlGen_ApplDataTypeLongName = Enum for TcpIp State type
        rba_ArxmlGen_ApplDataTypeCompuMethodOwnRef = TcpIp_Enum_StateType
        rba_ArxmlGen_ApplDataTypeDataConstrOwnRef = TcpIp_DataConstraint_u8
        rba_ArxmlGen_ApplDataTypeImplOwnRef = TcpIp_StateType_Enum_impl
      TcpIp_StateType_au8_app (rba_ArxmlGen_ApplDataType):
        rba_ArxmlGen_ApplDataTypeCategory = Array
        rba_ArxmlGen_ApplDataTypeLongName = Array of TcpIp State Type
        rba_ArxmlGen_ApplDataTypeImplOwnRef = TcpIp_StateType_au8_impl
        TcpIp_Array_Element_of_StateType (rba_ArxmlGen_ApplDataTypeSub): rba_ArxmlGen_ApplDataTypeSubOwnRef=TcpIp_StateType_Enum
      TcpIp_Enum_StateType (rba_ArxmlGen_CompuMethod): rba_ArxmlGen_CompuMethodCategory=TextTable, rba_ArxmlGen_CompuMethodLongName=Enumeration for TcpIp State Type
        5 x rba_ArxmlGen_CompuMethodTextEntry, all with rba_ArxmlGen_CompuMethodTENumVals=1:
          rba_ArxmlGen_CompuMethodTextEntry_0: rba_ArxmlGen_CompuMethodTEIntVal=1, rba_ArxmlGen_CompuMethodTEText=TCPIP_STATE_ONLINE
          rba_ArxmlGen_CompuMethodTextEntry_1: rba_ArxmlGen_CompuMethodTEIntVal=2, rba_ArxmlGen_CompuMethodTEText=TCPIP_STATE_ONHOLD
          rba_ArxmlGen_CompuMethodTextEntry_2: rba_ArxmlGen_CompuMethodTEIntVal=3, rba_ArxmlGen_CompuMethodTEText=TCPIP_STATE_OFFLINE
          rba_ArxmlGen_CompuMethodTextEntry_3: rba_ArxmlGen_CompuMethodTEIntVal=4, rba_ArxmlGen_CompuMethodTEText=TCPIP_STATE_STARTUP
          rba_ArxmlGen_CompuMethodTextEntry_4: rba_ArxmlGen_CompuMethodTEIntVal=5, rba_ArxmlGen_CompuMethodTEText=TCPIP_STATE_SHUTDOWN
      TcpIp_DataConstraint_u8 (rba_ArxmlGen_DataConstraint):
        rba_ArxmlGen_DataConstraintCategory = Physical
        rba_ArxmlGen_DataConstraintLower = 0
        rba_ArxmlGen_DataConstraintUpper = 255
        rba_ArxmlGen_DataConstraintUnitRef = NoUnit
      SE_MainFunction (rba_ArxmlGen_ExecEntity): rba_ArxmlGen_ExecEntityCategory=Schedulable, rba_ArxmlGen_ExecEntityImplEntryRef=TcpIp_MainFunction
      TcpIp_StateType_Enum_impl (rba_ArxmlGen_ImplDataType):
        rba_ArxmlGen_ImplDataTypeCategory = Simple
        rba_ArxmlGen_ImplDataTypeLongName = Enumeration for TcpIp State Type
        rba_ArxmlGen_ImplDataTypeBaseRef = uint8
      TcpIp_StateType_au8_impl (rba_ArxmlGen_ImplDataType): rba_ArxmlGen_ImplDataTypeCategory=Array, rba_ArxmlGen_ImplDataTypeLongName=Array of StateType
        TcpIp_Array_Element_of_StateType (rba_ArxmlGen_ImplDataTypeSub): rba_ArxmlGen_ImplDataTypeSubOwnRef=TcpIp_StateType_Enum_impl
      TcpIp_EthIfCtrlSt_aen (rba_ArxmlGen_Measurement):
        rba_ArxmlGen_MeasCategory = Array
        rba_ArxmlGen_MeasDispFormat = %5.1f
        rba_ArxmlGen_MeasLongName = Gives Information about TCP/IP stack state for a specific EthIf controller (TCPIP_STATE_ONLINE i.e. communication via at least one IP address is possible, TCPIP_STATE_ONHOLD i.e. no communication is currently possible (e.g. link down), TCPIP_STATE_OFFLINE i.e. no communication is possible, TCPIP_STATE_STARTUP i.e. IP address assignment in progress or ready for manual start communication is currently not possible, TCPIP_STATE_SHUTDOWN i.e. release of resources using the EthIf controller, release of IP address assignment.)
        rba_ArxmlGen_MeasAddrMethodRef = INTERNAL_VAR_CLEARED
        rba_ArxmlGen_MeasApplDataTypeOwnRef = TcpIp_StateType_au8_app
      8 x rba_ArxmlGen_Memsection:
        TCPIP_CONST: rba_ArxmlGen_MemsectionDatatype_08=true, rba_ArxmlGen_MemsectionDatatype_16=true, rba_ArxmlGen_MemsectionDatatype_32=true, rba_ArxmlGen_MemsectionDatatype_UNSPECIFIED=true, rba_ArxmlGen_MemsectionAddrMethodRef=CONST
        TCPIP_VAR_CLEARED: rba_ArxmlGen_MemsectionDatatype_08=true, rba_ArxmlGen_MemsectionDatatype_16=true, rba_ArxmlGen_MemsectionDatatype_32=true, rba_ArxmlGen_MemsectionDatatype_UNSPECIFIED=true, rba_ArxmlGen_MemsectionAddrMethodRef=VAR_CLEARED
        TCPIP_CALLOUT_CODE: rba_ArxmlGen_MemsectionAddrMethodRef=CALLOUT_CODE
        TCPIP_VAR_INIT: rba_ArxmlGen_MemsectionDatatype_08=true, rba_ArxmlGen_MemsectionDatatype_16=true, rba_ArxmlGen_MemsectionDatatype_32=true, rba_ArxmlGen_MemsectionDatatype_UNSPECIFIED=true, rba_ArxmlGen_MemsectionAddrMethodRef=VAR_INIT
        TCPIP_CODE: rba_ArxmlGen_MemsectionAddrMethodRef=CODE
        TCPIP_VAR_FAST_INIT: rba_ArxmlGen_MemsectionDatatype_UNSPECIFIED=true, rba_ArxmlGen_MemsectionAddrMethodRef=VAR_FAST_INIT
        TCPIP_CODE_FAST: rba_ArxmlGen_MemsectionAddrMethodRef=CODE_FAST
        TCPIP_CONFIG_DATA_POSTBUILD: rba_ArxmlGen_MemsectionDatatype_UNSPECIFIED=true, rba_ArxmlGen_MemsectionAddrMethodRef=CONFIG_DATA_POSTBUILD
