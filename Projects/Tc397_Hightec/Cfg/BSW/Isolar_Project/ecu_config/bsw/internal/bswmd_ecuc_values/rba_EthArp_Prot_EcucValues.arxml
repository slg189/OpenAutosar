AUTOSAR XML (schema 4-2-2)
package /RB/UBK/Project/EcucModuleConfigurationValuess
  module config rba_ArxmlGen
    rba_EthArp (rba_ArxmlGen_Comp):
      rba_ArxmlGen_CompCategory = BswModule
      rba_ArxmlGen_CompId = 255
      rba_ArxmlGen_CompIsConfigurable = true
      rba_ArxmlGen_CompIsStandalone = false
      rba_ArxmlGen_CompIsStandardized = false
      rba_ArxmlGen_CompLongName = Address Resolution Protocol
      4 x rba_ArxmlGen_Memsection:
        RBA_ETHARP_CONST: rba_ArxmlGen_MemsectionDatatype_UNSPECIFIED=true, rba_ArxmlGen_MemsectionAddrMethodRef=CONST
        RBA_ETHARP_VAR_CLEARED: rba_ArxmlGen_MemsectionDatatype_UNSPECIFIED=true, rba_ArxmlGen_MemsectionAddrMethodRef=VAR_CLEARED
        RBA_ETHARP_VAR_INIT: rba_ArxmlGen_MemsectionDatatype_08=true, rba_ArxmlGen_MemsectionAddrMethodRef=VAR_INIT
        RBA_ETHARP_CODE: rba_ArxmlGen_MemsectionAddrMethodRef=CODE
