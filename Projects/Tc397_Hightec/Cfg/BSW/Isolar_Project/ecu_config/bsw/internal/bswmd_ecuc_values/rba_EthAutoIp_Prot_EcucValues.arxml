AUTOSAR XML (schema 4-2-2)
package /RB/UBK/Project/EcucModuleConfigurationValuess
  module config rba_ArxmlGen
    rba_EthAutoIp (rba_ArxmlGen_Comp):
      rba_ArxmlGen_CompCategory = BswModule
      rba_ArxmlGen_CompId = 255
      rba_ArxmlGen_CompIsConfigurable = true
      rba_ArxmlGen_CompIsStandalone = false
      rba_ArxmlGen_CompIsStandardized = false
      rba_ArxmlGen_CompLongName = Automatic Address Configuration Protocol
      4 x rba_ArxmlGen_Memsection:
        RBA_ETHAUTOIP_CONST: rba_ArxmlGen_MemsectionDatatype_UNSPECIFIED=true, rba_ArxmlGen_MemsectionAddrMethodRef=CONST
        RBA_ETHAUTOIP_VAR_CLEARED: rba_ArxmlGen_MemsectionDatatype_08=true, rba_ArxmlGen_MemsectionDatatype_UNSPECIFIED=true, rba_ArxmlGen_MemsectionAddrMethodRef=VAR_CLEARED
        RBA_ETHAUTOIP_VAR_INIT: rba_ArxmlGen_MemsectionDatatype_UNSPECIFIED=true, rba_ArxmlGen_MemsectionAddrMethodRef=VAR_INIT
        RBA_ETHAUTOIP_CODE: rba_ArxmlGen_MemsectionAddrMethodRef=CODE
