AUTOSAR XML (schema 4-2-2)
package /RB/UBK/Project/EcucModuleConfigurationValuess
  module config rba_ArxmlGen
    rba_EthIPv4 (rba_ArxmlGen_Comp):
      rba_ArxmlGen_CompCategory = BswModule
      rba_ArxmlGen_CompId = 255
      rba_ArxmlGen_CompIsConfigurable = true
      rba_ArxmlGen_CompIsStandalone = false
      rba_ArxmlGen_CompIsStandardized = false
      rba_ArxmlGen_CompLongName = Internet Protocol version 4
      5 x rba_ArxmlGen_Memsection:
        RBA_ETHIPV4_CONST: rba_ArxmlGen_MemsectionDatatype_UNSPECIFIED=true, rba_ArxmlGen_MemsectionAddrMethodRef=CONST
        RBA_ETHIPV4_VAR_CLEARED: rba_ArxmlGen_MemsectionDatatype_32=true, rba_ArxmlGen_MemsectionDatatype_UNSPECIFIED=true, rba_ArxmlGen_MemsectionAddrMethodRef=VAR_CLEARED
        RBA_ETHIPV4_VAR_INIT: rba_ArxmlGen_MemsectionDatatype_16=true, rba_ArxmlGen_MemsectionDatatype_UNSPECIFIED=true, rba_ArxmlGen_MemsectionAddrMethodRef=VAR_INIT
        RBA_ETHIPV4_CODE: rba_ArxmlGen_MemsectionAddrMethodRef=CODE
        RBA_ETHIPV4_CODE_FAST: rba_ArxmlGen_MemsectionAddrMethodRef=CODE_FAST
