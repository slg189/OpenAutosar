AUTOSAR XML (schema 4-2-2)
package /RB/UBK/Project/EcucModuleConfigurationValuess
  module config rba_ArxmlGen
    rba_EthUdp (rba_ArxmlGen_Comp):
      rba_ArxmlGen_CompCategory = BswModule
      rba_ArxmlGen_CompId = 255
      rba_ArxmlGen_CompIsConfigurable = true
      rba_ArxmlGen_CompIsStandalone = false
      rba_ArxmlGen_CompIsStandardized = false
      rba_ArxmlGen_CompLongName = Ethernet User Datagram Protocol
      5 x rba_ArxmlGen_Memsection:
        RBA_ETHUDP_CONST: rba_ArxmlGen_MemsectionDatatype_08=true, rba_ArxmlGen_MemsectionDatatype_16=true, rba_ArxmlGen_MemsectionDatatype_32=true, rba_ArxmlGen_MemsectionDatatype_UNSPECIFIED=true, rba_ArxmlGen_MemsectionAddrMethodRef=CONST
        RBA_ETHUDP_VAR_CLEARED: rba_ArxmlGen_MemsectionDatatype_08=true, rba_ArxmlGen_MemsectionDatatype_16=true, rba_ArxmlGen_MemsectionDatatype_32=true, rba_ArxmlGen_MemsectionDatatype_UNSPECIFIED=true, rba_ArxmlGen_MemsectionAddrMethodRef=VAR_CLEARED
        RBA_ETHUDP_VAR_INIT: rba_ArxmlGen_MemsectionDatatype_08=true, rba_ArxmlGen_MemsectionDatatype_16=true, rba_ArxmlGen_MemsectionDatatype_UNSPECIFIED=true, rba_ArxmlGen_MemsectionAddrMethodRef=VAR_INIT
        RBA_ETHUDP_CODE: rba_ArxmlGen_MemsectionAddrMethodRef=CODE
        RBA_ETHUDP_CODE_FAST: rba_ArxmlGen_MemsectionAddrMethodRef=CODE_FAST
