AUTOSAR XML (schema 4-2-2)
package /AUTOSAR_Dem/EcucModuleDefs
  module definition Dem [0..1]: category=VENDOR_SPECIFIC_MODULE_DEFINITION, refined-module-def=Dem, variants pre-compile  # Configuration of the Dem (Diagnostic Event Manager) module.
    container DemConfigSet  # This container contains the configuration parameters and sub containers of the Dem module supporting multiple configuration sets.
      container DemComponent [0..*]  # This container configures the monitored components and system dependencies.
        function name DemComponentFailedCallbackFnc [0..1]: multiplicity set at pre-compile, set at pre-compile  # Specifies the function to be called on component failed status changes.
        boolean DemComponentIgnoresPriority [0..1]: multiplicity set at pre-compile, set at pre-compile, default-value=false  # This configuration switch defines, whether the priority of events at this component shall be ignored.
        boolean DemComponentFailedCallbackUsePort [0..1]: multiplicity set at pre-compile, set at pre-compile, default-value=false  # Specifies whether CBStatusComp_{ComponentName} for component change notifications shall be provided.
        integer DemRbComponentAllowedRecoveries [0..1]: 0..255, multiplicity set at pre-compile, origin=RB:AR40.4.0.0:2012-06-01, set at pre-compile, default-value=255  # Number of allowed recoveries at a node during one ignition cycle. To limit system toggeling for unrobust monitorings.
        reference DemImmediateChildComponentRef [0..*]: multiplicity set at pre-compile, set at pre-compile, destination=DemComponent  # Reference to all immediate children of the current component.
      container DemDTC [0..65535]  # This container contains the configuration (parameters) for DemUdsDTC.
        integer DemDTCFunctionalUnit [0..1]: 0..255, scope=ECU, multiplicity set at pre-compile, set at pre-compile  # DTCFuncitonalUnit is a 1-byte value which identifies the corresponding basic vehicle / system function which reports the DTC. This parameter is necessary for the report of severity information. | If this parameter is configured for no DTC, the Dem provides no DTC functional unit information.
        enumeration DemDTCSeverity [0..1]: {DEM_SEVERITY_CHECK_AT_NEXT_HALT, DEM_SEVERITY_CHECK_IMMEDIATELY, DEM_SEVERITY_MAINTENANCE_ONLY, DEM_SEVERITY_NO_SEVERITY}, scope=ECU, multiplicity set at pre-compile, set at pre-compile, default-value=DEM_SEVERITY_NO_SEVERITY  # DTC severity according to ISO 14229-1. This parameter depends on the automotive manufacturer. | If it is not configured, the value is counted as 'no severity'. If this parameter is configured for no DTC, the Dem provides no DTC severity information.
        integer DemDtcValue [0..1]: 1..16777214, scope=ECU, multiplicity set at pre-compile, set at pre-compile  # Unique Diagnostic Trouble Code value for UDS | (Range: 0x000000 and 0xFFFFFF are reserved for DTC groups by ISO 14229-1)
        integer DemRbAlternativeDTC [0..1]: 1..16777214, multiplicity set at pre-compile, origin=RB:AR40.8.0.0:2014-01-27, set at pre-compile  # Alternative Diagnostic Trouble Code value | (Range: 0x000000 and 0xFFFFFF are reserved for DTC groups by ISO 14229-1)
        enumeration DemWWHOBDDTCClass [0..1]: {DEM_DTC_WWHOBD_CLASS_A, DEM_DTC_WWHOBD_CLASS_B1, DEM_DTC_WWHOBD_CLASS_B2, DEM_DTC_WWHOBD_CLASS_C, DEM_DTC_WWHOBD_CLASS_NOCLASS}, scope=ECU, multiplicity set at pre-compile, set at pre-compile  # DTC Class according to ISO 14229-1 [2013 version]. This parameter depends on the automotive manufacturer. | If it is not configured, the value is marked as 'unclassified'. If this parameter is configured for no DTC, the Dem provides no DTC WWHOBD class information.
        reference DemDTCAttributesRef: set at pre-compile, destination=DemDTCAttributes  # This parameter defines the DTC Attributes associated with the DemDTC.
        reference DemObdDTCRef [0..1]: multiplicity set at pre-compile, set at pre-compile, destination=DemObdDTC  # This parameter defines the OBD DTC configuration associated with the DemDTC. | It is allowed to have events without a OBD DTC.
      container DemDTCAttributes [0..65535]  # This container contains the configuration (parameters) for DemDTCAttributes.
        boolean DemAgingAllowed: scope=ECU, set at pre-compile  # Switch to allow aging/unlearning of the event or not. | true: aging allowed false: aging not allowed
        integer DemAgingCycleCounterThreshold [0..1]: 0..255, scope=ECU, set at pre-compile  # Number of aging cycles needed to unlearn/delete the event.
        integer DemAgingCycleCounterThresholdForTFSLC [0..1]: 1..255, scope=ECU, multiplicity set at pre-compile, set at pre-compile  # Number of aging cycles needed to reset the testFailedSinceLastClear Bit.When it is not configured, aging of TFSLC is not performed. Value has to be greater than 'DemAgingCycleCounterThreshold'. The parameter DemStatusBitHandlingTestFailedSinceLastClear has to be configured as "DEM_STATUS_BIT_AGING_AND_DISPLACEMENT". AgingCycleCounterThresholdForTFSLC is not supported if:-> Event is configured for Fast aging (demAgingCycleCounterThreshold = 0).-> No DTC mapped to the Event.
        integer DemDTCPriority: 1..255, scope=ECU, set at pre-compile  # Priority of the event/dtc, in view of full event buffer. A lower value means higher priority.
        enumeration DemDTCSignificance [0..1]: {DEM_EVENT_SIGNIFICANCE_FAULT, DEM_EVENT_SIGNIFICANCE_OCCURRENCE}, scope=ECU, multiplicity set at pre-compile, set at pre-compile  # Significance of the event, which indicates additional information concerning fault classification and resolution. | It can be mapped as Dem-internal data element. It shall be configured, if it is a part of event related data.
        integer DemEventMemoryEntryFdcThresholdStorageValue [0..1]: 1..126, multiplicity set at pre-compile, set at pre-compile  # Threshold to allocate an event memory entry and to capture the Freeze Frame.
        boolean DemImmediateNvStorage: scope=ECU, set at pre-compile  # Switch to enable immediate storage triggering of an according event memory entriy persistently to NVRAM. If it is enabled, immediate storage in Event memory will happen e.g. on every increment of occurrence counter and on Clear. | true: immediate non-volatile storage triggering enabled false: immediate non-volatile storage triggering disabled
        integer DemMaxNumberFreezeFrameRecords [0..1]: 0..255, scope=ECU, multiplicity set at pre-compile, set at pre-compile  # This parameter defines the number of according freeze frame records, which can maximal be stored for this event. Therefore all these freeze frame records have the same freeze frame class. | This parameter is only required for calculated record numeration (refer to DemTypeOfFreezeFrameRecordNumeration).
        reference DemAgingCycleRef: scope=ECU, origin=AUTOSAR_ECUC V1.0.0, set at pre-compile, destination=DemOperationCycle  # Reference to the cycle which is triggering the aging of the event.
        reference DemExtendedDataClassRef [0..1]: multiplicity set at pre-compile, set at pre-compile, destination=DemExtendedDataClass  # This reference defines the link to an extended data class sampler.
        reference DemFreezeFrameClassRef [0..1]: multiplicity set at pre-compile, set at pre-compile, destination=DemFreezeFrameClass  # These references define the links to a freeze frame class sampler.
        reference DemFreezeFrameRecNumClassRef [0..1]: scope=ECU, multiplicity set at pre-compile, set at pre-compile, destination=DemFreezeFrameRecNumClass  # This parameter defines the list of dedicated freeze frame record numbers associated with the diagnostic event. These record numbers are assigned to the freeze frame records (instead of calculated record numbers). | This parameter is only required for configured record numeration (refer to DemTypeOfFreezeFrameRecordNumeration).
        reference DemJ1939DTC_J1939NodeRef [0..1]: multiplicity set at pre-compile, set at pre-compile, destination=DemJ1939Node  # Reference to a J1939 Node
        reference DemJ1939ExpandedFreezeFrameClassRef [0..1]: multiplicity set at pre-compile, set at pre-compile, destination=DemJ1939FreezeFrameClass  # These references define the links to a J1939 freeze frame class sampler.
        reference DemJ1939FreezeFrameClassRef [0..1]: multiplicity set at pre-compile, set at pre-compile, destination=DemJ1939FreezeFrameClass  # These references define the links to a J1939 freeze frame class sampler.
        choice reference DemMemoryDestinationRef [0..2]: scope=ECU, multiplicity set at pre-compile, set at pre-compile, destination=[DemMirrorMemory, DemPrimaryMemory, DemUserDefinedMemory]  # The event destination assigns events to none, one or two origins. If no event destination is assigned to a specific event, the event is handled internally and is not visible externally to the Dcm. If more than one event destination is assigned to a specific event, the event can be present in the corresponding origins.
        reference DemWWHOBDFreezeFrameClassRef [0..1]: multiplicity set at pre-compile, set at pre-compile, destination=DemFreezeFrameClass  # This reference defines the link to a WWH-OBD freeze frame class sampler.
      container DemDebounceCounterBasedClass [0..65535]  # This container contains the configuration of Debounce Counter Based Class
        enumeration DemDebounceBehavior: {DEM_DEBOUNCE_FREEZE, DEM_DEBOUNCE_RESET}, set at pre-compile  # This parameter defines how the event debounce algorithm will behave, if a related enable condition is not fulfilled or ControlDTCSetting of the related event is disabled.
        integer DemDebounceCounterDecrementStepSize: 1..32768, scope=ECU, set at pre-compile  # Defines the step size for decrementation of the internal debounce counter (PREPASSED).
        integer DemDebounceCounterFailedThreshold [0..1]: 1..32767, scope=ECU, multiplicity set at pre-compile, set at pre-compile  # Defines the value of the internal debounce counter, which indicates the failed status.
        integer DemDebounceCounterIncrementStepSize: 1..32767, scope=ECU, set at pre-compile  # Defines the step size for incrementation of the internal debounce counter (PREFAILED).
        boolean DemDebounceCounterJumpDown [0..1]: scope=ECU, multiplicity set at pre-compile, set at pre-compile  # Switch for the activation of Jump-Down. | true: Jump-Down activated false: Jump-Down deactivated
        integer DemDebounceCounterJumpDownValue [0..1]: -32768..32767, scope=ECU, multiplicity set at pre-compile, set at pre-compile, default-value=0  # Jump-Down value of the internal debounce counter which is taken as initialization value for the counter when the respective step-down occurs.
        boolean DemDebounceCounterJumpUp [0..1]: scope=ECU, multiplicity set at pre-compile, set at pre-compile  # Switch for the activation of Jump-Up. | true: Jump-Up activated false: Jump-Up deactivated
        integer DemDebounceCounterJumpUpValue [0..1]: -32768..32767, scope=ECU, multiplicity set at pre-compile, set at pre-compile, default-value=0  # Jump-Up value of the internal debounce counter which is taken as initialization value for the counter when the respective step-up occurs.
        integer DemDebounceCounterPassedThreshold [0..1]: -32768..-1, scope=ECU, multiplicity set at pre-compile, set at pre-compile  # Defines the value of the internal debounce counter, which indicates the passed status.
        boolean DemDebounceCounterStorage: set at pre-compile, default-value=false  # Switch to store the debounce counter value non-volatile or not. | true: debounce counter value shall be stored non-volatile false: debounce counter value is volatile
        integer DemRbDebounceCounterDecrementStepSizeAlternative [0..1]: 1..32768, multiplicity set at pre-compile, origin=RB:AR40.6.0.0:2013-06-01, set at pre-compile  # Defines alternative step size for decrementation of the internal fault detection counter (PREPASSED) (e.g. for plant mode software). If the parameter is not configured, the value of "DemDebounceCounterDecrementStepSize" shall be considered.
        integer DemRbDebounceCounterFdcThresholdStorageValue [0..1]: 1..32767, multiplicity set at pre-compile, origin=RB:AR40.11.0.0:2015-11-20, set at pre-compile  # Threshold to allocate an event memory entry and to capture the FreezeFrame.
        integer DemRbDebounceCounterIncrementStepSizeAlternative [0..1]: 1..32767, multiplicity set at pre-compile, origin=RB:AR40.6.0.0:2013-06-01, set at pre-compile  # Defines alternative step size for incrementation of the internal fault detection counter (PREFAILED) (e.g. for plant mode software). If the parameter is not configured, the value of "DemDebounceCounterIncrementStepSize" shall be considered.
        boolean DemRbDebounceCounterJumpDownAlternative [0..1]: multiplicity set at pre-compile, origin=RB:AR40.6.0.0:2013-06-01, set at pre-compile  # Switch for the activation of Jump-Down. true: Jump-Down activated false: Jump-Down deactivated If the parameter is not configured, the value of DemDebounceCounterJumpDown shall be considered.
        integer DemRbDebounceCounterJumpDownValueAlternative [0..1]: -32768..32767, multiplicity set at pre-compile, origin=RB:AR40.6.0.0:2013-06-01, set at pre-compile  # Defines Alternative Jump down value of the internal fault detection counter. If the parameter is not configured, the value of "DemDebounceCounterJumpDownValue" shall be considered.
        boolean DemRbDebounceCounterJumpUpAlternative [0..1]: multiplicity set at pre-compile, origin=RB:AR40.6.0.0:2013-06-01, set at pre-compile  # Switch for the activation of Jump-Up. true: Jump-Up activated false: Jump-Up deactivated If the parameter is not configured, the value of "DemDebounceCounterJumpUp" shall be considered
        integer DemRbDebounceCounterJumpUpValueAlternative [0..1]: -32768..32767, multiplicity set at pre-compile, origin=RB:AR40.6.0.0:2013-06-01, set at pre-compile  # Defines Alternative Jump Up value of the internal fault detection counter. If the parameter is not configured, the value of DemDebounceCounterJumpUpValue shall be considered.
        integer DemRbDebounceCounterSuspiciousThreshold [0..1]: 1..32767, multiplicity set at pre-compile, origin=RB:AR40.11.0.0:2015-10-19, set at pre-compile  # Threshold to indicate the event is suspicious.
        string DemRbShiftView [0..1]: multiplicity set at pre-compile, origin=RB:AR40.6.0.0:2013-07-26, set at pre-compile, regular-expression=[a-zA-Z0-9_]([a-zA-Z0-9\._])*  # This parameter is added for DGS Dem. It specifies where to arrange calibration parameters of the ratioId in asap file (shiftview). DGS DSM creates diagnostic calibration parameters for ratios. If your module has own calibration parameters then give your assigned function name in a2l-file and DGS-DSM will shift the diagnostic calibration parameters to this a2l function. Otherwise define a function name for the diagnostic calibration, only.
        container DemRbDebounceCounterAlternative [0..255]: multiplicity set at pre-compile  # This container is available for configuring alternate debouncing parameters for the particular DemDebounceCounterBasedClass.This container hasDemRbDebounceCounterDecrementStepSize,DemRbDebounceCounterIncrementStepSize,DemRbDebounceCounterIsJumpUp,DemRbDebounceCounterIsJumpDown,DemRbDebounceCounterJumpUpValue,DemRbDebounceCounterJumpDownValue as alternate parameters to existing similar parameters available within DemDebounceCounterBasedClass container. Additionally, it has DemRbDebounceCounterSetRef parameter which refers to another container DemRbGeneral/DemRbDebounceCounterSet. The symbolic name of this container shall be used as input parameter(CounterParamSetId) in Std_ReturnType Dem_DebSwitchToParameters(uint8 CounterParamSetId) API.
          integer DemRbDebounceCounterDecrementStepSize: 0..32768, origin=RB:AR40.11.9.0:2016-06-02, set at pre-compile  # Defines the step size for incrementation of the internal fault detection counter (PREPASSED).
          integer DemRbDebounceCounterIncrementStepSize: 0..32767, origin=RB:AR40.11.9.0:2016-06-02, set at pre-compile  # Defines the step size for incrementation of the internal fault detection counter (PREFAILED).
          boolean DemRbDebounceCounterIsJumpDown [0..1]: multiplicity set at pre-compile, origin=RB:AR40.11.9.0:2016-06-02, set at pre-compile  # Switch for the activation of Jump-Down.true: Jump-Down activated false: Jump-Down deactivated
          boolean DemRbDebounceCounterIsJumpUp [0..1]: multiplicity set at pre-compile, origin=RB:AR40.11.9.0:2016-06-02, set at pre-compile  # Switch for the activation of Jump-Up.true: Jump-Up activated false: Jump-Up deactivated
          integer DemRbDebounceCounterJumpDownValue [0..1]: -32768..32767, multiplicity set at pre-compile, origin=RB:AR40.11.9.0:2016-06-03, set at pre-compile  # Jump-Down value of the internal fault detection counter.
          integer DemRbDebounceCounterJumpUpValue [0..1]: -32768..32767, multiplicity set at pre-compile, origin=RB:AR40.11.9.0:2016-06-02, set at pre-compile  # Jump-Up value of the internal fault detection counter.
          reference DemRbDebounceCounterSetRef: origin=RB:AR40.11.9.0:2016-06-04, set at pre-compile, destination=DemRbDebounceCounterSet  # The reference for the current Switchable DebounceCounterBasedClass Parameters.
      container DemDebounceTimeBaseClass [0..65535]  # This container contains the configuration of Debounce Counter Based Class
        enumeration DemDebounceBehavior: {DEM_DEBOUNCE_FREEZE, DEM_DEBOUNCE_RESET}, set at pre-compile  # This parameter defines how the event debounce algorithm will | behave, if a related enable condition is not fulfilled or ControlDTCSetting of the related event is disabled.
        float DemDebounceTimeFailedThreshold: 0.001..3600, scope=ECU, set at pre-compile  # Defines the time out duration for "Event Failed" qualification. | The AUTOSAR configuration standard is to use SI units, so this parameter is defined as float value in seconds. Dem configuration tools must convert this float value to the appropriate value format for the use in the software implementation of Dem.
        float DemDebounceTimePassedThreshold: 0.001..3600, scope=ECU, set at pre-compile  # Defines the time out duration for "Event Passed" qualification. | The AUTOSAR configuration standard is to use SI units, so this parameter is defined as float value in seconds. Dem configuration tools must convert this float value to the appropriate value format for the use in the software implementation of Dem.
        float DemRbDebounceTimeSuspiciousThreshold [0..1]: 0.001..3600, multiplicity set at pre-compile, origin=RB:AR40.11.0.0:2015-10-19, set at pre-compile  # Threshold to indicate the event is suspicious.
        string DemRbShiftView [0..1]: multiplicity set at pre-compile, origin=RB:AR40.6.0.0:2013-07-26, set at pre-compile, regular-expression=[a-zA-Z0-9_]([a-zA-Z0-9\._])*  # This parameter is added for DGS Dem. It specifies where to arrange calibration parameters of the ratioId in asap file (shiftview). DGS DSM creates diagnostic calibration parameters for ratios. If your module has own calibration parameters then give your assigned function name in a2l-file and DGS-DSM will shift the diagnostic calibration parameters to this a2l function. Otherwise define a function name for the diagnostic calibration, only.
      container DemDtrs [0..1]  # This container holds the configuration of DTRs collection.
        container DemDtr [0..65535]  # This container holds the configuration of one individual DTR.
          float DemDtrCompuDenominator0: scope=ECU, set at pre-compile  # Part of the conversion between the binary representation and the physical meaning analogous to the SW-C Template conversion CompuRationalCoeffs with 2 numerator coefficients and 1 denominator coefficient in the direction compuInternalToPhys. | This is the only one supported denominator value, a constant divisor. The value 0 is not allowed.
          float DemDtrCompuNumerator0: scope=ECU, set at pre-compile  # Part of the conversion between the binary representation and the physical meaning analogous to the SW-C Template conversion CompuRationalCoeffs with 2 numerator coefficients and 1 denominator coefficient in the direction compuInternalToPhys. | This is the first numerator value, which is multiplied with x^0, i.e., the offset.
          float DemDtrCompuNumerator1: scope=ECU, set at pre-compile  # Part of the conversion between the binary representation and the physical meaning analogous to the SW-C Template conversion CompuRationalCoeffs with 2 numerator coefficients and 1 denominator coefficient in the direction compuInternalToPhys. | This is the second numerator value, which is multiplied with x^1, i.e., the factor.
          integer DemDtrId: 0..65535, scope=ECU, set at pre-compile, symbolic-name-value=true  # The index identifier value assigned to this DTR. The value is generated during the Dem configuration process.
          integer DemDtrMid: 0..255, scope=ECU, set at pre-compile  # The OBDMID of the DTR. | The values 0x00, 0x20, 0x40, 0x60, 0x80, 0xA0, 0xC0, 0xE0 are reserved.
          integer DemDtrTid: 0..255, scope=ECU, set at pre-compile  # The OBDTID of the DTR.
          integer DemDtrUasid: 0..255, scope=ECU, set at pre-compile  # The UaSId the DTR data shall be scaled to, and reported together with the rescaled DTR data.
          enumeration DemDtrUpdateKind [0..1]: {DEM_DTR_UPDATE_ALWAYS, DEM_DTR_UPDATE_STEADY}, multiplicity set at pre-compile, set at pre-compile  # Update conditions applied by the Dem to reports of DTR values. Only supported if a related Event is configured. If no related Event is configured, the Dem behaves as if DemDtrUpdateKind is configured to "DEM_DTR_UPDATE_ALWAYS".
          reference DemDtrEventRef [0..1]: scope=ECU, multiplicity set at pre-compile, set at pre-compile, destination=DemEventParameter  # Reference to the DemEventParameter this DTR is related to. If the related event is not configured, the Dem cannot ensure consistency between the DTR and the event.
      container DemEventParameter [1..65535]  # This container contains the configuration (parameters) for events.
        integer DemComponentPriority [0..1]: 0..255, multiplicity set at pre-compile, set at pre-compile  # Specifies the priority within the component. A lower value means higher priority.
        boolean DemEventAvailable: scope=ECU, set at pre-compile  # This parameter configures an Event as unavailable. | It is treated by Dem as if it does not exist. true = Event is available false = Event is not available
        integer DemEventFailureCycleCounterThreshold: 1..255, scope=ECU, set at pre-compile, default-value=1  # Defines the number of failure cycles for the event based fault confirmation. | If this parameter is enabled, fault confirmation of the event is enabled accordingly.
        integer DemEventId: 1..65535, scope=ECU, set at pre-compile, symbolic-name-value=true, with-auto=true  # Unique identifier of a diagnostic event. | This parameter should not be changeable by user, because the Id should be generated by Dem itself to prevent gaps and multiple use of an Id. The events should be sequentially ordered beginning with 1 and no gaps in between.
        enumeration DemEventKind: {DEM_EVENT_KIND_BSW, DEM_EVENT_KIND_SWC}, set at pre-compile  # This parameter is used to distinguish between SW-C and BSW events. SW-C events are reported by Dem_SetEventStatus API and BSW events are reported by Dem_ReportErrorStatus API.
        boolean DemFFPrestorageSupported [0..1]: scope=ECU, set at pre-compile, default-value=false  # If this parameter is set to true, then the Prestorage of FreezeFrames is supported by the assigned event. This parameter is useful to calculate the buffer size.
        string DemRbEventDescription [0..1]: multiplicity set at pre-compile, origin=RB:AR40.4.0.0:2012-06-01, set at pre-compile  # The purpose of the specified event shall be described.
        enumeration DemReportBehavior [0..1]: {REPORT_AFTER_INIT, REPORT_BEFORE_INIT}, multiplicity set at pre-compile, set at pre-compile, default-value=REPORT_BEFORE_INIT  # Indicates the reporting behavior of the BSW Module (DemEventKind == DEM_EVENT_KIND_BSW) in order to determine the size of the reporting queue. Hint: This configuration is necessary in case of DemBswErrorBufferSize in DemGeneral is not configured | If the parameter is not defined it means REPORT_BEFORE_INIT.
        reference DemCallbackEventStatusChangedRBRef [0..1]: multiplicity set at pre-compile, origin=RB:AR40.6.0.0:2013-07-26, set at pre-compile, destination=DemCallbackEventStatusChangedRB  # This parameter provides an reference to the container which contains all the call-back functions which needs to be invoked in case of any Status Change of this corresponding Event.
        reference DemComponentClassRef [0..1]: multiplicity set at pre-compile, set at pre-compile, destination=DemComponent  # Reference to the monitored component.
        reference DemDTCRef [0..1]: multiplicity set at pre-compile, set at pre-compile, destination=DemDTC  # This parameter defines the DTC configuration (typically Uds) associated with the diagnostic event. | It is allowed to have events without a DTC (e.g. for ECU-internal events triggering safety reactions without being reported via diagnostic communication). The same DemDTCAttributes can be used from several events, to combine these (refer to chapter "Combination of diagnostic event").
        reference DemEnableConditionGroupRef [0..1]: scope=ECU, multiplicity set at pre-compile, origin=AUTOSAR_ECUC V1.0.0, set at pre-compile, destination=DemEnableConditionGroup  # References an enable condition group.
        reference DemOBDGroupingAssociativeEventsRef [0..1]: scope=ECU, multiplicity set at pre-compile, set at pre-compile, destination=DemEventParameter  # This parameter defines a reference which points to a representative event of one group of associate events. | The "reverence event" must refer to it self. Note: One event is only allowed to be reverenced to only one group of associate events.
        reference DemOperationCycleRef: scope=ECU, origin=AUTOSAR_ECUC V1.0.0, set at pre-compile, destination=DemOperationCycle  # Kind of operation cycle for the event (e.g. power cycle, driving cycle, ...)
        reference DemStorageConditionGroupRef [0..1]: scope=ECU, multiplicity set at pre-compile, origin=AUTOSAR_ECUC V1.0.0, set at pre-compile, destination=DemStorageConditionGroup  # References a storage condition group.
        container DemCallbackClearEventAllowed [0..1]  # The presence of this container indicates that the Dem has access to a "ClearEventAllowed" callback. | In case there is a DemCallbackClearEventAllowedFnc, this parameter defines the name of the function that the Dem will call. In case there is no DemCallbackClearEventAllowedFnc, the Dem will have an R-Port requiring the interface CallbackClearEventAllowed whose name is generated by using the unique callback-prefix followed by the event name.
          function name DemCallbackClearEventAllowedFnc [0..1]: scope=ECU, multiplicity set at pre-compile, set at pre-compile  # Function name of prototype "ClearEventAllowed". For further details refer Dem563. Hint: It has presedence (Higher Prio) over DemRbGlobalCallbackClearEventAllowedFnc.
          enumeration DemClearEventAllowedBehavior: {DEM_NO_STATUS_BYTE_CHANGE, DEM_ONLY_THIS_CYCLE_AND_READINESS}, set at pre-compile, default-value=DEM_NO_STATUS_BYTE_CHANGE  # Defines the resulting UDS status byte for the related event, which must not be cleared according to the ClearEventAllowed callback. Note : If DemClearEventAllowedBehavior is configured as DEM_ONLY_THIS_CYCLE_AND_READINESS for an event, the aging and confirmation process could speed up for that Event. Currently any event which is linked to an OBD Dtc shall not be configured as DemClearEventAllowedBehavior to be set to DEM_ONLY_THIS_CYCLE_AND_READINESS(An error will be thrown for this scenario by OAW check)
        container DemCallbackEventDataChanged [0..1]  # The presence of this container indicates that the Dem has access to an "EventDataChanged" callback. (Callback on any change in Event related data i.e ENV DATA-> Ext data or freeze frame) | In case there is a DemCallbackEventDataChangedFnc, this parameter defines the name of the function that the Dem will call. In case there is no DemCallbackEventDataChangedFnc, the Dem will have an R-Port requiring the interface CallbackEventDataChanged whose name is generated by using the unique callback-prefix followed by the event name.
          function name DemCallbackEventDataChangedFnc [0..1]: scope=ECU, multiplicity set at pre-compile, set at pre-compile  # Function name of prototype "EventDataChanged". Refer [SWS_Dem_00562] for more details
        container DemCallbackEventStatusChanged [0..0]  # CURRENTLY NOT SUPPORTED.Instead use DemCallbackEventStatusChanged available in the path Dem/DemGeneral/DemCallbackEventStatusChangedRB/DemCallbackEventStatusChanged which can be referenced via DemCallbackEventStatusChangedRBRef(Dem/DemConfigSet/DemEventParameter).The presence of this container indicates, that the Dem has access to an "EventStatusChanged" callback, which the Dem will call to notify other components about the change in the status of an event. | In case there is a DemCallbackEvenStatusChangedFnc, this parameter defines the name of the function that the Dem will call. In case there is no DemCallbackEvenStatusChangedFnc, the Dem will have an R-Port requiring the interface CallbackEventStatusChanged, whose name is generated by using the unique callback-prefix followed by the event name.
          function name DemCallbackEventStatusChangedFnc [0..1]: scope=ECU, multiplicity set at pre-compile, set at pre-compile  # Function name of prototype "EventStatusChanged"
        container DemCallbackInitMForE [0..1]  # The presence of this container indicates, that the Dem has access to an "InitMonitorForEvent" callback, which the Dem will call to initialize a monitor. | In case the container has a DemCallbackInitMForEFnc, this parameter defines the name of the function that the Dem will call. In case there is no DemCallbackInitMForEFnc, the Dem will have an R-Port requiring the interface CallbackInitMonitorForEvent, whose name is generated by using the unique callback-prefix followed by the event name.
          function name DemCallbackInitMForEFnc [0..1]: multiplicity set at pre-compile, set at pre-compile  # Function name of prototype "InitMonitorForEvent". For further details refer [SWS_Dem_00256].
        choice container DemDebounceAlgorithmClass  # Debounce algorithm class: counter based, time based, or monitor internal.
          container DemDebounceCounterBased [0..1]  # This container contains the configuration (parameters) for counter based debouncing.
            reference DemDebounceCounterBasedClassRef: set at pre-compile, destination=DemDebounceCounterBasedClass  # This reference selects the DemDebounceCounterBasedClass applied for the debouncing of the DemEventParameter.
          container DemDebounceMonitorInternal [0..1]  # This container contains the configuration (parameters) for monitor internal debouncing.
            container DemCallbackGetFDC [0..1]  # DemCallbackGetFDC specifies the callback (parameter DemCallbackGetFDCFnc is present) or R-Port (no parameter DemCallbackGetFDCFnc is present) to retrieve the fault detection counter value. | In case no container is configured, no fault detection counter will be available.
              function name DemCallbackGetFDCFnc [0..1]: scope=ECU, multiplicity set at pre-compile, set at pre-compile  # This parameter defines the name of the function that the Dem will call to retrieve the fault-detection counter value from a complex driver. Refer [SWS_Dem_00263] for further details. Hint:The function name must not be same as any Dem API's
              boolean DemRbGeneralCallbackGetFDCFncUsed [0..1]: multiplicity set at pre-compile, origin=RB:AR40.7.0.0:2013-07-24, set at pre-compile, default-value=false  # If configured to TRUE, the global callback has to be configured under DemGeneral/demRbGeneral/demRbGlobalCallbackGetFaultDetectionCounter. General function name used for "GetFaultDetectionCounter".
          container DemDebounceTimeBase [0..1]  # This container contains the configuration (parameters) for time based debouncing.
            reference DemDebounceTimeBaseRef: set at pre-compile, destination=DemDebounceTimeBaseClass  # This reference selects the DemDebounceTimeBaseClass applied for the debouncing of the DemEventParameter.
        container DemIndicatorAttribute [0..255]  # This container contains the event specific configuration of Indicators.
          enumeration DemIndicatorBehaviour: {DEM_INDICATOR_BLINKING, DEM_INDICATOR_BLINK_CONT, DEM_INDICATOR_CONTINUOUS, DEM_INDICATOR_FAST_FLASH, DEM_INDICATOR_SLOW_FLASH}, scope=ECU, set at pre-compile  # Behaviour of the linked indicator
          integer DemIndicatorFailureCycleCounterThreshold [0..1]: 0..255, scope=ECU, multiplicity set at pre-compile, set at pre-compile, default-value=0  # Defines the number of failure cycles for the WarningIndicatorOnCriteria.
          integer DemIndicatorHealingCycleCounterThreshold: 0..255, scope=ECU, set at pre-compile  # Defines the number of healing cycles for the WarningIndicatorOffCriteria.
          boolean DemRbIndicatorApiControl [0..1]: multiplicity set at pre-compile, origin=RB:AR40.4.8.0:2014-07-31, set at pre-compile, default-value=false  # This configuration switch defines whether the indicator state is controlled using the API Dem_SetIndicatorStatusForEvent, according to DemIndicatorBehaviour
          reference DemIndicatorRef: scope=ECU, set at pre-compile, destination=DemIndicator  # Reference to the used indicator.
        container DemRbDoc [0..1]: multiplicity set at pre-compile  # Documentation | This container contains the documentation for the Event.
          add info DemRbDocFailedCriteria: origin=RB:AR40.8.0.0:2014-06-10, set at pre-compile  # Failure detection criteria | Verbal description of the recognition method for the FAILED/PREFAILED status, i.e. how it is detected that a failure is present. If applicable, describe what limit values or thresholds are used. If several alternative strategies are implemented, all of them shall be described.
          add info DemRbDocFailedDebouncing: origin=RB:AR40.8.0.0:2014-06-10, set at pre-compile  # Monitoring-internal failure debouncing | This shall describe how long or how often the failure detection criteria has to be detected before the FAILED/PREFAILED status is reported to the Dem. Note: Describe monitoring-internal debouncing only. If no monitoring-internal debouncing is implemented, then enter an empty paragraph.
          add info DemRbDocFaultReaction: origin=RB:AR40.8.0.0:2014-06-10, set at pre-compile  # Monitoring-internal fault reaction | Describe what further actions are triggered in case of a failure besides the reporting to the Dem. Note: Do not describe FiM-related failure reactions. If no failure reactions are triggered, enter an empty paragraph.
          add info DemRbDocPassedCriteria: origin=RB:AR40.8.0.0:2014-06-10, set at pre-compile  # Passed detection criteria | Verbal description of the recognition method for the PASSED/PREPASSED status, i.e. how it is detected that no failure is present. If applicable, describe what limit values or thresholds are used. If several alternative strategies are implemented, all of them shall be described.
          add info DemRbDocPassedDebouncing: origin=RB:AR40.8.0.0:2014-06-10, set at pre-compile  # Monitoring-internal passed debouncing | This shall describe how long or how often the passed detection criteria has to be detected before the PASSED/PREPASSED status is reported to the Dem. Note: Describe monitoring-internal debouncing only. If no monitoring-internal debouncing is implemented, then enter an empty paragraph.
          add info DemRbDocTestPrecondition: origin=RB:AR40.8.0.0:2014-06-10, set at pre-compile  # Monitoring-internal enable condition | Under which preconditions does a test take place? Note: Describe monitoring-internal preconditions only (not Dem-configured enable conditions). If no monitoring-internal precondition is implemented, then enter an empty paragraph.
          container DemRbFDoc [0..*]: multiplicity set at pre-compile  # Formalized description | This container contains the formalized documentation of the monitoring reporting this Dem event. If a (PRE)PASSED/(PRE)FAILED status can be detected in multiple ways, create one container instance for each way.
            enumeration DemRbFDocApplObdLaw: origin=RB:AR40.8.0.0:2014-06-10, set at pre-compile  # OBD law reference | Filling out this element is needed for legally required events. If the event is not legally required, please select "none". For further information contact your local legislation expert.
              none
              e13_CCR_P_1968_2  # 13 CCR ÃÂ§ 1968.2
              e13_CCR_P_1971_1  # 13 CCR ÃÂ§ 1971.1
              e70_220_EEC_ECE_R83  # EU 70/220/EEC, ECE R83
              EU_595_2009_EC_ECE_R49  # EU 595/2009/EC, ECE R49
              other
            string DemRbFDocApplObdLawOther [0..1]: multiplicity set at pre-compile, origin=RB:AR40.8.0.0:2014-06-10, set at pre-compile, regular-expression=[a-zA-Z0-9_]([a-zA-Z0-9\._])*  # OBD law reference other | This element has to be filled out, if 'other' is selected for OBD law reference. For further information contact your local legislation expert.
            string DemRbFDocApplObdLawSection [0..1]: multiplicity set at pre-compile, origin=RB:AR40.8.0.0:2014-06-10, set at pre-compile  # OBD law section | Filling out this element is needed for legally required events. For further information contact your local legislation expert.
            add info DemRbFDocFailedCriterion: origin=RB:AR40.8.0.0:2014-06-10, set at pre-compile  # Failure detection criterion | Formal description of the recognition method for the FAILED/PREFAILED status, i.e. how it is detected that a failure is present. This shall be formulated as an expression based on measurement variables and calibration parameters. If applicable measurement variables and calibration parameters are not available and there is exactly one instance of the formalized description container, then enter an empty paragraph. If applicable measurement variables and calibration parameters are not available and there is more than one instance of the formalized description container, then enter an textual description.
            add info DemRbFDocFailedDebouncing: origin=RB:AR40.8.0.0:2014-06-10, set at pre-compile  # Monitoring-internal failure debouncing | This shall describe how long or how often the failure detection criteria has to be detected before the FAILED/PREFAILED status is reported to the Dem. This shall be formulated as an expression based on measurement variables and calibration parameters. Note: Describe monitoring-internal debouncing only. If no monitoring-internal debouncing is implemented, then enter an empty paragraph.
            string DemRbFDocMonitoredComponentOther [0..1]: multiplicity set at pre-compile, origin=RB:AR40.8.0.0:2014-06-10, set at pre-compile  # Monitored component other | Specification of the monitored component or monitored system, if not included in the list (DemFDocMonitoredComponent).
            add info DemRbFDocMonitoringDeactivation: origin=RB:AR40.8.0.0:2014-06-10, set at pre-compile  # Monitoring deactivation | Typically a simple condition which deactivates the monitoring (at least report to DEM will be suppressed/deactivated). This might e.g. be a monitor-internal, calibratable parameter to deactivate the calculation of the fault detection criterion. The condition does not represent a physical necessity. Also it does not change during ECU runtime. Therefore it is not an enable condition. If no deactivation condition is implemented, then enter an empty paragraph.
            enumeration DemRbFDocMonitoringFrequency: origin=RB:AR40.8.0.0:2014-06-10, set at pre-compile  # Monitoring frequency | Describes how often the monitoring algorithm is calculated. "continuous": does not have a precondition or may only depend on the following preconditions: battery voltage, ignition, altitude, ambient temperature, barometric pressure, can initialization "multiple": uses additional preconditions (besides the ones listed above) but runs always if preconditions are fulfilled. "once per driving cycle": only runs once per driving cycle "once per driving cycle keep alive": only runs during postrun "once per lifetime": only runs once per ecu lifetime
              continuous
              multiple
              once_per_driving_cycle  # once per driving cycle
              once_per_driving_cycle_keep_alive  # once per driving cycle keep alive
              once_per_lifetime  # once per lifetime
            enumeration DemRbFDocMonitoringStrategyComprehensiveComp: origin=RB:AR40.8.0.0:2014-06-10, set at pre-compile  # General monitoring strategy for comprehensive component | General classification of the monitoring strategy for Comprehensive Components according to the definitions of the California Air Ressources Board CARB. In case a "Comprehensive Component" monitoring strategy is selected above please enter here the general monitoring strategy according to CARBs definition. For monitored components other than comprehensive components select "none".
              none
              Input_Open_Circuit  # input open circuit
              Input_Out_of_Range_Low  # input out of range low
              Input_Out_of_Range_High  # input out of range high
              Input_Rationality_Low  # input rationality low
              Input_Rationality_High  # input rationality high
              Input_Other_Rationality  # input other rationality
              Output_Open_Circuit  # output open circuit
              Output_Shorted_Low  # output shorted low
              Output_Shorted_High  # output shorted high
              Output_Functional  # output functional
            string DemRbFDocMonitoringStrategyOther [0..1]: multiplicity set at pre-compile, origin=RB:AR40.8.0.0:2014-06-10, set at pre-compile  # Other Monitoring strategy | Brief description of the basic idea for the fault detection criterion of the monitoring. Only needed if "Monitoring strategy" "other" is selected.
            add info DemRbFDocPassedCriterion: origin=RB:AR40.8.0.0:2014-06-10, set at pre-compile  # Passed detection criterion | Formal description of the recognition method for the PASSED/PREPASSED status, i.e. how it is detected that no failure is present. This shall be formulated as an expression based on measurement variables and calibration parameters. If applicable measurement variables and calibration parameters are not available and there is exactly one instance of the formalized description container, then enter an empty paragraph. If applicable measurement variables and calibration parameters are not available and there is more than one instance of the formalized description container, then enter an textual description.
            add info DemRbFDocPassedDebouncing: origin=RB:AR40.8.0.0:2014-06-10, set at pre-compile  # Monitoring-internal passed debouncing | This shall describe how long or how often the passed detection criteria has to be detected before the PASSED/PREPASSED status is reported to the Dem. This shall be formulated as an expression based on measurement variables and calibration parameters. Note: Describe monitoring-internal debouncing only. If no monitoring-internal debouncing is implemented, then enter an empty paragraph.
            add info DemRbFDocTestPrecondition: origin=RB:AR40.8.0.0:2014-06-10, set at pre-compile  # Test precondition | Describe all atomic conditions which must be fulfilled so that the fault detection criterion can be calculated with a meaningful result. Atomic condition means a single condition such as "battery voltage above minimum". Describe in formal syntax if feasible - otherwise use text. Note: The fault detection criterion shall not be repeated here, neither partly nor completely. Note: Do not repeat a fault detection inactive condition "Monitoring deactivation".
            reference DemRbFDocMonitoredComponent: origin=RB:AR40.8.0.0:2014-06-10, set at pre-compile, destination=DemRbGDocMonitoredComponent  # Monitored component | What is monitored? Select the monitored component or monitored system from the list.
            reference DemRbFDocMonitoringStrategy: origin=RB:AR40.8.0.0:2014-06-10, set at pre-compile, destination=DemRbGDocMonitoringStrategy  # Monitoring strategy | Brief description of the basic idea for the fault detection criterion of the monitoring. Select appropriate value of the monitoring strategy from the list. If none of the values fits, choose "other" and enter description in "Other Monitoring strategy".
        container DemRbEventClass  # This container contains the configuaration (parameters) for EventClass
          string DemRbDgsDfcName [0..1]: multiplicity set at pre-compile, origin=RB:AR40.4.0.0:2012-06-01, set at pre-compile, regular-expression=[a-zA-Z0-9_]([a-zA-Z0-9\._])*  # This parameter is added for DGS Dem. It specifies the legacy DFC (Diagnostic Fault Code) name used in DGS systems.
          integer DemRbEventBufferTime [0..1]: 0..255, multiplicity set at pre-compile, origin=RB:AR40.4.0.0:2012-06-01, set at pre-compile, default-value=0  # This parameter specifies the Event buffer Time. It configures the number of Dem main cycles until a reported failure is finally considered as being a causal failure. See failure dependency feature [NON-AUTOSAR EXTENSION]
          boolean DemRbEventRecoverableInSameOperationCycle [0..1]: multiplicity set at pre-compile, origin=RB:AR40.4.0.0:2012-06-01, set at pre-compile, default-value=true  # This parameter specifies if the failure may be recovered in the same operation cycle as the FAILED was reported. If the configured to false, a PASSED report will be ignored if testfailedThisOperationCycle is already set. [NON-AUTOSAR EXTENSION]
          boolean DemRbEventStatusBitStorageTestFailed [0..1]: multiplicity set at pre-compile, origin=RB:AR40.4.0.0:2012-06-01, set at pre-compile, default-value=false  # This parameter specifies if the failure of this event is stored to the next operation cycle. This setting is only relevant if the global setting DemStatusBitStorageTestFailed is set to FALSE. [NON-AUTOSAR EXTENSION]
          integer DemRbEventUniqueId [0..1]: 0..0xFFFFFFFF, multiplicity set at pre-compile, origin=RB:AR40.7.0.0:2013-11-11, set at pre-compile, symbolic-name-value=true  # This contains a free definable unique id. It is used with the BFM.
          string DemRbShiftView [0..1]: multiplicity set at pre-compile, origin=RB:AR40.6.0.0:2013-07-26, set at pre-compile, regular-expression=[a-zA-Z0-9_]([a-zA-Z0-9\._])*  # Mapping for documentation | Reference to the name of the SW-component calculating the DemEvent. This parameter is added for DGS Dem. It is used in further processing to assign calibration parameters of the considered event, generated during software build in asap file to the calculating SW-component("shiftview"). DGS DSM creates diagnostic calibration parameters for events(= DGS DFCs). If your module has own calibration parameters then give your assigned function name in a2l-file and DGS-DSM will shift the diagnostic calibration parameters to this a2l function. Otherwise define a function name for the diagnostic calibration, only.
          reference DemRbEventCategoryRef [0..1]: multiplicity set at pre-compile, origin=RB:AR40.4.0.0:2012-06-01, set at pre-compile, destination=DemRbEventCategory  # Reference to category of the event [NON-AUTOSAR EXTENSION]
          container DemRbEventCustAttribute [0..*]: multiplicity set at pre-compile  # This container contains the configuration(parameters) for event customer attribute values and reference.
            string DemRbCustAttributeValue: origin=TO_BE_UPDATED, set at pre-compile  # The configuration of the event attributes done by assigning a value
            reference DemRbCustAttributeRef: origin=TO_BE_UPDATED, set at pre-compile, destination=DemRbDefaultEventCustAttribute  # The configuration of the event attribute done by creating a reference
      container DemJ1939Node [0..255]: multiplicity set at pre-compile  # Contains the parameters for the support of a logical J1939 node.
        symbolic name reference DemJ1939NmNodeRef [1..255]: scope=ECU, multiplicity set at pre-compile, set at pre-compile, destination=J1939NmNode  # Reference to the corresponding J1939Nm node.
      container DemObdDTC [0..65535]  # This container contains the configuration (parameters) for DemObdDTC.
        boolean DemConsiderPtoStatus [0..1]: scope=ECU, multiplicity set at pre-compile, set at pre-compile, with-auto=true  # This parameter is TRUE, when the event is affected by the Dem PTO handling. CURRENTLY PARAMETER IS NOT SUPPORTED.
        integer DemDtcValue [0..1]: 1..65535, scope=ECU, multiplicity set at pre-compile, set at pre-compile  # Unique Diagnostic Trouble Code value for OBD
        enumeration DemEventOBDReadinessGroup [0..1]: {DEM_OBD_RDY_AC, DEM_OBD_RDY_BOOSTPR, DEM_OBD_RDY_CAT, DEM_OBD_RDY_CMPRCMPT, DEM_OBD_RDY_EGSENS, DEM_OBD_RDY_ERG, DEM_OBD_RDY_EVAP, DEM_OBD_RDY_FLSYS, DEM_OBD_RDY_FLSYS_NONCONT, DEM_OBD_RDY_HCCAT, DEM_OBD_RDY_HTCAT, DEM_OBD_RDY_MISF, DEM_OBD_RDY_NONE, DEM_OBD_RDY_NOXCAT, DEM_OBD_RDY_O2SENS, DEM_OBD_RDY_O2SENSHT, DEM_OBD_RDY_PMFLT, DEM_OBD_RDY_SECAIR}, scope=ECU, multiplicity set at pre-compile, set at pre-compile  # This parameter specifies the Event OBD Readiness group for PID $01 and PID $41 computation. | This parameter is only applicable for emission-related ECUs.
        integer DemJ1939DTCValue [0..1]: 1..16777214, scope=ECU, multiplicity set at pre-compile, set at pre-compile  # Unique Diagnostic Trouble Code value for J1939 (consiting of SPN and FMI)
      container DemPidClass [0..255]  # This container contains the different PIDs for the single global OBD relevant freeze frame class. It is assembled out of one or several data elements.
        integer DemPidIdentifier: 0..255, scope=ECU, set at pre-compile  # identifier of the PID
        container DemPidDataElement [1..255]  # This container contains the different data elements contained in the specific PID.
          reference DemPidDataElementClassRef: scope=ECU, set at pre-compile, destination=DemDataElementClass  # This reference contains the link to a data element class.
    container DemGeneral  # This container contains the configuration (parameters) of the BSW Dem
      enumeration DemAgingCycleCounterProcessing [0..0]: {DEM_PROCESS_AGINGCTR_EXTERN, DEM_PROCESS_AGINGCTR_INTERN}, scope=ECU, multiplicity set at pre-compile, set at pre-compile, with-auto=true  # DemAgingCycleCounterProcessing (Obsolete) | This configuration switch defines, whether the aging counter is calculated Dem-internally or provided via Dem_SetAgingCycleCounterValue. PARAMETER IS DEPRECATED.
      boolean DemAgingRequieresTestedCycle: scope=ECU, set at pre-compile  # Defines if the aging cycle counter is processed every aging cycles or if only tested aging cycle are considered. | true: only tested aging cycle are considered for aging cycle counter false: aging cycle counter is processed every aging cycle
      enumeration DemAvailabilitySupport: {DEM_EVENT_AVAILABILITY, DEM_NO_AVAILABILITY}, set at pre-compile  # This configuration switch defines, whether support for availability is enabled or not.
      integer DemBswErrorBufferSize [0..1]: 0..255, scope=ECU, multiplicity set at pre-compile, set at pre-compile  # Maximum number of elements in buffer for handling of BSW errors (ref. to SWS_Dem_00207). If this is not configured, the internal buffer queue size will be equal to the number of events configured with DemEventkind = DEM_EVENT_KIND_BSW and DemReportBehavior == REPORT_BEFORE_INIT.
      enumeration DemClearDTCBehavior: {DEM_CLRRESP_NONVOLATILE_FINISH, DEM_CLRRESP_NONVOLATILE_TRIGGER, DEM_CLRRESP_VOLATILE}, scope=ECU, set at pre-compile  # Defines the clearing process of diagnostic information for volatile and non-volatile memory and the positive response handling for the Dcm module.
      enumeration DemClearDTCLimitation: {DEM_ALL_SUPPORTED_DTCS, DEM_ONLY_CLEAR_ALL_DTCS}, scope=ECU, set at pre-compile, default-value=DEM_ALL_SUPPORTED_DTCS  # Defines the supported Dem_<...>ClearDTC API scope.
      enumeration DemDataElementDefaultEndianness: {BIG_ENDIAN, LITTLE_ENDIAN, OPAQUE}, set at pre-compile  # Defines the default endianness of the data belonging to a data element which is applicable if the DemExternalSRDataElementClass does not define a endianness.
      boolean DemDebounceCounterBasedSupport: scope=ECU, set at pre-compile  # This configuration switch defines, whether support for counter based debouncing is enabled or not. | true: counter based debouncing support is enabled false: counter based debouncing support is disabled
      boolean DemDebounceTimeBasedSupport: scope=ECU, set at pre-compile  # This configuration switch defines, whether support for time based debouncing is enabled or not. | true: time based debouncing support is enabled. In case it is enabled and has to run in a different cyclic task time (refer to: DemRbDebounceTimeBasedTaskTime) then the API Dem_TimeBasedDebounceMainFunction() must be scheduled in appropriate cycle task. false: time based debouncing support is disabled
      boolean DemDevErrorDetect: set at pre-compile  # Switches the Default Error Tracer (Det) detection and notification ON or OFF. | * true: enabled (ON). * false: disabled (OFF).
      integer DemDtcStatusAvailabilityMask: 0..255, scope=ECU, set at pre-compile  # Mask for the supported DTC status bits by the Dem. This mask is used by UDS service 0x19.
      enumeration DemEnvironmentDataCapture: {DEM_CAPTURE_ASYNCHRONOUS_TO_REPORTING, DEM_CAPTURE_SYNCHRONOUS_TO_REPORTING}, multiplicity set at pre-compile, set at pre-compile  # DemEnvironmentDataCapture defines the point in time, when the data actually is captured.
      enumeration DemEventCombinationSupport: {DEM_EVCOMB_DISABLED, DEM_EVCOMB_ONRETRIEVAL, DEM_EVCOMB_ONSTORAGE}, scope=ECU, set at pre-compile  # This parameter defines the type of event combination supported by the Dem.
      enumeration DemEventDisplacementStrategy: {DEM_DISPLACEMENT_FULL, DEM_DISPLACEMENT_NONE, DEM_DISPLACEMENT_PRIO_OCC, CUST}, scope=ECU, set at pre-compile  # This configuration switch defines, whether support for event displacement is enabled or not, and which displacement strategy is followed.
      enumeration DemEventMemoryEntryStorageTrigger: {DEM_TRIGGER_ON_CONFIRMED, DEM_TRIGGER_ON_FDC_THRESHOLD, DEM_TRIGGER_ON_PENDING, DEM_TRIGGER_ON_TEST_FAILED}, set at pre-compile, default-value=DEM_TRIGGER_ON_TEST_FAILED  # Configures the primary trigger to allocate an event memory entry.
      boolean DemGeneralInterfaceSupport: scope=ECU, set at pre-compile  # The interfaces GeneralEvtInfo, GeneralCallbackEventDataChanged and GeneralCallbackEventStatusChange are provided if DemGeneralInterfaceSupport is equal to true.
      string DemHeaderFileInclusion [0..*]: scope=ECU, multiplicity set at pre-compile, set at pre-compile, regular-expression=[a-zA-Z0-9_]([a-zA-Z0-9\._])*  # Name of the header file(s) to be included by the Dem module containing the used C-callback declarations.
      integer DemImmediateNvStorageLimit [0..1]: 1..255, scope=ECU, multiplicity set at pre-compile, set at pre-compile  # This parameter defines the maximum number of occurrences, a specific event memory entry is allowed, to be stored in NVRAM immediately (refer to DemImmediateNvStorage).
      integer DemMaxNumberEventEntryEventBuffer [0..1]: 1..250, scope=ECU, multiplicity set at pre-compile, set at pre-compile  # Specifies the size of the buffer for storing environmental data (freezeframes and extended data) until they are processed and stored to the event memory.
      integer DemMaxNumberEventEntryPermanent: 0..255, scope=ECU, set at pre-compile  # Maximum number of events which can be stored in the permanent memory. | The assignment of an event to this memory type is dynamic and used for emission-related events only.
      integer DemMaxNumberPrestoredFF: 0..255, scope=ECU, set at pre-compile  # Defines the maximum number for prestored freeze frames. | If set to 0, then freeze frame prestorage is not supported by the ECU.
      enumeration DemOBDSupport: {DEM_OBD_DEP_SEC_ECU, DEM_OBD_MASTER_ECU, DEM_OBD_NO_OBD_SUPPORT, DEM_OBD_PRIMARY_ECU}, scope=ECU, set at pre-compile  # This configuration switch defines OBD support and kind of OBD ECU.
      enumeration DemOccurrenceCounterProcessing: {DEM_PROCESS_OCCCTR_CDTC, DEM_PROCESS_OCCCTR_TF}, scope=ECU, set at pre-compile  # This configuration switch defines the consideration of the fault confirmation process for the occurrence counter. For OBD and mixed systems (OBD/non OBD, refer to DemOBDSupport) configuration switch shall always set to DEM_PROCESS_OCCCTR_TF.
      boolean DemOperationCycleStatusStorage: scope=ECU, set at pre-compile  # Defines if the operation cycle state is available over the power cycle (stored non-volatile) or not. | true: the operation cycle state is stored non-volatile false: the operation cycle state is only stored volatile
      boolean DemPTOSupport [0..1]: scope=ECU, multiplicity set at pre-compile, set at pre-compile, with-auto=true  # This configuration switch defines, whether PTO support (and therefore PID $1E support) is enabled or not. CURRENTLY PARAMETER IS NOT SUPPORTED.
      enumeration DemRbValidationMode [0..1]: {Dem_ValidationMode_CUBASBSW, Dem_ValidationMode_Standard}, multiplicity set at pre-compile, origin=RB:AR40.8.0.0:2014-05-28, set at pre-compile, default-value=Dem_ValidationMode_Standard  # This configuration switch defines,whether the executed validations shall be specially enhanced for RTA-BSW BSW Events or whether - in standard mode - the standard project validations shall be used.
      boolean DemResetConfirmedBitOnOverflow: set at pre-compile, default-value=true  # This configuration switch defines, whether the confirmed bit is reset or not while an event memory entry will be displaced.
      enumeration DemStatusBitHandlingTestFailedSinceLastClear: {DEM_STATUS_BIT_AGING_AND_DISPLACEMENT, DEM_STATUS_BIT_NORMAL}, scope=ECU, set at pre-compile, default-value=DEM_STATUS_BIT_NORMAL  # This configuration switch defines, whether the aging and displacement mechanism shall be applied to the "TestFailedSinceLastClear" status bits.
      boolean DemStatusBitStorageTestFailed: scope=ECU, set at pre-compile  # Activate/Deactivate the permanent storage of the "TestFailed" status bits. If this is activated, the failure of this event is stored to the next power cycle. | true: storage activated false: storage deactivated
      enumeration DemSuppressionSupport: {DEM_DTC_SUPPRESSION, DEM_NO_SUPPRESSION}, scope=ECU, set at pre-compile  # This configuration switch defines, whether support for suppression is enabled or not.
      float DemTaskTime: 0.001..0.1, scope=ECU, origin=AUTOSAR_ECUC V1.0.0, set at pre-compile  # Allow to configure the time for the periodic cyclic task. Please note: This configuration value shall be equal to the value in the Basic Software Scheduler configuration of the RTE module. | The AUTOSAR configuration standard is to use SI units, so this parameter is defined as float value in seconds. Dem configuration tools must convert this float value to the appropriate value format for the use in the software implementation of Dem. min: A negative value is not allowed. max: After event status was reported, processing shall be completed within 100ms in order to have the fault entry status information updated as soon as possible (e.g. for PID $01). upperMultiplicity: Exactly one TaskTime must be specified per configuration. lowerMultiplicity: Exactly one TaskTime must be specified per configuration.
      boolean DemTriggerDcmReports: scope=ECU, set at pre-compile  # Activate/Deactivate the notification to the Diagnostic Communication Manager for ROE processing. | true: Dcm ROE notification activated false: Dcm ROE notification deactivated
      boolean DemTriggerDltReports: scope=ECU, set at pre-compile  # Activate/Deactivate the notification to the Diagnostic Log and Trace. | true: Dlt notification activated false: Dlt notification deactivated
      boolean DemTriggerFiMReports: scope=ECU, set at pre-compile  # Activate/Deactivate the notification to the Function Inhibition Manager. | true: FiM notification activated false: FiM notification deactivated
      boolean DemTriggerMonitorInitBeforeClearOk: scope=ECU, set at pre-compile  # Defines if the monitor re-initialization has to be triggered before or after the Dem module returns E_OK. | true: trigger re-initialization before E_OK false: trigger re-initialization after E_OK
      enumeration DemTypeOfDTCSupported: {DEM_DTC_TRANSLATION_ISO11992_4, DEM_DTC_TRANSLATION_ISO14229_1, DEM_DTC_TRANSLATION_ISO15031_6, DEM_DTC_TRANSLATION_SAEJ1939_73, DEM_DTC_TRANSLATION_SAE_J2012_DA_DTCFORMAT_04}, scope=ECU, set at pre-compile  # This parameter defines the format returned by Dem_GetTranslationType and does not relate to/influence the supported Dem functionality.
      enumeration DemTypeOfFreezeFrameRecordNumeration: {DEM_FF_RECNUM_CALCULATED, DEM_FF_RECNUM_CONFIGURED}, scope=ECU, set at pre-compile  # This parameter defines the type of assigning freeze frame record numbers for event-specific freeze frame records. Hint: For CALCULATED, the numeration will start from 1 and increase by 1 for each subsequent freezeframe record
      boolean DemVersionInfoApi: set at pre-compile  # Activate/Deactivate the version information API. | true: version information activated false: version information deactivated
      reference DemMILIndicatorRef [0..1]: scope=ECU, multiplicity set at pre-compile, set at pre-compile, destination=DemIndicator  # This parameter defines the indicator representing the MIL. | This parameter is mandatory for ECUs supporting OBD (refer to DemOBDSupport).
      container DemCallbackDTCStatusChanged [0..*]  # The presence of this container indicates, that the Dem has access to a "DTCStatusChanged" callback, which the Dem will call to notify other components about the change in the status of a DTC. | In case there is a DemCallbackDTCStatusChangedFnc, this parameter defines the name of the function that the Dem will call. In case there is no DemCallbackDTCStatusChangedFnc, the Dem will have an R-Port requiring the interface CallbackDTCStatusChanged whose name is generated by using the unique callback-prefix followed by the event name. Status change notifications are supported for DTCs in primary memory only.
        function name DemCallbackDTCStatusChangedFnc [0..1]: scope=ECU, multiplicity set at pre-compile, set at pre-compile  # Function name of prototype "DTCStatusChanged". | Note: If the parameter DemTriggerDcmReports is enabled, this parameter shall not be "Dcm_DemTriggerOnDTCStatus".
      container DemCallbackEventStatusChangedRB [0..255]: multiplicity set at pre-compile  # This name uniquely identifies a group of type "DemCallbackEventStatusChangedRB"
        container DemCallbackEventStatusChanged [1..*]: multiplicity set at pre-compile  # The presence of this container indicates, that the Dem has access to an "EventStatusChanged" callback, which the Dem will call to notify other components about the change in the status of all associated events. | In case there is a DemCallbackEvenStatusChangedFnc, this parameter defines the name of the function that the Dem will call. In case there is no DemCallbackEvenStatusChangedFnc, the Dem will have an R-Port requiring the interface CallbackEventStatusChanged, whose name is generated by using the unique callback-prefix followed by that event name which is referencing this sub-container.
          function name DemCallbackEventStatusChangedFnc [0..1]: multiplicity set at pre-compile, origin=RB:AR40.6.0.0:2013-07-26, set at pre-compile  # Function name of prototype "EventStatusChanged". For further details refer [SWS_Dem_00259].
      container DemClient [1..255]: multiplicity set at pre-compile  # This container contains possible clients that are using the Dem APIs.
        enumeration DemClientFunctionality: {DEM_CLIENT_ONLY_USES_EVENTOVERFLOW_INTERFACE, DEM_CLIENT_USES_FULL_FUNCTIONALITY}, set at pre-compile, default-value=DEM_CLIENT_USES_FULL_FUNCTIONALITY  # Functionality provided by Dem for the DemClient.
        integer DemClientId: 0..255, scope=ECU, multiplicity set at pre-compile, set at pre-compile, symbolic-name-value=true, with-auto=true  # Defines a unique identifier for a Dem client. This number is used by this client in the ClientID parameter in all API with this parameter.
        boolean DemClientUsesRte: multiplicity set at pre-compile, set at pre-compile, default-value=false  # If set to true, this client shall only use the DEM via RTE (Dem will provide the C/S interfaces: CddIf, EvMemOverflowIndication). The client must not do any C_API calls to the DEM.
        integer DemRbClientPriority: 1..255, multiplicity set at pre-compile, origin=RB:AR42.5.0.0:2018-08-29, set at pre-compile  # This parameter defines a unique priority value that a DemClient can have. Lower the value higher the priority.
        reference DemEventMemorySetRef: multiplicity set at pre-compile, set at pre-compile, destination=DemEventMemorySet  # References to the client assigned event memory container that contains client specific settings and event memories.
      choice container DemDataElementClass [0..65535]  # This container contains the configuration (parameters) for an internal/external data element class.
        container DemExternalCSDataElementClass [0..1]  # This container contains the configuration (parameters) for an external client/server based data element class. | It defines, how the Dem can obtain the value of the data element from either a SW-C or another BSW module. Whether a client/server port or a C function-call is used, is defined by DemDataElementUsePort.
          integer DemDataElementDataSize: 1..255, scope=ECU, set at pre-compile  # Defines the size of the data element in bytes.
          function name DemDataElementReadFnc [0..1]: scope=ECU, multiplicity set at pre-compile, set at pre-compile  # In case of DemDataElementUsePort is false, this parameter defines the prototype of the C function "ReadDataElement" used to get the according value.
          boolean DemDataElementUsePort: scope=ECU, set at pre-compile  # If the parameter is set to True, a R-Port is generated, to obtain the data element (interface DataServices_{Data}). | If the parameter is set to False, the information is obtained by C function-call on another BSW module specified by the parameter DemRbDataElementReadFnc.
        container DemExternalSRDataElementClass [0..1]  # This container contains the configuration (parameters) for an external sender/receiver based data element class. It defines, how the Dem can obtain the value of the data element from a SW-C, by using a sender/receiver port.
          integer DemDataElementDataSize: 1..255, scope=ECU, set at pre-compile, with-auto=true  # Defines the size of the data element in bytes (According to AR4.3).
          enumeration DemDataElementDataType: {BOOLEAN, SINT16, SINT32, SINT8, UINT16, UINT32, UINT8}, scope=ECU, set at pre-compile  # Provide the implementation data type of data belonging to a external data.
          enumeration DemDataElementEndianness [0..1]: {BIG_ENDIAN, LITTLE_ENDIAN, OPAQUE}, multiplicity set at pre-compile, set at pre-compile  # Defines the endianness of the data belonging to an external data. | If no DemDataElementEndianness is defined the value of DemDataElementDefaultEndianness is applicable.
          choice container DemDiagnosisScaling [0..1]  # This container contains the configuration (parameters) of an alternative Diagnosis Representation. Out if this the scaling between Diagnosis and ECU internal representation and vice versa can be calculated.
            container DemAlternativeDataInterface [0..0]  # This container contains the configuration (parameters) of an alternative Diagnosis Representation by the means of a VariableDataPrototoype in a DataInterface. | Additionally a reference to PortInterfaceMapping can be defined which provide already the mapping rules between the VariableDataPrototoype in a DataInterface used by the software component (DemSRDataElementClass) and the intended Diagnosis Representation defined by DemExternalSRDataElementClass.Currently not supported.
              foreign reference DemDataElement: set at pre-compile, destination-type=VARIABLE-DATA-PROTOTYPE  # Alternative Diagnosis Representation for the data defined by the means of a VariableDataPrototoype in a DataInterface.
              foreign reference DemPortInterfaceMapping [0..1]: multiplicity set at pre-compile, set at pre-compile, destination-type=PORT-INTERFACE-MAPPING  # Optional reference to PortInterfaceMapping which defines the mapping rules.
            container DemAlternativeDataProps [0..1]  # This container contains the configuration (parameters) of an alternative Diagnosis Representation by the means of ECU configuration parameters. | The physical unit of the alternative data representation is defined by the DataPrototype referenced by DemSRDataElementClass. Additionally the definition of a text table mapping can be a defined for DemDataTypeCategory TEXTTABLE and SCALE_LINEAR_AND_TEXTTABLE
              enumeration DemDataTypeCategory [0..0]: {SCALE_LINEAR_AND_TEXTTABLE, TEXTTABLE}, scope=ECU, set at pre-compile  # Data category of the alternative Diagnosis Representation.
              container DemLinearScale [0..1]  # This container contains the configuration (parameters) of an linear scale of the alternative Diagnosis Representation.
                float DemDiagnosisRepresentationDataLowerRange: scope=ECU, set at pre-compile  # Lower Range for this scale of the data in the alternative Diagnosis Representation.
                float DemDiagnosisRepresentationDataOffset: 0..Inf, scope=ECU, set at pre-compile, default-value=0  # Data offset of the alternative Diagnosis Representation for this scale.
                float DemDiagnosisRepresentationDataResolution: 0..Inf, scope=ECU, set at pre-compile  # Data resolution of the alternative Diagnosis Representation for this scale.
                float DemDiagnosisRepresentationDataUpperRange: scope=ECU, set at pre-compile  # Upper Range for this scale of the data in the alternative Diagnosis Representation.
              container DemTextTableMapping [0..0]  # This container contains the configuration (parameters) of the mapping a DataPrototype typed by AutosarDataType that refer to a CompuMethods of category TEXTTABLE or SCALE_LINEAR_AND_TEXTTABLE. | Each DemTextTableMapping defines a value pair which is used to map the ECU internal value (DemInternalDataValue) to the vale used in the diagnosis representation (DemDiagnosisRepresentationDataValue) and vice versa. The set of all DemTextTableMapping defines the whole mapping of an data.
                integer DemDiagnosisRepresentationDataValue: 0..1.84467440737096E+19, scope=ECU, set at pre-compile  # The data value in the diagnosis representation.
                integer DemInternalDataValue: 0..1.84467440737096E+19, scope=ECU, set at pre-compile  # The ECU internal data value.
            container DemAlternativeDataType [0..1]  # This container contains the configuration (parameters) of an alternative Diagnosis Representation by the means of an ApplicationDataType. | Additionally the definition of a text table mapping can be a defined for ApplicationDataTypes of category TEXTTABLE and SCALE_LINEAR_AND_TEXTTABLE.
              foreign reference DemApplicationDataType: set at pre-compile, destination-type=APPLICATION-PRIMITIVE-DATA-TYPE  # Alternative Diagnosis Representation for the data defined by the means of a ApplicationPrimitiveDataType of category VALUE or BOOLEAN.
              container DemTextTableMapping [0..0]  # This container contains the configuration (parameters) of the mapping a DataPrototype typed by AutosarDataType that refer to a CompuMethods of category TEXTTABLE or SCALE_LINEAR_AND_TEXTTABLE.Currently not supported. | Each DemTextTableMapping defines a value pair which is used to map the ECU internal value (DemInternalDataValue) to the vale used in the diagnosis representation (DemDiagnosisRepresentationDataValue) and vice versa. The set of all DemTextTableMapping defines the whole mapping of an data.
                integer DemDiagnosisRepresentationDataValue: 0..1.84467440737096E+19, scope=ECU, set at pre-compile  # The data value in the diagnosis representation.
                integer DemInternalDataValue: 0..1.84467440737096E+19, scope=ECU, set at pre-compile  # The ECU internal data value.
          choice container DemSRDataElementClass [0..0]  # This container defines the source of data in a provided port which shall be read for a external data element. Currently not supported. | This container shall contain either one DemSubElementInDataElementInstance OR DemDataElementInstance OR DemSubElementInImplDataElementInstance reference.
            container DemDataElementInstance [0..1]  # Instance Reference to the primitive data in a port where the data element is typed with an ApplicationPrimitveDataType or an ImplementationDataType.
              instance reference DemDataElementInstanceRef: set at pre-compile, destination-context=ROOT-SW-COMPOSITION-PROTOTYPE SW-COMPONENT-PROTOTYPE PORT-PROTOTYPE, destination-type=AUTOSAR-DATA-PROTOTYPE  # Instance Reference to the primitive data which shall be read or written. | Supported are VariableDataPrototypes in SenderReceiverInterfaces and NvDataInterfaces and ParameterDataPrototypes in ParameterInterfaces (read only). This reference is applicable if the AutosarDataPrototype is typed with a ApplicationPrimitiveDataType of category VALUE or BOOLEAN or if the AutosarDataPrototype is typed with a ImplementationDataType of category VALUE or TYPE_REFERENCE that in turn boils down to VALUE
            container DemSubElementInDataElementInstance [0..1]  # Instance Reference to the primitve sub-element (at any level) of composite data in a port where the data element is typed with an ApplicationCompositeDataType.
              instance reference DemSubElementInDataElementInstanceRef: set at pre-compile, destination-context=ROOT-SW-COMPOSITION-PROTOTYPE SW-COMPONENT-PROTOTYPE PORT-PROTOTYPE AUTOSAR-DATA-PROTOTYPE APPLICATION-COMPOSITE-ELEMENT-DATA-PROTOTYPE*, destination-type=AUTOSAR-DATA-PROTOTYPE  # Instance Reference to the primitve sub-element (at any level) of composite data in a port which shall be read or written. | Supported are VariableDataPrototypes in SenderReceiverInterfaces and NvDataInterfaces and ParameterDataPrototypes in ParameterInterfaces (read only). This reference is applicable if the AutosarDataPrototype is typed with a ApplicationCompositeDataType.
            container DemSubElementInImplDataElementInstance [0..1]  # Instance Reference to the primitve sub-element (at any level) of composite data in a port where the data element is typed with an ImplementationDataType of category STRUCTURE or ARRAY.
              instance reference DemSubElementInImplDataElementInstanceRef: set at pre-compile, destination-context=ROOT-SW-COMPOSITION-PROTOTYPE SW-COMPONENT-PROTOTYPE PORT-PROTOTYPE AUTOSAR-DATA-PROTOTYPE IMPLEMENTATION-DATA-TYPE-ELEMENT*, destination-type=IMPLEMENTATION-DATA-TYPE-ELEMENT  # Instance Reference to the primitve sub-element (at any level) of composite data in a port which shall be read or written. | Supported are VariableDataPrototypes in SenderReceiverInterfaces and NvDataInterfaces and ParameterDataPrototypes in ParameterInterfaces (read only). This reference is applicable if the AutosarDataPrototype is typed with a ImplementationDataType of category STRUCTURE or ARRAY. Please note that in case of ARRAY the index attribute in the target reference has to be set to select a single array element.
        container DemInternalDataElementClass [0..1]  # This container contains the configuration (parameters) for an internal data element class.
          integer DemDataElementDataSize: 1..255, scope=ECU, multiplicity set at pre-compile, set at pre-compile  # Defines the size of the data element in bytes.
          enumeration DemInternalDataElement: {DEM_AGINGCTR_DOWNCNT, DEM_AGINGCTR_UPCNT, DEM_CURRENT_FDC, DEM_CYCLES_SINCE_FIRST_FAILED, DEM_CYCLES_SINCE_LAST_FAILED, DEM_FAILED_CYCLES, DEM_MAX_FDC_DURING_CURRENT_CYCLE, DEM_MAX_FDC_SINCE_LAST_CLEAR, DEM_OCCCTR, DEM_OVFLIND, DEM_SIGNIFICANCE, DEM_DEBUG0, DEM_DEBUG1, DEM_BFM_OP_CYCLE, DEM_BFM_ABS_OP_TIME, DEM_BFM_REL_OP_TIME, DEM_BFM_TIMESTAMP, DEM_BFM_UNIQUE_ID, DEM_CYCLES_SINCE_LAST_FAILED_EXCLUDING_TNC, DEM_EVENT_STATUS_BYTE, DEM_EVENT_ID, DEM_PRJ_SPECIFIC_DATA_ON_RETRIEVE, DEM_PRJ_SPECIFIC_DATA_ON_REPORT}, scope=ECU, set at pre-compile  # This parameter defines the Dem-internal data value, which is mapped to the data element.
          function name DemRbDataElementReadFnc [0..1]: multiplicity set at pre-compile, origin=RB:AR40.10.0.0:2015-06-25, set at pre-compile  # Defines the name of the project specific C function "ReadDataElement" which will provide the desired internal data. Please refer to Dem_PrjSpecificInternalData.c_tpl. This parameter must be configured if DemInternalDataElement is configured as DEM_PRJ_SPECIFIC_DATA_ON_RETRIEVE or DEM_PRJ_SPECIFIC_DATA_ON_REPORT. Otherwise it must not be configured.
      container DemDidClass [0..65535]  # This container contains the configuration (parameters) for a data Id class. It is assembled out of one or several data elements.
        integer DemDidIdentifier: 0..65535, set at pre-compile  # Identifier of the Data ID.
        reference DemDidDataElementClassRef [1..255]: scope=ECU, multiplicity set at pre-compile, requires-index=true, set at pre-compile, destination=DemDataElementClass  # This reference contains the link to a data element class.
      container DemEnableCondition [0..255]  # This container contains the configuration (parameters) for enable conditions.
        integer DemEnableConditionId: 0..255, scope=ECU, set at pre-compile, symbolic-name-value=true, with-auto=true  # Defines a unique enable condition Id. | This parameter should not be changeable by user, because the Id should be generated by Dem itself to prevent gaps and multiple use of an Id. The enable conditions should be sequentially ordered beginning with 0 and no gaps in between.
        boolean DemEnableConditionStatus: scope=ECU, set at pre-compile  # Defines the initial status for enable or disable of acceptance of event reports of a diagnostic event. | The value is the initialization after power up (before this condition is reported the first time). true: acceptance of a diagnostic event enabled false: acceptance of a diagnostic event disabled
      container DemEnableConditionGroup [0..255]  # This container contains the configuration (parameters) for enable condition groups.
        reference DemEnableConditionRef [1..255]: scope=ECU, multiplicity set at pre-compile, origin=AUTOSAR_ECUC V1.0.0, set at pre-compile, destination=DemEnableCondition  # References an enable condition.
      container DemEventMemorySet  # This container is a collection of referenced event memories and related information for a Dem client.
        integer DemDtcStatusAvailabilityMask: 0..255, scope=ECU, set at pre-compile, with-auto=true  # Mask for the supported DTC status bits by the Dem. This mask is used by UDS service 0x19.
        integer DemMaxNumberEventEntryPermanent: 0..255, scope=ECU, set at pre-compile, with-auto=true  # Maximum number of events which can be stored in the permanent memory. | The assignment of an event to this memory type is dynamic and used for emission-related events only.
        enumeration DemTypeOfDTCSupported: {DEM_DTC_TRANSLATION_ISO11992_4, DEM_DTC_TRANSLATION_ISO14229_1, DEM_DTC_TRANSLATION_ISO15031_6, DEM_DTC_TRANSLATION_SAEJ1939_73, DEM_DTC_TRANSLATION_SAE_J2012_DA_DTCFORMAT_04}, scope=ECU, set at pre-compile, with-auto=true  # This parameter defines the format returned by Dem_GetTranslationType and does not relate to/influence the supported Dem functionality.
        reference DemAmberWarningLampIndicatorRef [0..1]: multiplicity set at pre-compile, set at pre-compile, destination=DemIndicator  # This parameter defines the indicator representing the AmberWarningLamp . This parameter may be used for ECUs supporting J1939.
        reference DemMILIndicatorRef [0..1]: scope=ECU, multiplicity set at pre-compile, set at pre-compile, destination=DemIndicator  # This parameter defines the indicator representing the MIL. | This parameter is mandatory for ECUs supporting OBD (refer to DemOBDSupport).
        reference DemProtectLampIndicatorRef [0..1]: multiplicity set at pre-compile, set at pre-compile, destination=DemIndicator  # This parameter defines the indicator representing the ProtectLamp. This parameter may be used for ECUs supporting J1939.
        reference DemRedStopLampIndicatorRef [0..1]: multiplicity set at pre-compile, set at pre-compile, destination=DemIndicator  # This parameter defines the indicator representing the RedStopLamp. This parameter may be used for ECUs supporting J1939.
        container DemClearDTCNotification [0..255]  # Contains callback function definition which are called during clear DTC operations.
          function name DemClearDtcNotificationFnc [0..1]: multiplicity set at pre-compile, set at pre-compile  # Notification callback function name which is called on a clear DTC operation (refer to <Module>_ClearDtcNotification).
          enumeration DemClearDtcNotificationTime: {FINISH, START}, set at pre-compile  # Configure, whether the callback shall be called on start of a clear or after finishing a clear DTC operation (refer to <Module>_ClearDtcNotification)
        container DemIndicator [0..255]  # This container contains the configuration (parameters) for Indicators.
          integer DemIndicatorID: 0..255, scope=ECU, set at pre-compile, symbolic-name-value=true, with-auto=true  # Unique identifier of an indicator.
        container DemMirrorMemory [0..1]  # This container contains the mirror event memory specific parameters of the Dem module.
          integer DemMaxNumberEventEntryMirror: 1..255, scope=ECU, set at pre-compile, with-auto=true  # Maximum number of events which can be stored in the mirror memory
        container DemPrimaryMemory  # This container contains the primary event memory specific parameters of the Dem module.
          integer DemMaxNumberEventEntryPrimary: 1..255, scope=ECU, set at pre-compile, with-auto=true  # Maximum number of events which can be stored in the primary memory
        container DemUserDefinedMemory [0..1]  # This container contains the user defined event memory specific parameters of the Dem module.
          integer DemMaxNumberEventEntryUserDefined: 1..255, scope=ECU, set at pre-compile, with-auto=true  # Maximum number of events which can be stored in the user defined memory.
          integer DemUserDefinedMemoryIdentifier: 16..255, scope=ECU, set at pre-compile, symbolic-name-value=true, with-auto=true  # Identifier used by external tester to identify the User defined event memory.
      container DemExtendedDataClass [0..*]  # This class contains the combinations of extended data records for an extended data class.
        reference DemExtendedDataRecordClassRef [1..253]: multiplicity set at pre-compile, requires-index=true, set at pre-compile, destination=DemExtendedDataRecordClass  # This reference contains the link to an extended data class record.
      container DemExtendedDataRecordClass [0..253]  # This container contains the configuration (parameters) for an extended data record class. | It is assembled out of one or several data elements.
        integer DemExtendedDataRecordNumber: 1..239, scope=ECU, set at pre-compile  # This configuration parameter specifies an unique identifier for an extended data record. | One or more extended data records can be assigned to one diagnostic event/DTC. 0x00 is reserved by ISO (therefore the minimal value equals 1) 0xF0 to 0xFF are reserved by ISO (therefore the maximal value equals 239)
        enumeration DemExtendedDataRecordTrigger: {DEM_TRIGGER_ON_CONFIRMED, DEM_TRIGGER_ON_FDC_THRESHOLD, DEM_TRIGGER_ON_MIRROR, DEM_TRIGGER_ON_PASSED, DEM_TRIGGER_ON_PENDING, DEM_TRIGGER_ON_TEST_FAILED}, set at pre-compile  # Defines the trigger to store the ExtendedDataRecord.
        enumeration DemExtendedDataRecordUpdate: {DEM_UPDATE_RECORD_NO, DEM_UPDATE_RECORD_YES}, scope=ECU, set at pre-compile  # This extended data record is captured if the configured trigger condition in "DemExtendedDataRecordTrigger" is fulfilled.
        reference DemDataElementClassRef [1..255]: multiplicity set at pre-compile, requires-index=true, set at pre-compile, destination=DemDataElementClass  # This reference contains the link to a data element class.
      container DemFreezeFrameClass [0..65535]  # This container contains the combinations of DIDs for a non OBD2 and WWH-OBD relevant freeze frame class.
        reference DemDidClassRef [1..255]: scope=ECU, multiplicity set at pre-compile, requires-index=true, set at pre-compile, destination=DemDidClass  # Reference to the DID elements which shall be contained in the freeze frame.
      container DemFreezeFrameRecNumClass [0..255]  # This container contains a list of dedicated, different freeze frame record numbers assigned to an event. The order of record numbers in this list is assigned to the chronological order of the according freeze frame records. | dependency: DemTypeOfFreezeFrameRecordNumeration = DEM_FF_RECNUM_CONFIGURED
        reference DemFreezeFrameRecordClassRef [1..254]: scope=ECU, multiplicity set at pre-compile, requires-index=true, set at pre-compile, destination=DemFreezeFrameRecordClass  # This parameter references record number(s) for a freeze frame record.
      container DemFreezeFrameRecordClass [0..255]  # This container contains a list of dedicated, different freeze frame record numbers.
        integer DemFreezeFrameRecordNumber: 1..254, scope=ECU, set at pre-compile  # This parameter defines a record number for a freeze frame record. This record number is unique per freeze frame record number class.
        enumeration DemFreezeFrameRecordTrigger: {DEM_TRIGGER_ON_CONFIRMED, DEM_TRIGGER_ON_FDC_THRESHOLD, DEM_TRIGGER_ON_PENDING, DEM_TRIGGER_ON_TEST_FAILED}, set at pre-compile  # Defines the trigger to store the FreezeFrameRecordTrigger.
        enumeration DemFreezeFrameRecordUpdate: {DEM_UPDATE_RECORD_NO, DEM_UPDATE_RECORD_YES}, scope=ECU, set at pre-compile  # This parameter defines the case, when the freeze frame record is stored/updated.
      container DemGeneralJ1939 [0..1]  # This container contains the general J1939-specific configuration (parameters) of the Dem module. | If the container exists the J1939 support is enabled.
        boolean DemJ1939ClearDtcSupport: set at pre-compile  # This configuration switch defines whether clearing J1939 DTCs (DM03 und DM11) is supported or not. | This switches on and off the API Dem_J1939DcmClearDTC.
        boolean DemJ1939Dm31Support: set at pre-compile  # This configuration switch defines whether J1939 DM31 is supported or not. | This switches on and off the APIs Dem_J1939DcmFirstDTCwithLampStatus and Dem_J1939DcmGetNextDTCwithLampStatus. .
        boolean DemJ1939ExpandedFreezeFrameSupport: set at pre-compile  # This configuration switch defines whether J1939 expanded freeze frames are supported or not. | This switches on and off the APIs Dem_J1939DcmSetFreezeFrameFilter, Dem_J1939DcmGetNextFreezeFrame and Dem_J1939DcmGetNextSPNInFreezeFrame.
        boolean DemJ1939FreezeFrameSupport: set at pre-compile  # This configuration switch defines whether J1939 freeze frames are supported or not. | This switches on and off the APIs Dem_J1939DcmSetFreezeFrameFilter and Dem_J1939DcmGetNextFreezeFrame.
        boolean DemJ1939RatioSupport: set at pre-compile  # This configuration switch defines whether J1939 performance ratios are supported or not. | This switches on and off the APIs Dem_J1939DcmSetRatioFilter and Dem_J1939DcmGetNextFilteredRatio.
        boolean DemJ1939Readiness1Support: set at pre-compile  # This configuration switch defines whether J1939 diagnostic readiness 1 is supported or not. | This switches on and off the API Dem_J1939DcmReadDiagnosticReadiness1.
        boolean DemJ1939Readiness2Support: set at pre-compile  # This configuration switch defines whether J1939 diagnostic readiness 2 is supported or not. | This switches on and off the API Dem_J1939DcmReadDiagnosticReadiness2.
        boolean DemJ1939Readiness3Support: set at pre-compile  # This configuration switch defines whether J1939 diagnostic readiness 3 is supported or not. | This switches on and off the API Dem_J1939DcmReadDiagnosticReadiness3.
        boolean DemJ1939ReadingDtcSupport: set at pre-compile  # This configuration switch defines whether J1939 DTC readout is supported or not. | This switches on and off the APIs Dem_J1939DcmSetDTCFilter, Dem_J1939DcmGetNumberOfFilteredDTC and Dem_J1939DcmGetNextFilteredDTC.
        reference DemAmberWarningLampIndicatorRef [0..1]: multiplicity set at pre-compile, set at pre-compile, destination=DemIndicator  # This parameter defines the indicator representing the AmberWarningLamp . This parameter may be used for ECUs supporting J1939.
        reference DemProtectLampIndicatorRef [0..1]: multiplicity set at pre-compile, set at pre-compile, destination=DemIndicator  # This parameter defines the indicator representing the ProtectLamp. This parameter may be used for ECUs supporting J1939.
        reference DemRedStopLampIndicatorRef [0..1]: multiplicity set at pre-compile, set at pre-compile, destination=DemIndicator  # This parameter defines the indicator representing the RedStopLamp. This parameter may be used for ECUs supporting J1939.
        container DemCallbackJ1939DTCStatusChanged [0..*]  # The presence of this container indicates, that the Dem has access to a "DTCStatusChanged" callback, which the Dem will call to notify other components about the change in the status of a DTC. | In case there is a DemCallbackDTCStatusChangedFnc, this parameter defines the name of the function that the Dem will call. In case there is no DemCallbackDTCStatusChangedFnc, the Dem will have an R-Port requiring the interface CallbackDTCStatusChanged whose name is generated by using the unique callback-prefix followed by the event name. Status change notifications are supported for DTCs in primary memory only.
          function name DemCallbackDTCStatusChangedFnc [0..1]: scope=ECU, multiplicity set at pre-compile, set at pre-compile  # Function name of prototype "DTCStatusChanged". | Note: If the parameter DemTriggerDcmReports is enabled, this parameter shall not be "Dcm_DemTriggerOnDTCStatus".
        container DemJ1939FreezeFrameClass [0..255]  # This container contains the combinations of SPNs s for a J1939 relevant freeze frame.
          reference DemSPNClassRef [1..255]: scope=ECU, multiplicity set at pre-compile, requires-index=true, set at pre-compile, destination=DemSPNClass  # Reference to an SPN. This reference defines requiresIndex = true since it represents a ordered list of references where the order describes the order of single SPNs in the J1939 Freeze Frame.
        container DemSPNClass [0..*]  # This container contains the configuration (parameters) for a SPN.
          integer DemSPNId: 0..524287, set at pre-compile  # Suspect parameter number
          reference DemSPNDataElementClassRef: scope=ECU, set at pre-compile, destination=DemDataElementClass  # This reference contains the link to a data element class.
      container DemGeneralOBD [0..1]  # This container contains the general OBD-specific configuration (parameters) of the Dem module.
        boolean DemOBDCentralizedPID21Handling: scope=ECU, set at pre-compile  # Switch to enable the centralized handling of PID $21. | true: centralized handling of PID $21 enabled false: centralized handling of PID $21 disabled
        boolean DemOBDCentralizedPID31Handling: scope=ECU, set at pre-compile  # Switch to enable the centralized handling of PID $31. | true: centralized handling of PID $31 enabled false: centralized handling of PID $31 disabled
        boolean DemRbOBDCentralizedPID4DHandling [0..1]: scope=ECU, origin=RTA-BSW, set at pre-compile  # DemOBDCentralizedPID4DHandling | Switch to enable the centralized handling of PID $4D. | true: centralized handling of PID $4D enabled false: centralized handling of PID $4D disabled
        boolean DemRbOBDCentralizedPID4EHandling [0..1]: scope=ECU, origin=RTA-BSW, set at pre-compile  # DemOBDCentralizedPID4EHandling | Switch to enable the centralized handling of PID $4E. | true: centralized handling of PID $4E enabled false: centralized handling of PID $4E disabled
        integer DemOBDCompliancy: 0..255, scope=ECU, set at pre-compile  # Configuration value to define the appropriate value to PID$1C "OBD requirements to which vehicle or engine is certified." according to the respective standards, e.g. OBD, OBDII, JOBD etc. | Notice as well J1979 or the "DiagnosticReadiness 1" DM05 message of J1939-73
        enumeration DemOBDEngineType [0..1]: {DEM_IGNITION_COMPRESSION, DEM_IGNITION_SPARK}, scope=ECU, multiplicity set at pre-compile, set at pre-compile  # Switch to provide either Gasoline or Diesel parameters.
        boolean DemOBDEventDisplacement [0..0]: set at pre-compile, with-auto=true  # Activate/Deactivate a different displacement behavior for OBD events. | OBD events with special Conditions (e.g. Pending, MIL_On...) shall not be displaced.
        boolean DemRbOBDDtcCodesConfigurable [0..1]: multiplicity set at pre-compile, origin=RB:AR40.8.0.0:2014-02-01, set at pre-compile, default-value=true  # This configuration switch defines whether the OBD Dtc codes are configuratble or not. If configurable, the DemDtcCode has to be entered in the DemDtcClass. If not configurable, the 2 higher bytes of the DemDtc is the OBD Dtc code.
        enumeration DemRbOBDFreezeFrameCapture [0..1]: {DEM_TRIGGER_CONFIRMEDDTC, DEM_TRIGGER_PENDINGDTC}, multiplicity set at pre-compile, origin=RB:AR40.5.0.0:2013-01-01, set at pre-compile, default-value=DEM_TRIGGER_PENDINGDTC  # [NON-AUTOSAR] This parameter defines the point in time, when the OBD freeze frame data collection is done for the initial event memory entry.
        enumeration DemRbOBDFreezeFrameVisibility [0..1]: {DEM_OBDFF_PENDING_AND_CONFIRMED_DTCS, DEM_OBDFF_CONFIRMED_DTCS}, multiplicity set at pre-compile, origin=RB:AR40.10.0.0:2015-04-02, set at pre-compile, default-value=DEM_OBDFF_CONFIRMED_DTCS  # [NON-AUTOSAR] This parameter defines the point of time, when the OBD freeze frame data is visible to scan tool tester.
        enumeration DemRbOBDPermanentDTCVisibilityTiming [0..1]: {END_OF_CYCLE, IMMEDIATELY}, multiplicity set at pre-compile, origin=RB:AR42.7.0.0:2019-11-06, set at pre-compile, default-value=IMMEDIATELY  # [NON-AUTOSAR] This configuration switch defines whether the permanent DTCs are visible immediately, or only after the next init of the Dem or at the end of Ignition Cycle.
        boolean DemRbOBDSupportBlockingPermanentDTC [0..1]: multiplicity set at pre-compile, origin=RB-AR40.13.0.0:2016-10-04, set at pre-compile, default-value=false  # This configuration switch enables the feature to block storing of OBD DTCs to Permanent memory.CAUTION: THIS FEATURE MUST USED ONLY DURING PRODUCTION.!!! OTHERWISE OBD CONFORMITY IS VIOLATED.See document description of the callback API rba_DemObdBasic_IsPermanentDTCStorageDisabled
        boolean DemRbOBDSupportObdVariantCoding [0..1]: multiplicity set at pre-compile, origin=RB-AR40.12.0.0:2016-04-12, set at pre-compile, default-value=false  # This configuration switch enables the feature to deactivate the OBD functionality. This feature could be used for variant coding to dynamically switch an OBD project to behave like a non OBD variant. This feature only controls the MIL status. Project specific implementation is necessary. Refer the interface documentation of the API rba_DemObdBasic_IsObdDeactivatedByVariant provided as a template file.
        boolean DemRbEnableApiSignalEndOfOBDIgnitionCycle [0..1]: multiplicity set at pre-compile, origin=RB:2019-04-25, set at pre-compile, default-value=false  # This configuration switch enables or disables the functionality of the API "Dem_SignalEndOfOBDIgnitionCycle". This API can be used to explicitly signal the end of the ignition cycle. Basically this API controls the storing and visibility of Permanent DTCs. (see also DemRbOBDIgnitionCycleRef for an alternative method)
        boolean DemRbOBDEnableMilCounterCheck [0..1]: multiplicity set at pre-compile, origin=ETAS-RTA-BSW, set at pre-compile, default-value=false  # This feature is used to serve for diagnosis OBD service 02. This configuration switch enables the feature to check Mil counter when get location Id OBD DTC in freeze frame. When freeze frame is full, this feature allows to over write stored data of confirmed DTC that is no longer illuminating the MIL
        choice reference DemOBDDestinationOfEventsRef [0..1]: scope=ECU, multiplicity set at pre-compile, set at pre-compile, destination=[DemPrimaryMemory, DemUserDefinedMemory]  # The destination of events assigns where the OBD events shall be stored.
        reference DemOBDDrivingCycleRef: origin=AUTOSAR_ECUC V1.0.0, set at pre-compile, destination=DemOperationCycle  # Defines the operationCycle which denotes the OBD driving cycle.
        choice reference DemOBDInputAcceleratorPedalInformation [0..0]: scope=ECU, multiplicity set at pre-compile, set at pre-compile, destination=[DemExternalCSDataElementClass, DemExternalSRDataElementClass]  # DemOBDInputAcceleratorPedalInformation (1 byte, unsigned, 0.392% per bit) | Input variable for the accelerator padal information, which is assigned to a specific data element used as interface for the Dem-internal PID calculations.
        choice reference DemOBDInputAmbientPressure [0..0]: scope=ECU, multiplicity set at pre-compile, set at pre-compile, destination=[DemExternalCSDataElementClass, DemExternalSRDataElementClass]  # DemOBDInputAmbientPressure (2 bytes, unsigned, 1hPa per bit, high byte first) | Input variable for the ambient pressure, which is assigned to a specific data element used as interface for the Dem-internal PID calculations.
        choice reference DemOBDInputAmbientTemperature [0..0]: scope=ECU, multiplicity set at pre-compile, set at pre-compile, destination=[DemExternalCSDataElementClass, DemExternalSRDataElementClass]  # DemOBDInputAmbientTemperature (2 bytes, unsigned, 0.1 Kelvin per bit, high byte first) | Input variable for the ambient temperature, which is assigned to a specific data element used as interface for the Dem-internal PID calculations.
        choice reference DemOBDInputDistanceInformation [0..1]: scope=ECU, multiplicity set at pre-compile, set at pre-compile, destination=[DemExternalCSDataElementClass, DemExternalSRDataElementClass]  # DemOBDInputDistanceInformation (4 bytes, unsigned, 1m per bit, high byte first) | Input variable for the distance information, which is assigned to a specific data element used as interface for the Dem-internal PID calculations.
        choice reference DemOBDInputEngineSpeed [0..0]: scope=ECU, multiplicity set at pre-compile, set at pre-compile, destination=[DemExternalCSDataElementClass, DemExternalSRDataElementClass]  # DemOBDInputEngineSpeed (2 bytes, unsigned, 0.25 rpm per bit, high byte first) | Input variable for the engine speed, which is assigned to a specific data element used as interface for the Dem-internal PID calculations.
        choice reference DemOBDInputEngineTemperature [0..0]: scope=ECU, multiplicity set at pre-compile, set at pre-compile, destination=[DemExternalCSDataElementClass, DemExternalSRDataElementClass]  # DemOBDInputEngineTemperature (2 bytes, unsigned, 0.1 Kelvin per bit, high byte first) | Input variable for the engine temperature, which is assigned to a specific data element used as interface for the Dem-internal PID calculations.
        choice reference DemOBDInputProgrammingEvent [0..0]: scope=ECU, multiplicity set at pre-compile, set at pre-compile, destination=[DemExternalCSDataElementClass, DemExternalSRDataElementClass]  # DemOBDInputProgrammingEvent (not supported) | Input variable for the programming event, which is assigned to a specific data element used as interface for the Dem-internal PID calculations. PARAMETER IS NOT SUPPORTED.
        choice reference DemOBDInputVehicleSpeed [0..1]: scope=ECU, multiplicity set at pre-compile, set at pre-compile, destination=[DemExternalCSDataElementClass, DemExternalSRDataElementClass]  # DemOBDInputVehicleSpeed (1 bytes, unsigned, 1km/h per bit, high byte first) | Input variable for the vehicle speed, which is assigned to a specific data element used as interface for the Dem-internal PID calculations.
        reference DemOBDPFCCycleRef: origin=AUTOSAR_ECUC V1.0.0, set at pre-compile, destination=DemOperationCycle  # Defines the operationCycle, which is relevant for processing the OBDPFCCycle.
        choice reference DemOBDTimeSinceEngineStart [0..1]: multiplicity set at pre-compile, set at pre-compile, destination=[DemExternalCSDataElementClass, DemExternalSRDataElementClass, DemInternalDataElementClass]  # DemOBDTimeSinceEngineStart (2 bytes, unsigned, 1 second per bit, high byte first) | Input variable for the Time Since Engine Start information, which is assigned to a specific data element.
        reference DemOBDWarmUpCycleRef: origin=AUTOSAR_ECUC V1.0.0, set at pre-compile, destination=DemOperationCycle  # Defines the operationCycle which denotes the OBD warm-up cycle.
        reference DemRbOBDIgnitionCycleRef [0..1]: origin=RB:2019-04-25, set at pre-compile, destination=DemOperationCycle  # References the operationCycle which denotes the OBD ignition cycle. The OBD Ignition Cycle is required to control the visibility of Permanent DTCs via the API Dem_SetOperationCycleState (see also DemRbEnableApiSignalEndOfOBDIgnitionCycle for an alternative method)
        container DemCallbackOBDDTCStatusChanged [0..*]  # The presence of this container indicates, that the Dem has access to a "DTCStatusChanged" callback, which the Dem will call to notify other components about the change in the status of a DTC. | In case there is a DemCallbackDTCStatusChangedFnc, this parameter defines the name of the function that the Dem will call. In case there is no DemCallbackDTCStatusChangedFnc, the Dem will have an R-Port requiring the interface CallbackDTCStatusChanged whose name is generated by using the unique callback-prefix followed by the event name. Status change notifications are supported for DTCs in primary memory only.
          function name DemCallbackDTCStatusChangedFnc [0..1]: scope=ECU, multiplicity set at pre-compile, set at pre-compile  # Function name of prototype "DTCStatusChanged". | Note: If the parameter DemTriggerDcmReports is enabled, this parameter shall not be "Dcm_DemTriggerOnDTCStatus".
      container DemGroupOfDTC [0..255]  # This container contains the configuration (parameters) for DTC groups.
        integer DemGroupDTCs: 256..16776959, scope=ECU, set at pre-compile, symbolic-name-value=true  # DTC values of the selected group of DTC | (Range: 3 byte, 0xFFFFFF is reserved for all DTCs, according to ISO14229-1 Annex D.1) The DTC group all DTCs is always available and will not be configured. The following ranges are reserved by ISO 14229-1 : 0x000000 to 0x0000ff and 0xffff00 to 0xffffff.
      container DemIndicator [0..255]  # This container contains the configuration (parameters) for Indicators.
        integer DemIndicatorID: 0..255, scope=ECU, set at pre-compile, symbolic-name-value=true, with-auto=true  # Unique identifier of an indicator.
      container DemMirrorMemory [0..1]  # This container contains the mirror event memory specific parameters of the Dem module.
        integer DemMaxNumberEventEntryMirror: 1..255, scope=ECU, set at pre-compile  # Maximum number of events which can be stored in the mirror memory
      container DemNvRamBlockId [0..*]  # This container contains the configuration (parameters) for a non-volatile memory block, which is used from the Dem. If no permanent storage of event memory entries is required, no block needs to be configured. | The number of blocks which are necessary depends on the implementation and configuration (e.g. number of used event memories) of the Dem module.
        integer DemRbNvRamImmediateStoragePriority [0..1]: -10000..10000, multiplicity set at pre-compile, origin=RB:AR40.14.0.0:2017-02-16, set at pre-compile, default-value=0  # If an immediate storage is triggered (e.g. via Dem_TriggerStorageToNvm()) then the blocks are stored to NvM in the order of decreasing priority. Some blocks must be configured to the highest priority (see documentation). The order between blocks which have the same priority is undefined.
        symbolic name reference DemNvRamBlockIdRef: origin=AUTOSAR_ECUC V1.0.0, set at pre-compile, destination=NvMBlockDescriptor  # This reference contains the link to a non-volatile memory block. For post build time configurations worst case scenario shall be used.
      container DemOperationCycle [1..256]  # This container holds all parameters that are relevant to configure an operation cycle.
        boolean DemOperationCycleAutomaticEnd [0..0]: scope=ECU, set at pre-compile, default-value=false  # If DemOperationCycleAutomaticEnd is configured to TRUE, Dem shall automatically end the driving cycle at either Dem_Shutdown() or Dem_Init().Currently, this parameter is not supported.
        boolean DemOperationCycleAutostart [0..0]: scope=ECU, set at pre-compile, default-value=false  # The autostart property defines if the operation cycles is automatically (re-)started during Dem_PreInit.Currently, this parameter is not supported.
        integer DemOperationCycleId: 0..18446744073709551615, set at pre-compile, symbolic-name-value=true, with-auto=true  # This parameters value is used, together with the aggregating container, to define a symbolic name of the operation cycle.
        boolean DemRbIsStartViaApiAllowed [0..1]: scope=ECU, origin=RB:AR42.4.0.0:2018-03-23, set at pre-compile, default-value=false  # DemRbIsAllowedToBeStartedDirectly | Is dependent cycle allowed to be started with Dem_SetOperationCycleState as well. (Only relevant if DemLeadingCycleRef is set)
        symbolic name reference DemLeadingCycleRef [0..1]: scope=ECU, set at pre-compile, destination=DemOperationCycle  # Defines the operation cycle, which is relevant for processing this operation cycle.
      container DemPrimaryMemory  # This container contains the primary event memory specific parameters of the Dem module.
        integer DemMaxNumberEventEntryPrimary: 1..255, scope=ECU, set at pre-compile  # Maximum number of events which can be stored in the primary memory
      container DemRatio [0..65535]  # This container contains the OBD-specific in-use-monitor performance ratio configuration. | It is related to a specific event, a FID, and an IUMPR group.
        enumeration DemIUMPRDenGroup: {DEM_IUMPR_DEN_500MILL, DEM_IUMPR_DEN_COLDSTART, DEM_IUMPR_DEN_EVAP, DEM_IUMPR_DEN_NONE, DEM_IUMPR_DEN_PHYS_API}, scope=ECU, set at pre-compile  # This parameter specifies the assigned denominator type which is applied in addition to the General Denominator conditions.
        enumeration DemIUMPRGroup: {DEM_IUMPR_BOOSTPRS, DEM_IUMPR_CAT1, DEM_IUMPR_CAT2, DEM_IUMPR_EGR, DEM_IUMPR_EGSENSOR, DEM_IUMPR_EVAP, DEM_IUMPR_FLSYS, DEM_IUMPR_NMHCCAT, DEM_IUMPR_NOXADSORB, DEM_IUMPR_NOXCAT, DEM_IUMPR_OXS1, DEM_IUMPR_OXS2, DEM_IUMPR_PMFILTER, DEM_IUMPR_PRIVATE, DEM_IUMPR_SAIR, DEM_IUMPR_SECOXS1, DEM_IUMPR_SECOXS2}, scope=ECU, set at pre-compile  # This parameter specifies the assigned IUMPR group of the ratio Id.
        integer DemRatioId: 0..65535, scope=ECU, set at pre-compile, symbolic-name-value=true, with-auto=true  # Defines a unique ratio Id. | This parameter should not be changeable by user, because the Id should be generated by Dem itself to prevent gaps and multiple use of an Id. The ratio Ids should be sequentially ordered beginning with 0 and no gaps in between.
        enumeration DemRatioKind: {DEM_RATIO_API, DEM_RATIO_OBSERVER}, scope=ECU, set at pre-compile  # This parameter defines whether the ratio will be calculated API or observer based.
        reference DemDiagnosticEventRef: scope=ECU, set at pre-compile, destination=DemEventParameter  # This reference contains the link to a diagnostic event.
        symbolic name reference DemFunctionIdRef [0..1]: scope=ECU, set at pre-compile, destination=FiMFID  # This reference contains the link to a function identifier within the FiM.
      container DemRbGDoc [0..1]: multiplicity set at pre-compile  # This container contains the configuration (parameters) of the BSW Dem
        container DemRbGDocMonitoredComponent [1..*]: multiplicity set at pre-compile  # Specify a monitored component or system.
        container DemRbGDocMonitoringStrategy [1..*]: multiplicity set at pre-compile  # Specify a monitoring strategy.
      container DemRbGeneral  # This container contains the configuration (parameters) of the BSW Dem
        enumeration DemRbAgingCounterType [0..1]: {NONE, COUNT_UP, COUNT_UP_TC, USER_DEFINED}, multiplicity set at pre-compile, origin=RB:AR40.4.0.0:2012-06-01, set at pre-compile, default-value=NONE  # [NON-AUTOSAR] This parameter defines the Type of Aging Counter. (1) Not Supported (2) Up Counter (3) Up Counter (considering TestComplete) (4) User Defined | If Aging Counter Type is either COUNT_UP or COUNT_UP_TC, only then both the data elements DEM_AGINGCTR_DOWNCNT and DEM_AGINGCTR_UPCNT will have the correct value. If the Aging Counter Type is USER_DEFINED, then the Aging counter value can be obtained from the Data-element DEM_AGINGCTR_UPCNT, but it will not be ensured that the data-element DEM_AGINGCTR_DOWNCNT gives correct value of Aging counter.
        function name DemRbAllowDisableDTCSettingCallback [0..1]: multiplicity set at pre-compile, origin=RB:AR40.7.0.0:2014-01-31, set at pre-compile  # Enter the name of a function which indicates whether disabling the DTCSetting for that particular event is allowed or not.If the function returns TRUE the event shall be ignored and if it returns FALSE the function shall be processed.
        boolean DemRbCheckApiConsistency [0..1]: multiplicity set at pre-compile, origin=RB:AR40.11.0.0:2015-12-23, set at pre-compile, default-value=false  # This parameter controls the check done for the consistency of DEM C and RTE APIs [Redundant declaration warnings are expected if the APIs are consistent]. Configured as True -> Consistency of APIs are checked Configured as False -> Consistency of APIs are not checked
        boolean DemRbClearDtcClearsAllBits [0..1]: multiplicity set at pre-compile, origin=RB:AR40.9.0.0:2014-08-20, set at pre-compile, default-value=true  # Control whether clear DTC will clear all the bits of the isobyte. If true is selected behavior is like AR4.0.*, AR4.1.*, AR4.2.1). In case of false the testfailed flag and warning indicator flag won't be cleared.
        boolean DemRbCustomizableDTCStatusByte [0..1]: multiplicity set at pre-compile, origin=RB:AR40.9.0.0:2014-08-20, set at pre-compile, default-value=false  # Activate separate calculation of a dtc statusbyte. This allows project specific extensions of the behavior of the dtc statusbyte, without influencing the "failsafe" behavior (e.g. testfailed flag of an event). Costs an additional statusbyte per event. If enabled use template file Dem_CustomStatusByte.h_tpl for projct specific implemenation.
        boolean DemRbDTCSettingBlocksReporting [0..1]: multiplicity set at pre-compile, origin=RB:AR40.9.0.0:2014-08-20, set at pre-compile, default-value=true  # Control whether DTC Setting will block the reporting of eventstatus like enableconditions (AR4.0.*, AR4.1.*, ...) or whether the DTC Setting does not block the reports allowing a system behavior (ISO14229-2013).
        boolean DemRbDebLimitRelevantForJumping [0..1]: multiplicity set at pre-compile, origin=RB:AR40.6.0.0:2013-06-01, set at pre-compile, default-value=false  # If configured to false, the debouncer jump behavior is performed on change of counter direction (as defined by Autosar). If set to true, the debouncer jump behavior is only done when the counter additionally equals the passed/failed limit.
        float DemRbDebounceTimeBasedTaskTime [0..1]: 0..0.1, multiplicity set at pre-compile, origin=RB:AR40.13.0.0:2016-07-25, set at pre-compile  # This parameter allows to configure a different cyclic task time as the base for Timebase Debounce method.If this is configured then Dem_TimeBasedDebounceMainFunction must be scheduled in appropriate cycle task. Please note: This configuration value shall be equal to the value in the Basic Software Scheduler configuration of the RTE module. [RB-Comment] The timebase for this parameter is seconds. | The AUTOSAR configuration standard is to use SI units, so this parameter is defined as float value in seconds. Dem configuration tools must convert this float value to the appropriate value format for the use in the software implementation of Dem. min: A negative value is not allowed. max: After event status was reported, processing shall be completed within 100ms in order to have the fault entry status information updated as soon as possible (e.g. for PID $01). upperMultiplicity: Exactly one TaskTime must be specified per configuration. lowerMultiplicity: Exactly one TaskTime must be specified per configuration.
        enumeration DemRbDebugData [0..1]: {OFF, ON_8BIT, ON_32BIT}, multiplicity set at pre-compile, origin=RB:AR40.4.0.0:2012-06-01, set at pre-compile, default-value=OFF  # This Parameter controls the availability of Debug data 0 and 1 in failure memory
        boolean DemRbDebugDataForTimeBasedDebouncing [0..1]: multiplicity set at pre-compile, origin=RB:AR42.9.0.0:2020-10-14, set at pre-compile, default-value=false  # With this it is possible to store the debugdata reported with the prepassed/-failed and process it after the timebaseddebouncing qualified the report. CAREFULL: this leads to additional memory consumption (DebugDataSize * 2 * countOfTimeBasedDebouncedEvents)
        boolean DemRbDebugDataBeforeInit [0..1]: multiplicity set at pre-compile, origin=RB:AR40.4.0.0:2014-03-25, set at pre-compile, default-value=true  # DemRbDebugDataBeforeInit (i.e debug data support between Preinit and Init) is supported or not
        boolean DemRbDisturbanceMemoryCallbackOnDisturbance [0..1]: multiplicity set at pre-compile, origin=RB:AR40.10.20.0:2016-10-28, set at pre-compile, default-value=false  # Enables/ Disables project specific callback at the time of disturbance for Disturbance memory
        integer DemRbDisturbanceMemorySize [0..1]: 1..15, multiplicity set at pre-compile, origin=RB:AR40.4.0.0:2012-06-01, set at pre-compile, default-value=15  # number of elements stored in the dirsturbance memory.
        boolean DemRbDisturbanceMemorySupported [0..1]: multiplicity set at pre-compile, origin=RB:AR40.4.0.0:2012-06-01, set at pre-compile, default-value=false  # Disturbance memory is supported or not
        boolean DemRbEnableDemNvmBlocksAutoConfiguration [0..1]: multiplicity set at pre-compile, origin=RB:AR42.5.0.0:2018-08-31, set at pre-compile, default-value=false  # This configuration switch defines, whether the needed Dem Blocks shall be added automatically in NVM or not. If it is enabled then the expected NvM Blocks should be configured in the NVRAM Manager and respectively referenced in Dem. In that case the block length shall be provided as C expression in NvMRbNvBlockLengthString.
        boolean DemRbEnableNvmBlockLengthChecks [0..1]: multiplicity set at pre-compile, origin=RB:AR40.9.0.0:2014-11-18, set at pre-compile, default-value=false  # This configuration switch defines, whether the static assertion check for the NVM Block length is enabled or not.
        boolean DemRbEnableReportingChronologicalOrderHooks [0..1]: multiplicity set at pre-compile, origin=RB:AR40.12.0.0:2016-05-05, set at pre-compile, default-value=false  # This switch controls the availability of hooks for implementing Project specific DTC filter and reporting.(like report DTCs in Chronological order ). The declarations are available in Dem_ChronoSort.h file. Project has to provide their implementation in template file Dem_PrjChronoSorting.c_tpl.
        boolean DemRbEraseAllNvMDataSupported [0..1]: multiplicity set at pre-compile, origin=RB:AR40.12.0.0:2016-06-29, set at pre-compile, with-auto=true, default-value=false  # PARAMETER DEPRECATED! Remove from configuration! Use the parameter "DemRbSupportEraseAllNvMData" instead
        boolean DemRbEvMemProjectExtension [0..1]: multiplicity set at pre-compile, origin=RB:AR40.10.0.0:2015-07-07, set at pre-compile, default-value=false  # Activate project specific implementation and calculation in evmem (e.g. cycle counters for environmental data). On activating the feature, the struct 'Dem_EvMemProjectExtension' is included in each EvMem location and the project specific calculations 'Dem_EvMemProjectExtension(Init|Main|UnRobust|Failed|StartOpCycle)' are triggered. The struct and the functions have to be implemented in the project based on the available templates 'Dem_PrjEvmemProjectExtension.*_tpl'. Additionally data items can be defined in the environmental data by specifying appropriate dataelement (refer to DemInternalDataElement: DEM_PRJ_SPECIFIC_DATA_ON_RETRIEVE or DEM_PRJ_SPECIFIC_DATA_ON_REPORT).
        boolean DemRbEventMemoryGenericSupported [0..1]: multiplicity set at pre-compile, origin=RB:AR40.6.0.0:2013-04-01, set at pre-compile, default-value=true  # Enables/Disables support for the generic event memory services Dem_GetDTCByOccurrenceTime and Dem_GetEventMemoryOverflow
        boolean DemRbEvtProjectExtension [0..1]: multiplicity set at pre-compile, origin=RB:AR40.10.0.0:2015-08-01, set at pre-compile, default-value=false  # Enables a project specific callback on each setEventStatus. May be used to calculate project specific status information (and e.g. store it as customer specific attributes; see DemRbDefaultEventCustAttribute).
        integer DemRbFailureDependencyRecheckLimit [0..1]: 1..65535, multiplicity set at pre-compile, origin=RB:AR40.12.0.0:2016-06-30, set at pre-compile, default-value=80  # Also known as "Recheck Causality": With failure dependency structure enabled, this parameter configures the number of events which are checked per main-cycle. The check addresses the situation, where an event is TestFailed, but not yet considered as beeing causal. This might happen for example, if an event is reported as FAILED while the storagecondition is not fulfilled or a higher priority fault is already reported and later on, the storagecondition is fulfilled again or the other failure disappears.
        function name DemRbGlobalCallbackClearEventAllowedFnc [0..1]: multiplicity set at pre-compile, origin=RB:AR40.6.0.0:2013-07-26, set at pre-compile  # This parameter specifies a global callback, which is called as a "permission gate" before deleting an event. The behavior is identical to DemCallbackClearEventAllowed which is configured within DemEventParameter. In cases when DemGlobalCallbackClearEventAllowedFnc is configured, for the events which have DemCallbackClearEventAllowedFnc configured, the configured callback per Event shall have the precidence and thus the global callback shall not be invoked. Thus, the global callback is restricted to be invoked for all the Events which does not have container DemCallbackClearEventAllowed configured with DemEventParameter.
        function name DemRbGlobalCallbackGetFaultDetectionCounter [0..1]: multiplicity set at pre-compile, origin=RB:AR40.6.0.0:2013-07-26, set at pre-compile  # This parameter specifies a global callback for getting the fault detection counter. The function returns 127 if the event is failed and -128 if it is passed . In all other cases it returns 0.
        boolean DemRbHistoryStatusSupported [0..1]: multiplicity set at pre-compile, origin=RB:AR40.8.0.0:2014-02-25, set at pre-compile, default-value=false  # AllowHistoryStatus is triggered or not
        boolean DemRbLockAllFailureInfoSupported [0..1]: multiplicity set at pre-compile, origin=RB:AR40.8.0.0:2014-03-28, set at pre-compile, default-value=false  # LockAllFailureInformation is supported or not
        enumeration DemRbMirrorMemoryDisplacmentStrategyType [0..1]: {AUTOSAR, FIFO, CUST}, multiplicity set at pre-compile, origin=RB:AR40.8.0.0:2014-03-03, set at pre-compile, default-value=AUTOSAR  # This parameter defines the type of Displacement Strategy used for the Mirror Memory (1) AUTOSAR (priority based) (2) FIFO (3) Customer
        boolean DemRbMirrorMemoryDtcStatusStored [0..1]: multiplicity set at pre-compile, origin=RB:AR40.8.0.0:2014-05-05, set at pre-compile, default-value=false  # [NON-AUTOSAR] This parameter defines that the DTC Status is additionally stored in Mirror Memory when a Mirror Memory location is written. If a DTC Status (with parameter Origin = MIRROR) is requested the stored DTC status is reported instead of the current DTC Status
        enumeration DemRbMirrorMemoryType [0..1]: {MIRROR_ON_FAILED, MIRROR_ON_CLEAR}, multiplicity set at pre-compile, origin=RB:AR40.4.0.0:2012-06-01, set at pre-compile, default-value=MIRROR_ON_CLEAR  # [NON-AUTOSAR] This parameter defines the type of Mirror Memory: (1) Store in Mirror Memory (On Failed) (2) Store in Mirror Memory (On Clear)
        integer DemRbNvMNumberOfStorageBuffer [0..1]: 1..255, multiplicity set at pre-compile, origin=RB:AR40.12.0.0:2016-03-21, set at pre-compile, default-value=2  # This parameter defines how many storagebuffer are available for copying to NVRAM. Storagebuffer are needed for all DemNvMBlocks which don't support callbacks and therefore need to store the content in a sperate buffer for data consistency. A higher number of storagebuffer means faster copying of multiple blocks but also more RAM consumption.
        enumeration DemRbOccurrenceCounterType [0..1]: {NONE, AUTOSAR}, multiplicity set at pre-compile, origin=RB:AR40.4.0.0:2012-06-01, set at pre-compile, default-value=AUTOSAR  # [NON-AUTOSAR] This parameter defines the Type of Occurrence Counter. (1) Not Supported (2) AUTOSAR
        boolean DemRbPrestoreFreezeFrameNonVolatile [0..1]: multiplicity set at pre-compile, origin=RB:AR40.9.0.0:2014-10-01, set at pre-compile, default-value=false  # [NON-AUTOSAR] If enabled, prestored freeze frame will be stored non volatile and will be still available after restarting the ECU.
        boolean DemRbProjectSpecificDebOptimization [0..1]: multiplicity set at pre-compile, origin=RB:AR42.06.1.0:2019-9-15, set at pre-compile, default-value=false  # Controls call-out point for optimising debouncing of events. If enabled (TRUE), a call-out point will be available in which the run-time optimzation logic needs to be implemented as per the template file Dem_PrjSpecificDebOptimization.h_tpl.
        boolean DemRbProjectSpecificEventStatusHandling [0..1]: multiplicity set at pre-compile, origin=RB:AR40.10.0.0:2015-06-26, set at pre-compile, default-value=false  # Controls project-specific handling of EventStatus. If enabled (TRUE), the event handling functions have to be implemented in the project based on the template file Dem_PrjEventStatus.h_tpl.
        boolean DemRbProjectSpecificWarningIndicatorHandling [0..1]: multiplicity set at pre-compile, origin=RB:AR40.10.9.0:2015-11-29, set at pre-compile, default-value=false  # Enable for project specific implementation of WIR bit handling. This parameter has to be enabled to use the IndicatorLiteforCCPS sub-module. Along with this parameter, DemEventParameter/DemRbEventClass/DemRbCustEventAtrributes has to be Configured with short name "DeActTrigger".
        boolean DemRbReadEventRelatedDataFromDifferentOsTask [0..1]: multiplicity set at pre-compile, origin=RB:AR40.13.0.0:2016-12-13, set at pre-compile, default-value=false  # Needs to be enabled if event-related data (extended data or freeze frames) is read synchronously from a task different than the one running the Dem_MainFunction() (e.g. via the Dem_GetEventExtendedDataRecord*, Dem_GetEventFreezeFrameData*, Dem_DltGetAllExtendedDataRecords or Dem_DltGetMostRecentFreezeFrameRecordData functions). The asynchronous Dcm interfaces Dem_GetNextExtendedDataRecord() and Dem_GetNextFreezeFrameData() are not affected. Enables additional synchronisation mechanisms which may incur some overhead (memory and runtime). In particular it needs to be enabled in OBD-relevant systems where the Dcm_MainFunction() runs in a different task than the Dem_MainFunction(). Non-OBD-relevant systems generally do not need to enable it unless the event-related data is accessed from outside the Dcm.
        boolean DemRbShadowEntriesVisible [0..1]: multiplicity set at pre-compile, origin=RB:AR40.8.0.0:2014-01-16, set at pre-compile, default-value=false  # This switch enables the visibility of deleted event memory entries (cleared or aged) in API services reporting extended data records and freeze frame data records to DCM.
        boolean DemRbShadowMemory [0..1]: multiplicity set at pre-compile, origin=RB:AR40.4.0.0:2012-06-01, set at pre-compile, default-value=false  # [NON-AUTOSAR] This parameter defines if the virtual deleted entries (Shadow memory) in the primary memory shall be mapped to the MIRROR Memory. This setting requires that Mirror Memory is not configured!
        enumeration DemRbStatusByteConsistencyPreference [0..1]: multiplicity set at pre-compile, origin=RB:AR40.13.0.0:2016-10-24, set at pre-compile, default-value=STATUS_BYTE_BLOCK  # Select which source to prefer if the event status bits stored in the event status byte Nvm block and the event memory Nvm block are inconsistent. Currently this only affects the TestFailed status bit. Options: STATUS_BYTE_BLOCK: Prefer the status bits restored from the status byte block. EVENT_MEMORY: Prefer the status bits restored from the event memory.
          STATUS_BYTE_BLOCK  # Prefer the status bits restored from the status byte block.
          EVENT_MEMORY  # Prefer the status bits restored from the event memory.
        boolean DemRbStorageConditionBlocksPassedReports [0..1]: multiplicity set at pre-compile, origin=RB:AR42.8.0.0:2020-03-20, set at pre-compile, default-value=false  # Control whether StorageCondition will block the storage of Passed reports. TRUE : Storage Condition blocks storage on both Passed and Failed reports. FALSE : Storage Condition blocks only storage on Failed reports and allows storage on Passed reports.
        integer DemRbStoreWaitingForMonBufferDelayTime [0..1]: 0..255, set at pre-compile, origin=RB:AR42.5.0.0:2018-09-20, default-value=255  # This Configuration is needed only if DemRbSupportFailureDependency is TRUE. This parameter defines the number of Dem main function cycles for which the storing of an event is delayed. During that time the event is kept in the event buffer and not written to the storage. If demRbStoreWaitingForMonitoringEvent is set to FALSE: If the event reports FAILED within this time then it will be moved to the Dem event memory and BFM as a FAILED event. If it reports PASSED within this time it will be discarded from buffer i.e. no storage. If demRbStoreWaitingForMonitoringEvent is set to TRUE: Even if there is no report within this time (either PASSED or FAILED) the event will be stored in the Dem event memory and BFM as a FAILED event after this time. Please refer demRbStoreWaitingForMonitoringEvent for further details. Note: If configured as 0, the event will be directly written to storage as soon as it enters the event buffer via recheck logic.[NON-AUTOSAR EXTENSION]
        boolean DemRbStoreWaitingForMonitoringEvent [0..1]: set at pre-compile, origin=RB:AR40.14.0.0:2017-06-14, default-value=false  # This configuration is needed only if DemRbSupportFailureDependency is TRUE. This switch controls whether the event in WAITING_FOR_MONITORING state to be stored as FAILED event in Event memory and BFM, even though no report until waiting time. Consider the situation, an event was affected by Storage condition (Storage filtered) or sequential fault (Parent or higher prio event is FAILED) and now it becomes causal due to storage condition removed or parent/high prio fault healed. Then the event will be in WAITING_FOR_MONITORING state i.e. it will be in the event buffer for a definite time (DemTaskTime * DemRbStoreWaitingForMonBufferDelayTime) expecting for a new report again either PASSED or FAILED. If it reports FAILED then it will be stored in Event memory and BFM. If PASSED then it will be discarded from buffer itself. If there is no report after time elapsed, then the event storage is dependant on this switch. TRUE: Event will be stored as FAILED in Event memory and BFM even though no report after time elapsed. FALSE: Event will be discarded and no storage in Event memory and BFM as there is no report after time elapsed. It is not allowed to use the DemRbStoreWaitingForMonitoringEvent (WAITING_FOR_MONITORING) with emission related events (OBD relevant)
        boolean DemRbSupportAgingCounterOnlyWhenAgingAllowed [0..1]: multiplicity set at pre-compile, origin=RB:AR42.4.0.0:2018-07-31, set at pre-compile, default-value=false  # This configuration switch defines whether Aging counter has to be supported for all DTCs or only for DTCs which have DemAgingAllowed configured as TRUE | TRUE: DTCs which have DemAgingAllowed configured as TRUE - will have an Aging counter, and for DTCs with DemAgingAllowed configured as FALSE - the corresponding aging counter will be set to a Default value 255. ; FALSE : All DTCs will have aging counters independent of the configuration value of DemAgingAllowed. ; Note : If this parameter is configured as TRUE, the Aging counter behaviour will be compliant to AUTOSAR 42.3. If this parameter is not configured or if it is configured as FALSE, then the behaviour will be not as per AUTOSAR(it will be compliant to previous versions of DEM) - If additionally DemAgingCycleCounterThreshold is not configured, the default value generated will be '1' and Aging counter will be updated independent of the configuration value of DemAgingAllowed.
        enumeration DemRbSupportDebouncerResetAfterStorageCondition [0..1]: {OFF, ACCORDING_DEBOUNCEBEHAVIOR}, multiplicity set at pre-compile, origin=RB:AR40.12.0.0:2016-01-22, set at pre-compile, default-value=OFF  # [NON-AUTOSAR] This Parameter Enables or Disables the resetting of the debouncer after storagecondition. (1) OFF : do not reset the debouncer after StorageCondition (2) ACCORDING_DEBOUNCEBEHAVIOR : resetting after StorageCondition is re-enebled based on the debounce behavior
        enumeration DemRbSupportEraseAllNvMData [0..1]: {ERASE_ALL_OFF, ERASE_ALL_WITHOUT_HASHID_CHECK, ERASE_ALL_WITH_HASHID_CHECK, PARTIAL_ERASE_ALL_WITHOUT_HASHID_CHECK, PARTIAL_ERASE_ALL_WITH_HASHID_CHECK}, multiplicity set at pre-compile, origin=RB:AR40.13.0.0:2016-08-10, set at pre-compile, default-value=ERASE_ALL_OFF  # Allows the project to erase all nvm data, e.g. in case of flashing. (Templatefile Dem_PrjEraseAllNvMDataHandling.c needs to be used, project specific callback "Dem_PrjEraseAllNvMDataHandling" to be implemented to trigger erase all.) 1.) ERASE_ALL_OFF - Erase all Nvm data functionality disabled. 2.) ERASE_ALL_WITHOUT_HASHID_CHECK - Erase all is enabled without having hash id check. 3.) ERASE_ALL_WITH_HASHID_CHECK - Erase all is enabled with hash id check, i.e result of HashId check to detect any change in Order of Events or Number of Events or Event ID or Event Shortname is provided as argument in callback. (Refer section 12.14 in Dem_BswDoc for more details) 4.) PARTIAL_ERASE_ALL_WITHOUT_HASHID_CHECK - Erase all is enabled partially without having hash id check. Hashid independent deletion happens for all Dem blocks , except few blocks -as of now, Bfm counter block 5.) PARTIAL_ERASE_ALL_WITH_HASHID_CHECK - Erase all is enabled partially with hash id check ( i.e result of HashId check to detect any change in Order of Events or Number of Events or Event ID or Event Shortname is provided as argument in callback). Hashid based deletion happens for all Dem blocks , except few blocks -as of now Bfm counter block (Refer section 12.14 in Dem_BswDoc for more details)
        boolean DemRbSupportEventCategory [0..1]: multiplicity set at pre-compile, origin=RB:AR40.4.0.0:2012-06-01, set at pre-compile, default-value=false  # This is used e.g. for prioritization of monitoring in the Failure Memory
        boolean DemRbSupportEventFDCThresholdReached [0..1]: multiplicity set at pre-compile, origin=RB:AR40.11.0.0:2015-11-07, set at pre-compile, default-value=false  # [NON-AUTOSAR] Switch to enable or disable the availability to querry whether the Event FDC value has reached FDC threshold configured or not. The querying can be done through the interface "Dem_GetEventFdcThresholdReached( )".
        boolean DemRbSupportEventMemoryEntryOnFDCThreshold [0..1]: multiplicity set at pre-compile, origin=RB:AR40.8.0.0:2014-07-07, set at pre-compile, default-value=false  # [NON-AUTOSAR] Switch to enable or disable the Robustness feature
        boolean DemRbSupportFailureDependency [0..1]: multiplicity set at pre-compile, origin=RB:AR40.4.0.0:2012-06-01, set at pre-compile, default-value=false  # This switch controls the availability of the feature failure dependency structure. The feature provides the possibility to define hierarchical failure dependencies through a graph structure that has to be defined in DIAMANT
        enumeration DemRbSupportProjectSpecificConsistencyCheck [0..1]: {CONSISTENCY_CHECK_OFF, CONSISTENCY_CHECK_ON}, multiplicity set at pre-compile, origin=RB:AR42.02:2017-06-09, set at pre-compile, default-value=CONSISTENCY_CHECK_OFF  # Enables or Disables Project Specific Consistency Checks.The Project specific function have to be implemented based on the project specific templates available in Dem_PrjSpecificConsistencyCheck*.tpl.
        boolean DemRbSupportProjectSpecificFailureMemory [0..1]: multiplicity set at pre-compile, origin=RB:AR40.12.0.0:2016-07-30, set at pre-compile, default-value=false  # Activates Project Specific Failure Memory Data handling. On activation, a new variable DemRbProjectSpecificFailureMemoryType DemRbProjectSpecificFailureMemoryData will be available in Dem_EvBuffEvent structure. The Project specific data type DemRbProjectSpecificFailureMemoryType and functions have to be implemented based on the project specific templates available in Dem_PrjSpecificFailureMemory*.tpl.
        boolean DemRbSupportQueueingUnrobustEvent [0..1]: multiplicity set at pre-compile, origin=RB:AR42.7.0.0:2019-11-06, set at pre-compile, default-value=false  # [NON-AUTOSAR] Switch to enable or disable the queueing of events reporting unrobust before the Dem has been initialized.
        boolean DemRbSupportRecoveryLimitation [0..1]: multiplicity set at pre-compile, origin=RB:AR40.4.0.0:2012-06-01, set at pre-compile, default-value=false  # The number of possible recoveries of failure words may be limited. This function switch configures the availability of a feature to configure a failure recovery limit for each node in the failure graph
        boolean DemRbSupportSuspicious [0..1]: multiplicity set at pre-compile, origin=RB:AR40.11.0.0:2015-10-19, set at pre-compile, default-value=false  # This configuration switch defines, event and component suspicious feature support is enabled or not. | true: event and component suspicious feature support is enabled false: event and component suspicious feature support is disabled
        boolean DemRbSymbolicNamesAccordingAR402 [0..1]: multiplicity set at pre-compile, origin=RB:AR40.4.0.0:2012-06-01, set at pre-compile, default-value=false  # Symbolic names are generated according to AR4.0.2 definition; the rule for symbolic names was "ModuleName"_"ElementShortname" e.g. Dem_EventXYZ as eventId. Recommendation: Do not activate this switch, to avoid any issues about naming (risk of double defined symbols). Use the later defined naming convention DemConf_DemEventParameter_ +"shortname", which is always on.
        boolean DemRbTestModeSupported [0..1]: multiplicity set at pre-compile, origin=RB:AR40.8.0.0:2014-02-14, set at pre-compile, default-value=false  # This configuration switch defines, whether Test Mode reporting is supported for events or not. If Test mode is enabled only test reporting is accepted (through Dem_SetEventStatus_TestMode, Dem_ReportErrorStatus_TestMode, DemSetEventStatusWithEnvData_TestMode, DemReportErrorStatusWithEnvData_TestMode). Normal reporting is deactivated | true: Test Mode Reporting for event is enabled; false: Test Mode Reporting for event is disabled
        boolean DemRbTriggerToStoreNvMSupported [0..1]: multiplicity set at pre-compile, origin=RB:AR40.8.0.0:2014-06-01, set at pre-compile, default-value=false  # This configuration switch defines, whether the API to trigger immediate storage to NVM (API : Dem_TriggerStorageToNvm) is available.
        boolean DemRbUserDefinedEventMemoryStorageStrategyEnabled [0..1]: multiplicity set at pre-compile, origin=RB:AR40.7.0.0:2013-12-01, set at pre-compile, default-value=false  # Enables/Disables support for a user defined storage and displacement strategy in primary and secondary event memory. This strategy replaces the AUTOSAR defined methods. When user-defined storage strategy is enabled the user needs to implement the function Dem_EvMemGetEventMemoryStorageLocation. The header file Dem.h is used to include the function prototyp
        boolean DemRbUserDefinedMirrorMemoryStorageStrategyEnabled [0..1]: multiplicity set at pre-compile, origin=RB:AR40.7.0.0:2013-12-01, set at pre-compile, default-value=false  # Enables/Disables support for a user defined function to implement storage and displacement strategy in mirror memory. If default behavior is not overwritten here, the mirror memory is using the same strategy as the primary and secondary memory. When user-defined storage strategy is enabled the user needs to implement the function Dem_EvMemGetMirrorMemoryStorageLocation. The header file Dem.h is used to include the function prototyp
        boolean DemRbDataElementLastFailedSinceLastFailedExcludingTNCIncludesFailedCycle [0..1]: multiplicity set at pre-compile, origin=RB:AR40.7.0.0:2013-12-01, set at pre-compile, default-value=true  # Enables/Disables if the counter for the internal data element class DEM_CYCLES_SINCE_LAST_FAILED_EXCLUDING_TNC includes the cycle in which the failed occurred.
        boolean DemRbClearProjectExtensionIsClearPendingNotification [0..1]: multiplicity set at pre-compile, origin=RB:AR40.7.0.0:2013-12-01, set at pre-compile, default-value=false  # This configuration switch defines, project specific callback to get the feedback from project if the clear triggered via this API is pending or not, before finish the ClearDTC action
        reference DemRbDisturbanceMemoryExtendedDataClassRef [0..1]: multiplicity set at pre-compile, origin=RB:AR40.4.0.0:2012-06-01, set at pre-compile, destination=DemExtendedDataClass  # This reference defines the link to an extended data class sampler.
        container DemRbBfm [0..1]: multiplicity set at pre-compile  # This container contains the configuration (parameters) of the BSW Dem. Delete container if BFM is not required.
        container DemRbDebounceCounterSet [0..255]: multiplicity set at pre-compile  # Defines debounce counter alternative's name
        container DemRbDefaultEventCustAttribute [0..*]: multiplicity set at pre-compile  # Definition of available Customer Specific Attributes, which may be set per Event. Handling to be done in template file Dem_EventAttribute.h_tpl.
          string DemRbCustAttributeDefaultValue: origin=TO_BE_UPDATED, set at pre-compile  # DefaultValue if this parameter is not referred in an Event
        container DemRbEventCategory [0..255]: multiplicity set at pre-compile  # Specification of the event categories known in ESP-Systems; used to categorize failure for analysis in plants. This parameter is also used as the priority of failure memory records.
          integer DemRbEventCategoryId: 1..254, origin=RB:AR40.4.0.0:2012-06-01, set at pre-compile, symbolic-name-value=true, default-value=254  # This contains unique event category id. The values "0" and "255" are reserved for internal use. In the failure memory "0" is the highest priority and "255" is the lowest one.
          integer DemRbEventCategoryPriorityId [0..1]: 1..254, multiplicity set at pre-compile, origin=RB:AR40.12.0.0:2016-04-18, set at pre-compile, symbolic-name-value=true, default-value=254  # The parameter is used to configure event category priority. Least the value higher the priority.
        container DemRbExternalProcessing [0..1]: multiplicity set at pre-compile  # This container contains the configuration (parameter) for processing the function externally.
          boolean DemRbDtcFilter [0..1]: multiplicity set at pre-compile, origin=RB:AR40.8.0.0:2014-07-24, set at pre-compile, default-value=false  # This configuration switch defines whether the DTC filter function shall be processed inside Dem_Mainfunction or it shall be processed when it is called from the external function | true: External processing is enabled false: External Processing is disabled
        container DemRbGlobalCallbackEventStatusChanged [0..255]: multiplicity set at pre-compile  # The presence of this container indicates, that the Dem has access to a "DemRbGlobalCallbackEventStatusChangedFnc" callback, which the Dem will call for every event status changed to notify other components about the change in the status of a event. Note: All callbacks configured in this container shall be called in a single function. | if DemRbGlobalCallbackEventStatusChangedFnc is configured, this parameter defines the name of the function that the Dem will call.
          function name DemRbGlobalCallbackEventStatusChangedFnc: scope=ECU, multiplicity set at pre-compile, origin=RB:AR42.7.0.0:2019-07-12, set at pre-compile  # Function name of prototype "GlobalEventStatusChanged".
        container DemRbOptimization  # This container contains the configuration (parameters) introduced for the optimization purpose.
          integer DemRbAdvanceOperationCycleEventsPerLock [0..1]: 1..65535, multiplicity set at pre-compile, origin=RB:AR42.1.0.0:2016-12-01, set at pre-compile, default-value=16  # On change of an operationcycle, all affected events are processed concerning their eventstatus. This parameter configures the number of events beeing processed at once inside a lock in DemMainCycle.
          integer DemRbClearDTCNumberOfEventsPerCycle [0..1]: 1..65535, multiplicity set at pre-compile, origin=RB:AR40.10.0.0:2015-05-06, set at pre-compile  # Configures the number of events to be processed per DemMainCycle when processing a clear command. Be aware, the time to clear an individual event is highly dependent on ecu speed, task timing, and configuration like clearEventAllowed callbacks and eventStatusChange callbacks. ->If this parameter is not configured, all events are processed in one call.
          integer DemRbDtcFilterNumberOfEventsPerCycle [0..1]: 1..65535, multiplicity set at pre-compile, origin=RB:AR40.7.0.0:2013-10-01, set at pre-compile, default-value=25  # Defines how many events are considered in processing of a DTCFilter function in the Dem task cycle. If a DTC has more events than this parameter it will be processed anyway if it is the first DTC of this Dem task cycle (so that at least one dtc will be processed per cycle).
          integer DemRbDtcFilterRetrieveNumberOfDTCsPerCycle [0..1]: 1..255, multiplicity set at pre-compile, origin=RB:AR42.4.0.0:2018-04-10, set at pre-compile, default-value=50  # This parameter defines how many DTC's are considered to search matching DTC while retrieval in processing of one GetNextFilteredDTC call. Increasing this value will increase runtime marginally as we look for more DTC’s if matching DTC’s are not present. Refer BSWDOC for further details.
          integer DemRbDtcStateManagerNumberOfDTCsPerCycle [0..1]: 1..65535, multiplicity set at pre-compile, origin=RB:AR42.3.0.0:2017-09-04, set at pre-compile, default-value=10  # Defines the namuber of DTCs to be processed in DTCStateManager function per cycle
          integer DemRbNumberOfDTCsToProcessPerLOCK [0..1]: 1..65535, multiplicity set at pre-compile, origin=RB:AR42.4.0.0:2018-06-18, set at pre-compile, default-value=1  # The number of DTCs to be allowed for processing per LOCK while Control DTC Setting Service is called. Projects should take care that LOCK might take more time in two cases, (i) when DEM_CFG_CUSTOMIZABLEDTCSTATUSBYTE is switched ON(and some project specific functionlaity is done inside the Customer Status Byte Function), (ii) When Event combination is used. -> If this parameter is not configured, by default, it takes the value 1 such that it is safe to have LOCK per DTC irrespective of Project configuration.
        container DemRbGlobalCallbackInitMForE [0..1]  # The presence of this container indicates, that the Dem has access to an "DemRbGlobalInitMonitorForEvent" callback, which the Dem will call to initialize all monitors. | In case the container has a DemRbGlobalCallbackInitMForEFnc, this parameter defines the name of the function that the Dem will call. In case there is no DemRbGlobalCallbackInitMForEFnc, the Dem will not call the GLobal Callback to notify the reset monitor reasons to the application.
          function name DemRbGlobalCallbackInitMForEFnc [0..1]: multiplicity set at pre-compile, origin=RB:AR42.X.0.0:2020-01-22, set at pre-compile  # Function name of prototype "GlobalInitMonitorForEvent".
        container DemRbDocumentation [0..1]: multiplicity set at pre-compile  # This container contains the configuration (parameters) of the BSW Dem
          container DemRbDDL_CSV [0..1]: multiplicity set at pre-compile  # Specify a DDL parameters
            boolean DemRbIncludeEventParameterInDDLExport [0..1]: scope=ECU, multiplicity set at pre-compile, set at pre-compile, default-value=true  # Configurable DDL parameters | true: Provide EventParameter value in Dem_DDL.csv file false: Not Provide EventParameter value in Dem_DDL.csv file
            boolean DemRbIncludeEventIdInDDLExport [0..1]: scope=ECU, multiplicity set at pre-compile, set at pre-compile, default-value=true  # Configurable DDL parameters | true: Provide EventId value in Dem_DDL.csv file false: Not Provide EventId value in Dem_DDL.csv file
            boolean DemRbIncludeDTCClassRefInDDLExport [0..1]: scope=ECU, multiplicity set at pre-compile, set at pre-compile, default-value=true  # Configurable DDL parameters | true: Provide DTCClassRef value in Dem_DDL.csv file false: Not Provide DTCClassRef value in Dem_DDL.csv file
            boolean DemRbIncludeDTCValueInDDLExport [0..1]: scope=ECU, multiplicity set at pre-compile, set at pre-compile, default-value=false  # Configurable DDL parameters | true: Provide DTC Value in Dem_DDL.csv file false: Not Provide DTC Value in Dem_DDL.csv file
            boolean DemRbIncludeNodeRefInDDLExport [0..1]: scope=ECU, multiplicity set at pre-compile, set at pre-compile, default-value=true  # Configurable DDL parameters | true: Provide NodeRef value in Dem_DDL.csv file false: Not Provide NodeRef value in Dem_DDL.csv file
            boolean DemRbIncludeDebounceAlgorithmClassInDDLExport [0..1]: scope=ECU, multiplicity set at pre-compile, set at pre-compile, default-value=true  # Configurable DDL parameters | true: Provide DebounceAlgorithmClass value in Dem_DDL.csv file false: Not Provide DebounceAlgorithmClass value in Dem_DDL.csv file
            boolean DemRbIncludeEventKindInDDLExport [0..1]: scope=ECU, multiplicity set at pre-compile, set at pre-compile, default-value=true  # Configurable DDL parameters | true: Provide EventKind value in Dem_DDL.csv file false: Not Provide EventKind Parameter value in Dem_DDL.csv file
            boolean DemRbIncludeFreezeFrameClassRefInDDLExport [0..1]: scope=ECU, multiplicity set at pre-compile, set at pre-compile, default-value=true  # Configurable DDL parameters | true: Provide FreezeFrameClassRef value in Dem_DDL.csv file false: Not Provide FreezeFrameClassRef value in Dem_DDL.csv file
            boolean DemRbIncludeExtendedDataClassRefInDDLExport [0..1]: scope=ECU, multiplicity set at pre-compile, set at pre-compile, default-value=true  # Configurable DDL parameters | true: Provide ExtendedDataClassRef value in Dem_DDL.csv file false: Not Provide ExtendedDataClassRef value in Dem_DDL.csv file
            boolean DemRbIncludeCallbackClearEventAllowedInDDLExport [0..1]: scope=ECU, multiplicity set at pre-compile, set at pre-compile, default-value=true  # Configurable DDL parameters | true: Provide CallbackClearEventAllowed value in Dem_DDL.csv file false: Not Provide CallbackClearEventAllowed value in Dem_DDL.csv file
            boolean DemRbIncludeCallbackEventDataChangedInDDLExport [0..1]: scope=ECU, multiplicity set at pre-compile, set at pre-compile, default-value=true  # Configurable DDL parameters | true: Provide CallbackEventDataChanged value in Dem_DDL.csv file false: Not Provide CallbackEventDataChanged value in Dem_DDL.csv file
            boolean DemRbIncludeCallbackEventStatusChangedInDDLExport [0..1]: scope=ECU, multiplicity set at pre-compile, set at pre-compile, default-value=true  # Configurable DDL parameters | true: Provide CallbackEventStatusChanged value in Dem_DDL.csv file false: Not Provide CallbackEventStatusChanged value in Dem_DDL.csv file
            boolean DemRbIncludeCallbackInitMForEInDDLExport [0..1]: scope=ECU, multiplicity set at pre-compile, set at pre-compile, default-value=true  # Configurable DDL parameters | true: Provide CallbackInitMForE value in Dem_DDL.csv file false: Not Provide CallbackInitMForE value in Dem_DDL.csv file
            boolean DemRbIncludeEvBufferTimeInDDLExport [0..1]: scope=ECU, multiplicity set at pre-compile, set at pre-compile, default-value=true  # Configurable DDL parameters | true: Provide EvBufferTime value in Dem_DDL.csv file false: Not Provide EvBufferTime value in Dem_DDL.csv file
            boolean DemRbIncludeRecoverableInDDLExport [0..1]: scope=ECU, multiplicity set at pre-compile, set at pre-compile, default-value=true  # Configurable DDL parameters | true: Provide Recoverable value in Dem_DDL.csv file false: Not Provide Recoverable value in Dem_DDL.csv file
            boolean DemRbIncludeFailureCycleThresholdInDDLExport [0..1]: scope=ECU, multiplicity set at pre-compile, set at pre-compile, default-value=true  # Configurable DDL parameters | true: Provide FailureCycleThreshold value in Dem_DDL.csv file false: Not Provide FailureCycleThreshold value in Dem_DDL.csv file
            boolean DemRbIncludeDgsDfcNameInDDLExport [0..1]: scope=ECU, multiplicity set at pre-compile, set at pre-compile, default-value=true  # Configurable DDL parameters | true: Provide DemRbDgsDfcName value in Dem_DDL.csv file false: Not Provide DemRbDgsDfcName value in Dem_DDL.csv file
            boolean DemRbIncludeShiftViewInDDLExport [0..1]: scope=ECU, multiplicity set at pre-compile, set at pre-compile, default-value=true  # Configurable DDL parameters | true: Provide DemRbShiftView value in Dem_DDL.csv file false: Not Provide DemRbShiftView value in Dem_DDL.csv file
            boolean DemRbIncludeEnableConditionsInDDLExport [0..1]: scope=ECU, multiplicity set at pre-compile, set at pre-compile, default-value=true  # Configurable DDL parameters | true: Provide EnableConditions value in Dem_DDL.csv file false: Not Provide EnableConditions value in Dem_DDL.csv file
            boolean DemRbIncludeStorageConditionsInDDLExport [0..1]: scope=ECU, multiplicity set at pre-compile, set at pre-compile, default-value=true  # Configurable DDL parameters | true: Provide StorageConditions value in Dem_DDL.csv file false: Not Provide StorageConditions value in Dem_DDL.csv file
            boolean DemRbIncludeIsReplacementEventOfStocoInDDLExport [0..1]: scope=ECU, multiplicity set at pre-compile, set at pre-compile, default-value=true  # Configurable DDL parameters | true: Provide IsReplacementEventOfStoco value in Dem_DDL.csv file false: Not Provide IsReplacementEventOfStoco value in Dem_DDL.csv file
            boolean DemRbIncludeOperationCycleInDDLExport [0..1]: scope=ECU, multiplicity set at pre-compile, set at pre-compile, default-value=true  # Configurable DDL parameters | true: Provide OperationCycle value in Dem_DDL.csv file false: Not Provide OperationCycle value in Dem_DDL.csv file
            boolean DemRbIncludeFailureCycleInDDLExport [0..1]: scope=ECU, multiplicity set at pre-compile, set at pre-compile, default-value=true  # Configurable DDL parameters | true: Provide FailureCycle value in Dem_DDL.csv file false: Not Provide FailureCycle value in Dem_DDL.csv file
            boolean DemRbIncludeAgingCycleInDDLExport [0..1]: scope=ECU, multiplicity set at pre-compile, set at pre-compile, default-value=true  # Configurable DDL parameters | true: Provide AgingCycle value in Dem_DDL.csv file false: Not Provide AgingCycle value in Dem_DDL.csv file
      container DemStorageCondition [0..255]  # This container contains the configuration (parameters) for storage conditions.
        integer DemStorageConditionId: 0..255, scope=ECU, set at pre-compile, symbolic-name-value=true, with-auto=true  # Defines a unique storage condition Id. This parameter should not be changeable by user, because the Id should be generated by Dem itself to prevent gaps and multiple use of an Id. The storage conditions should be sequentially ordered beginning with 0 and no gaps in between.
        boolean DemStorageConditionStatus: set at pre-compile  # Defines the initial status for enable or disable of storage of a diagnostic event. | The value is the initialization after power up (before this condition is reported the first time). true: storage of a diagnostic event enabled false: storage of a diagnostic event disabled
        reference DemStorageConditionReplacementEventRef [0..1]: scope=ECU, multiplicity set at pre-compile, origin=AUTOSAR_ECUC V1.0.0, set at pre-compile, destination=DemEventParameter  # Specifies the reference to an event which is stored to event memory and supports failure analysis.
      container DemStorageConditionGroup [0..255]  # This container contains the configuration (parameters) for storage condition groups.
        reference DemStorageConditionRef [1..255]: scope=ECU, multiplicity set at pre-compile, origin=AUTOSAR_ECUC V1.0.0, set at pre-compile, destination=DemStorageCondition  # References an enable condition.
      container DemUserDefinedMemory [0..1]  # This container contains the user defined event memory specific parameters of the Dem module.
        integer DemMaxNumberEventEntryUserDefined: 1..255, scope=ECU, set at pre-compile  # Maximum number of events which can be stored in the user defined memory.
        integer DemUserDefinedMemoryIdentifier: 16..255, scope=ECU, set at pre-compile  # Identifier used by external tester to identify the User defined event memory.
