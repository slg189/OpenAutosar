AUTOSAR XML (schema 4-2-2)
package /AUTOSAR_FrTp/EcucModuleDefs
  module definition FrTp [0..1]: category=VENDOR_SPECIFIC_MODULE_DEFINITION, post-build-variant-support=true, refined-module-def=FrTp, variants post-build/pre-compile  # Configuration of the FlexRay Transport Protocol module according to ISO 10681-2.
    container FrTpGeneral  # This container contains the general configuration parameters of the FlexRay Transport Protocol module.
      boolean FrTpAckRt: set at pre-compile  # Preprocessor switch for enabling the Acknowledgement and retry mechanisms. True: Acknowledge and Retry is enabled False: Acknowledge and Retry is disabled
      integer FrTpChanNum: 1..32, set at pre-compile  # Preprocessor switch for defining the number of concurrent channels the module supports. Up to 32 channels shall be definable here.
      boolean FrTpChangeParamApi: set at pre-compile  # Preprocessor switch for enabling the API to change FrTp communication parameters. True: ChangeParameter API is enabled False: ChangeParameter API is disabled.
      boolean FrTpDevErrorDetect: set at pre-compile  # Switches the Default Error Tracer (Det) detection and notification ON or OFF.  true: enabled (ON).  false: disabled (OFF).
      boolean FrTpFullDuplexEnable: set at pre-compile, default-value=false  # Preprocessor switch for enabling full duplex mechanisms for all channels. True: Full duplex is enabled False: Fullduplex is disabled (Half duplex is enabled)
      float FrTpMainFuncCycle: 0..Inf, set at pre-compile  # This parameter contains the calling period of the TPs Main Function. The parameter is specified in seconds.
      boolean FrTpRbAPILevelRetrySupport [0..1]: origin=RB:AR42.2.0.0:2019-01-28, set at pre-compile, default-value=false  # This parameter enabled Retry feature on API level - FrIf_Transmit and PduR_StartOfReception.
      integer FrTpRbMaxTxPduCnt [0..1]: 1..65535, origin=RB:AR42.2.0.0:2019-01-28, set at pre-compile  # Maximum possible value of number of uinque FrIf referred Pdus. If this value is to be updated, then source code has to be recompiled.
      enumeration FrTpRbScheduleViaJoblist [0..1]: origin=RB:AR42.8.0.0:2020-01-23, set at pre-compile  # Preprocessor switch for enabling scheduling of FrTp from FrIf Joblist. Forward JobEntry: Scheduling of FrTp will be done from FrIf Joblist. so FrTp Main Function and FrIfGDCycle should have the same value. when Flexray goes offline scheduling will be done from OS and scheduling from Joblist Resumes once Flexray comes back to Online state.This parameter needs to be enabled only when there is atleast one usecase of transmission on FrTp and all the required parmeters for the transmission path should be configured in FrTp and FrIf as FrTp considers all these parameters for its caluclation. Disable: Scheduling will be done by OS. Enable Callback: only the API FrTp_MainFunction_JobExec will be enabled and joblist won't be created in FrIf by FrTp, this will have to configured manually by the integrator.
        FRTP_SCH_FWD_JOB_ENTRY  # Forward JobEntry
        FRTP_SCH_JOBLIST_DISABLED  # Disable
        ENABLE_CALLBACK  # Enable Callback
      boolean FrTpRbTriggerTransmitSupport [0..1]: origin=RB:AR42.2.0.0:2019-01-28, set at pre-compile, default-value=false  # This enables Trigger Transmit support on FrTp level. This also uses extra buffers for data storing and transfer. Set this parameter to True even if one of the corresponding FrIf PDU's "FrIfImmediate" parameter is set to False.
      boolean FrTpRbValidationDone [0..1]: origin=RB:AR42.2.0.0:2019-01-28, set at pre-compile, with-auto=true, default-value=false  # Configuration Validation Step executed in BCT? Note: This parameter is for internal use only. Do not configure it.
      boolean FrTpTransmitCancellation: set at pre-compile, default-value=false  # Preprocessor switch for enabling Transmit Cancellation and Receive Cancellation. True: Transmit/Receive Cancellation is enabled False: Transmit/Receive Cancellation is disabled
      boolean FrTpUnknownMsgLength [0..0]: set at pre-compile  # Preprocessor switch to support data transfer with unknown message length. True: Transmission with unknown message length is enabled False: Transmission with unknown message length is disabled
      boolean FrTpVersionInfoApi: set at pre-compile  # Preprocessor switch for enabling the Version info API. True: Version Info API is enabled False: Version Info API is disabled
    container FrTpMultipleConfig  # This container contains the configuration parameters and sub containers of the AUTOSAR FrTp module.
      integer FrTpMaxConnectionCnt [0..1]: 0..18446744073709551615, multiplicity set at pre-compile, set at pre-compile  # Maximum number of TP connections. This parameter is needed only in case of post-build loadable implementation using static memory allocation.
      container FrTpConnection [1..*]: multiplicity set at pre-compile in variant pre-compile / post-build in variant post-build, post-build-variant-multiplicity=true  # This container contains the connection specific parameters to transfer N-PDUs via FlexRay TP.
        boolean FrTpBandwidthLimitation [0..0]: post-build-variant-value=true, set at pre-compile in variant pre-compile / post-build in variant post-build  # This parameter indicates whether the connection requires a bandwidth limitation or not. If FrTpBandwidthLimitation=True the sender shall send a StartFrame always on the first PDU of a PDU-Pool.
        integer FrTpLa: 0..65535, post-build-variant-value=true, set at pre-compile in variant pre-compile / post-build in variant post-build  # This parameter defines the Local Address for the respective connection. When the local instance is the sender, this is the Source Address within the TP frame. When the local instance is the receiver, this is the Target Address within the TP frame.
        boolean FrTpMultipleReceiverCon: post-build-variant-value=true, set at pre-compile in variant pre-compile / post-build in variant post-build  # This parameter defines, whether this connection is an 1:1 ('false') or an 1:n ('true') connection. If data segmentation is required this parameter is used to check whether segmentation is possible or not. If the connection is 1:n segmentation is not possible and an error will occur.
        integer FrTpRa: 0..65535, post-build-variant-value=true, set at pre-compile in variant pre-compile / post-build in variant post-build  # This parameter defines the Remote Address for the respective connection. When the local instance is the sender, this is the Target Address within the TP frame. When the local instance is the receiver, this is the Source Address within the TP frame.
        reference FrTpConCtrlRef: post-build-variant-value=true, set at pre-compile in variant pre-compile / post-build in variant post-build, destination=FrTpConnectionControl  # FrTpConnectionControlReference: This parameter defines a reference to a connection control container.
        reference FrTpRxPduPoolRef [0..1]: multiplicity set at pre-compile in variant pre-compile / post-build in variant post-build, post-build-variant-multiplicity=true, post-build-variant-value=true, set at pre-compile in variant pre-compile / post-build in variant post-build, destination=FrTpRxPduPool  # This parameter defines a reference to a RxPduPool.
        reference FrTpTxPduPoolRef [0..1]: multiplicity set at pre-compile in variant pre-compile / post-build in variant post-build, post-build-variant-multiplicity=true, post-build-variant-value=true, set at pre-compile in variant pre-compile / post-build in variant post-build, destination=FrTpTxPduPool  # Reference to [ FrTpTxPduPool ]
        container FrTpRxSdu [0..1]  # This parameter defines the Rx Service Data Unit Identifier (Sdu Id) which uniquely identifies a data transfer (inter-module communication) between FrTp and PDUR.
          integer FrTpRxSduId: set at pre-compile, symbolic-name-value=true, with-auto=true  # This unique identifier is used for change parameter request or receive cancellation from PduR to FrTp. ImplementationType: PduIdType
          reference FrTpRxSduRef: post-build-variant-value=true, set at pre-compile in variant pre-compile / post-build in variant post-build, destination=Pdu  # Reference to a PDU in the global PDU structure.
        container FrTpTxSdu [0..1]  # This parameter defines the Tx Service Data Unit Identifier (Sdu Id) which uniquely identifies a data transfer (inter-module communication) between FrTp and PDUR.
          integer FrTpTxSduId: set at pre-compile, symbolic-name-value=true, with-auto=true  # This is a unique identifier for a to be transmitted message from the PduR to the FrTp. ImplementationType: PduIdType
          reference FrTpTxSduRef: post-build-variant-value=true, set at pre-compile in variant pre-compile / post-build in variant post-build, destination=Pdu  # Reference to a PDU in the global PDU structure.
      container FrTpConnectionControl [1..*]: multiplicity set at pre-compile in variant pre-compile / post-build in variant post-build, post-build-variant-multiplicity=true  # This container contains the configuration parameters to control a FlexRay TP connection.
        enumeration FrTpAckType: post-build-variant-value=true, set at pre-compile in variant pre-compile / post-build in variant post-build  # This parameter defines the type of acknowledgement which is used for the specific channel.
          FRTP_ACK_WITH_RT  # Acknowledgement with retry
          FRTP_NO  # No acknowledgement
        integer FrTpMaxAr [0..0]: post-build-variant-value=true, set at pre-compile in variant pre-compile / post-build in variant post-build  # This parameter defines the maximum number of trying to send a frame when a TIMEOUT AR occurs.
        integer FrTpMaxAs [0..0]: post-build-variant-value=true, set at pre-compile in variant pre-compile / post-build in variant post-build  # This parameter defines the maximum number of trying to send a frame when a TIMEOUT AS occurs.
        integer FrTpMaxBufferSize [0..0]: post-build-variant-value=true, set at pre-compile in variant pre-compile / post-build in variant post-build  # Limits the maximal buffer size the FrTp can choose in order to limit the amount of Tx buffer that will be requested at the sender side in a segmented transfer.
        integer FrTpMaxFCWait: 0..255, post-build-variant-value=true, set at pre-compile in variant pre-compile / post-build in variant post-build  # This parameter defines the maximum number of FlowControl N-PDUs with FlowState "WAIT"
        integer FrTpMaxFrIf [0..0]: post-build-variant-value=true, set at pre-compile in variant pre-compile / post-build in variant post-build  # This parameter defines the maximum number of trying to send a frame when the FrIf returns an error.
        integer FrTpMaxNbrOfNPduPerCycle: 0..31, post-build-variant-value=true, set at pre-compile in variant pre-compile / post-build in variant post-build  # This parameter is part of the ISO 10681-2 protocol's FlowControl parameter "Bandwidth Control (BC)". It limits the number of N-Pdus the sender is allowed to transmit within a FlexRay cycle.
        integer FrTpMaxRn: 0..255, post-build-variant-value=true, set at pre-compile in variant pre-compile / post-build in variant post-build  # This parameter defines the maximum number of retries (if retry is configured).
        integer FrTpRbRxBfsMax [0..1]: ..65535, origin=RB:AR42.2.0.0:2019-01-28, set at pre-compile in variant pre-compile / post-build in variant post-build  # This parameter defines the maximum value of BfS that can be sent in the Flow Control during a segmented reception. If this parameter is configured to a non zero value, the Buffer Size Sent in the Flow Control frame from FrTp will be restricted to the configured value, even if complete buffer is provided by the upper layer. This parameter may be used when using a tester which will only accept a fixed value of BfS in the Flow Control frames from the ECU.
        float FrTpRbTimeBrBufferRetry: 0..0.255, origin=RB:AR42.2.0.0:2019-01-28, post-build-variant-value=true, set at pre-compile in variant pre-compile / post-build in variant post-build  # This parameter defines the time in seconds that FrTp is allowed to try to acquire a receive buffer. This value forms a part of the total time before which a FC must be transmitted by the receiver (FrTpTimeBr). Therefore, the configuration of this parameter cannot exceed the value of FrTpTimeBr.
        integer FrTpRbTxBfsMax [0..1]: ..65535, origin=RB:AR42.2.0.0:2019-01-28, set at pre-compile in variant pre-compile / post-build in variant post-build  # This parameter allows the sender to limit the Block size transmitted during a segmented transmission.If this parameter is configured to a non zero value, FrTp will send an CF_EOB frame to the tester after transmitting the configured number of bytes.FrTp will then wait for the next flow control frame to be received from the tester before transmitting the next sequence of frames. This parameter may be configured for use cases where it may be necessary for the ECU to receive a confirmation of the transmitted frames from the tester ( by the reception of an FC frame), or, for the use case where the maximum buffer that can be requested from the upper layer, at any point of time , is limited (E.g, in the case of GateWays)
        integer FrTpSCexp: 0..7, post-build-variant-value=true, set at pre-compile in variant pre-compile / post-build in variant post-build  # This parameter is part of the ISO 10681-2 protocol's FlowControl parameter "Bandwidth Control (BC)". It represents the exponent to calculate the minimum number of "Separation Cycles" the sender has to wait for the next transmission of an FrTp N-Pdu.
        float FrTpTimeBr: 0..0.255, post-build-variant-value=true, set at pre-compile in variant pre-compile / post-build in variant post-build  # This parameter defines the time in seconds the FrTp requires to transmit a corresponding FlowControl Frame. According to ISO 10681-2 this parameter is a performance requirement.
        float FrTpTimeCs: 0..65.535, post-build-variant-value=true, set at pre-compile in variant pre-compile / post-build in variant post-build  # This parameter defines the time in seconds between the sending of two CFs or between the sending of a CF and LF or between the reception of a FC and sending of the next CF.
        float FrTpTimeFrIf [0..0]: post-build-variant-value=true, set at pre-compile in variant pre-compile / post-build in variant post-build  # This parameter defines the time in seconds of waiting for the next try (if retry is activated) to send via FrIf_Transmit.
        float FrTpTimeoutAr: 0..65.535, post-build-variant-value=true, set at pre-compile in variant pre-compile / post-build in variant post-build  # This parameter states the timeout in seconds between the PDU transmit request of the Transport Layer to the FlexRay Interface and the corresponding confirmation of the FlexRay Interface on the receiver side (for FC or AF).
        float FrTpTimeoutAs: 0..65.535, post-build-variant-value=true, set at pre-compile in variant pre-compile / post-build in variant post-build  # This parameter specifies the timeout in seconds the FrIf shall confirm a transmitted Pdu to the FrTp.
        float FrTpTimeoutBr [0..0]: post-build-variant-value=true, set at pre-compile in variant pre-compile / post-build in variant post-build  # This parameter specifies the timeout in seconds between the PDU receive indication of the Transport Layer to the FlexRay Interface and the corresponding PDU transmission of the FlexRay Interface on the receiver side.
        float FrTpTimeoutBs: 0..65.535, post-build-variant-value=true, set at pre-compile in variant pre-compile / post-build in variant post-build  # This parameter defines the timeout in seconds for waiting for an FC or AF on the sender side in a 1:1 connection.
        float FrTpTimeoutCr: 0..65.535, post-build-variant-value=true, set at pre-compile in variant pre-compile / post-build in variant post-build  # This parameter defines the timeout value in seconds a receiver is waiting for a CF or a LF.
        float FrTpTimeoutCs [0..0]: post-build-variant-value=true, set at pre-compile in variant pre-compile / post-build in variant post-build  # This parameter specifies the timeout in seconds to transmit the next ConsecutiveFrame N-PDU or the last frame N-PDU after receiving the flow control frame (CTS) from the sender side.
      container FrTpRxPduPool [0..*]: multiplicity set at pre-compile in variant pre-compile / post-build in variant post-build, post-build-variant-multiplicity=true  # This container contains all Pdus that are assigned to that Pdu Pool.
        container FrTpRxPdu [1..*]: multiplicity set at pre-compile in variant pre-compile / post-build in variant post-build, post-build-variant-multiplicity=true  # Container to hold the PDU parameters. ImplementationType: PduInfoType
          integer FrTpRxPduId: 0..65535, set at pre-compile, symbolic-name-value=true, with-auto=true  # This is a unique identifier for a received message which is forwarded from the FrIf to the FrTp. ImplementationType: PduIdType
          reference FrTpRxPduRef: post-build-variant-value=true, set at pre-compile in variant pre-compile / post-build in variant post-build, destination=Pdu  # Reference to a PDU in the global PDU structure.
      container FrTpTxPduPool [0..*]: multiplicity set at pre-compile in variant pre-compile / post-build in variant post-build, post-build-variant-multiplicity=true  # This container contains all Pdus that are assigned to that Pdu Pool.
        container FrTpTxPdu [1..*]: multiplicity set at pre-compile in variant pre-compile / post-build in variant post-build, post-build-variant-multiplicity=true  # Container to hold the PDU parameters. ImplementationType: PduInfoType
          integer FrTpTxConfirmationPduId: 0..65535, set at pre-compile, symbolic-name-value=true, with-auto=true  # Handle Id to be used by the FrIf to confirm the transmission of the FrTpTxPdu to the FrIf module (FrTp_TxConfirmation) and for TriggerTransmit (FrTp_TriggerTransmit).
          reference FrTpTxPduRef: post-build-variant-value=true, set at pre-compile in variant pre-compile / post-build in variant post-build, destination=Pdu  # Reference to a PDU in the global PDU structure.
