AUTOSAR XML (schema 4-2-2)
package /AUTOSAR_Nm/EcucModuleDefs
  module definition Nm [0..1]: category=VENDOR_SPECIFIC_MODULE_DEFINITION, refined-module-def=Nm, variants pre-compile  # Network Management Interface Module | The Generic Network Management Interface module
    container NmChannelConfig [1..*]  # This container contains the configuration (parameters) of the bus channel(s). The channel parameter shall be harmonized within the whole communication stack.
      boolean NmActiveCoordinator [0..1]: multiplicity set at pre-compile, set at pre-compile  # This parameter indicates whether a NM channel - part of a Nm Coordination cluster - will be coordinated actively (NmActiveCoordinator = TRUE) or passively (NmActiveCoordinator = FALSE).
      boolean NmChannelSleepMaster: set at link in variant link-time / pre-compile in variant pre-compile  # This parameter shall be set to indicate if the sleep of this network can be absolutely decided by the local node only and that no other nodes can oppose that decision. | If this parameter is set to TRUE, the Nm shall assume that the channel is always ready to go to sleep and that no calls to Nm_RemoteSleepIndication or Nm_RemoteSleepCancellation will be made from the <BusNm> representing this channel. If this parameter is set to FALSE, the Nm shall not assume that the network is ready to sleep until a call has been made to Nm_RemoteSleepCancellation.
      boolean NmComUserDataSupport [0..1]: multiplicity set at pre-compile, set at pre-compile  # This parameter indicates whether on a NM channel user data is accessed via Com signals or by SetUserData API.
      integer NmCoordClusterIndex [0..1]: 0..255, multiplicity set at link in variant link-time / pre-compile in variant pre-compile, set at link in variant link-time / pre-compile in variant pre-compile  # If this parameter is undefined for a channel, the corresponding bus does not belong to an NM coordination cluster.
      boolean NmPassiveModeEnabled [0..1]: set at pre-compile  # This parameter indicates whether a NM channel is active,e.g. can request communication and keep the bus awake, or passive, e.g. can just be woken up and kept awake by other ECUs.
      boolean NmNodeDetectionEnabled: origin=RB:4.4.0:2018-03-30, set at pre-compile  # Pre-processor switch for enabling the Node Detection feature.
      boolean NmNodeIdEnabled: origin=RB:4.4.0:2018-03-30, set at pre-compile  # Pre-processor switch for enabling transmission of the source node identifier in NM messages.
      boolean NmRepeatMsgIndEnabled: origin=RB:4.4.0:2018-03-30, set at pre-compile  # Pre-processor switch for enabling the Repeat Message Bit Indication.
      float NmShutdownDelayTimer: 0..Inf, multiplicity set at pre-compile, set at pre-compile  # This parameter defines the time in seconds which the NM Coordination algorithm shall delay the release of this channel with.
      boolean NmStateReportEnabled: set at pre-compile  # Specifies if the NMS shall be set for the corresponding network. | false: No NMS shall be set true: The NMS shall be set
      boolean NmSynchronizingNetwork: set at link in variant link-time / pre-compile in variant pre-compile  # If this parameter is true, then this network is a synchronizing network for the NM coordination cluster which it belongs to. The network is expected to call Nm_SynchronizationPoint() at regular intervals.
      symbolic name reference NmComMChannelRef: set at link in variant link-time / pre-compile in variant pre-compile, destination=ComMChannel  # Reference to the corresponding ComM Channel.
      symbolic name reference NmStateReportSignalRef [0..1]: multiplicity set at pre-compile, set at pre-compile, destination=ComSignal  # Reference to the signal for setting the NMS by calling Com_SendSignal for the respective channel.
      choice container NmBusType  # This is a sub container of NmChannelConfig which specifies whether Bus Configuration is NmGenericBusNmConfig or NmStandardBusNmConfig.
        container NmGenericBusNmConfig [0..1]  # This is a sub container of “NmBusType” which identifies the generic <BusNm> configuration.
          string NmGenericBusNmPrefix: set at link in variant link-time / pre-compile in variant pre-compile  # The prefix which identifies the generic <BusNm>. This will be used to determine the API name to be called by Nm for the provided interfaces of the <BusNm>. This string will used for the module prefix before the "_" character in the API call name.
          float NmGenericBusNmShutdownTime: 0..Inf, set at link in variant link-time / pre-compile in variant pre-compile  # This parameter shall be used to calculate shutdown delay time.
        container NmStandardBusNmConfig [0..1]  # This is a sub container of “NmBusType” which identifies the bus configuration of the channel for standard AUTOSAR <BusNm>s.
          enumeration NmStandardBusType: {NM_BUSNM_CANNM, NM_BUSNM_FRNM, NM_BUSNM_J1939NM, NM_BUSNM_LINNM, NM_BUSNM_UDPNM}, set at link in variant link-time / pre-compile in variant pre-compile  # Identifies the bus type of the channel for standard AUTOSAR <BusNm>s and is used to determine which set of API calls to be called by Nm for the <BusNm>s. | Note: The Ethernet bus' NM is UdpNm !
    container NmGlobalConfig  # This container contains all global configuration parameters of the Nm Interface.
      container NmGlobalConfigLinNm [0..1]: multiplicity set at pre-compile  # This is a sub container of “NmGlobalConfig” which contains all global LinNm configuration parameters of the Nm Interface.
        boolean LinNmCoordinatorSyncSupport: origin=RB:1.0.0:2017-09-10, set at pre-compile, default-value=false  # Enables/disables the coordinator synchronization support.
        float LinNmMainFunctionPeriod: 0..0.255, multiplicity set at link in variant link-time / pre-compile in variant pre-compile, origin=B:1.0.0:2016-08-31, set at link in variant link-time / pre-compile in variant pre-compile  # Call cycle in seconds of LinNm_MainFunction.
        boolean LinNmPassiveModeEnabled: origin=RB:1.0.0:2016-08-31, set at pre-compile, default-value=false  # Pre-processor switch for enabling support of the Passive Mode of the LinNm.
        boolean LinNmStateChangeIndEnabled: origin=RB:1.0.0:2016-08-31, set at link in variant link-time / pre-compile in variant pre-compile  # Pre-processor switch for enabling the Network Management state change notification.
        float LinNmTimeoutTime: 0..65.535, multiplicity set at link in variant link-time / pre-compile in variant pre-compile, origin=B:1.0.0:2016-08-31, set at link in variant link-time / pre-compile in variant pre-compile  # Network Timeout after passive start-up. It denotes the time in seconds how long the NM shall stay in Network Mode in case of passive start-up before transition into Bus-Sleep Mode is initiated.
      container NmGlobalConstants  # This is a sub container of “NmGlobalConfig” which contains all the constant configuration parameters of the Nm Interface.
        integer NmNumberOfChannels: 1..255, set at pre-compile  # Number of NM channels allowed within one ECU.
        integer NmNumberOfClusters [0..1]: 0..255, origin=RB:1.0.0:2017-06-13, set at pre-compile  # Number of NM clusters allowed within one ECU.
        function name NmRemoteSleepCancelCallback [0..1]: multiplicity set at pre-compile, origin=RB:1.0.0:2016-08-31, set at pre-compile  # Upper layer callback that is called to indicate cancellation of Remote Sleep situation after BusNm receives NM messages/Votes
        function name NmRemoteSleepIndCallback [0..1]: multiplicity set at pre-compile, origin=RB:1.0.0:2016-08-31, set at pre-compile  # Upper layer callback that is called to indicate Remote Sleep situation detected by BusNm
        string NmRxCallbackHeader [0..1]: origin=RB:1.0.0:2016-08-31, set at pre-compile  # This is the header file that declares the protoype of NmRxIndicationCallback
        function name NmRxIndicationCallback [0..1]: multiplicity set at pre-compile, origin=RB:1.0.0:2016-08-31, set at pre-compile  # Application callback that is called when Nm is indicated about a reception by BusNm. This should be of type "void Callback_Name(NetworkHandleType)". If no callback is configured, NULL_PTR will be assigned
        function name NmStateChangeIndCallback [0..1]: multiplicity set at pre-compile, origin=RB:1.0.0:2016-08-31, set at pre-compile  # Upper layer callback that is called to indicate state change notifications
      container NmGlobalFeatures  # This is a sub container of “NmGlobalConfig” which contains all the features of global configuration parameters of the Nm Interface.
        boolean NmBusSynchronizationEnabled: set at pre-compile  # Pre-processor switch for enabling bus synchronization support of the <BusNm>s. This feature is required for NM Coordinator nodes only.
        function name NmCarWakeUpCallout [0..1]: multiplicity set at link in variant link-time / pre-compile in variant pre-compile, set at link in variant link-time / pre-compile in variant pre-compile  # Name of the callout function to be called if Nm_CarWakeUpIndication() is called. If this parameter is not configured, the NmIf will call BswM_CarWakeUpIndication.
        boolean NmCarWakeUpRxEnabled: set at link in variant link-time / pre-compile in variant pre-compile, default-value=false  # Enables or disables CWU detection. | FALSE - CarWakeUp not supported TRUE - CarWakeUp supported
        boolean NmComControlEnabled: set at pre-compile  # Pre-processor switch for enabling the Communication Control support.
        boolean NmComUserDataSupport: set at pre-compile, default-value=false  # Enable/Disable setting of NMUserData via SW-C. If NmComUserDataSupport is enabled the API Nm_SetUserData shall not be available.
        boolean NmCoordinatorSupportEnabled: set at pre-compile, default-value=false  # Pre-processor switch for enabling NM Coordinator support.
        boolean NmCoordinatorSyncSupport: set at link in variant link-time / pre-compile in variant pre-compile  # Enables/disables the coordinator synchronisation support.
        float NmGlobalCoordinatorTime [0..1]: 0..Inf, multiplicity set at pre-compile, set at pre-compile  # This parameter defines the maximum shutdown time of a connected and coordinated NM-Cluster. | Note:This includes nested connections.
        boolean NmNodeDetectionEnabled [0..1]: set at pre-compile, default-value=false  # Pre-processor switch for enabling the Node Detection feature.
        boolean NmNodeIdEnabled [0..1]: set at pre-compile, default-value=false  # Pre-processor switch for enabling transmission of the source node identifier in NM messages.
        boolean NmPassiveModeEnabled: set at pre-compile  # Pre-processor switch for enabling support of Passive Mode of the <BusNm>s.
        boolean NmPduRxIndicationEnabled: set at pre-compile  # Pre-processor switch for enabling the PDU Rx Indication.
        boolean NmRemoteSleepIndEnabled: set at pre-compile  # Pre-processor switch for enabling Remote Sleep Indication support. This feature is required for a Gateway or Nm Coordinator functionality.
        boolean NmRepeatMsgIndEnabled [0..1]: set at pre-compile, default-value=false  # Pre-processor switch for enabling the Repeat Message Bit Indication.
        boolean NmStateChangeIndEnabled: set at pre-compile  # Pre-processor switch for enabling the Network Management state change notification.
        boolean NmUserDataEnabled: set at pre-compile  # Pre-processor switch for enabling User Data support.
      container NmGlobalProperties  # This is a sub container of “NmGlobalConfig” which contains all the properties of global configuration parameters of the Nm Interface.
        float NmCycletimeMainFunction [0..1]: 0..Inf, multiplicity set at link in variant link-time / pre-compile in variant pre-compile, set at link in variant link-time / pre-compile in variant pre-compile  # The period between successive calls to the Main Function of the NM Interface in seconds.
        boolean NmDevErrorDetect: set at pre-compile, default-value=false  # Switches the Default Error Tracer (Det) detection and notification ON or OFF. | * true: enabled (ON). * false: disabled (OFF).
        boolean NmVersionInfoApi: set at pre-compile  # Pre-processor switch for enabling Version Info API support.
        boolean NmRbBackwardCompatible [0..0]: origin=RB:8.4.0:2020-03-18, set at pre-compile, default-value=false  # This parameter defines if the NmPassiveModeEnabled and NmComUserDataSupport should be configured in NmGlobalFeatures (AR4.2) or in NmChannelConfig(AR4.5). This parameter is used for backward compatible SW. | True - For AR4.5 feature, configure NmPassiveModeEnabled and NmComUserDataSupport in NmChannelConfig only. False - For AR4.2 feature, configure NmPassiveModeEnabled and NmComUserDataSupport in NmGlobalFeatures only.
