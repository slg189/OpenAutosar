AUTOSAR XML (schema 4-2-2)
package /AUTOSAR_WdgM/EcucModuleDefs
  module definition WdgM [0..1]: category=VENDOR_SPECIFIC_MODULE_DEFINITION, post-build-variant-support=true, refined-module-def=WdgM, variants pre-compile  # Watchdog Manager | Configuration of the WdgM (Watchdog Manager) module (with vendor specific enhancements of RB).
    container WdgMConfigSet  # Configuration set for WdgM | This container describes one of multiple configuration sets of WdgM.
      symbolic name reference WdgMInitialMode: set at pre-compile, destination=WdgMMode  # WdgM initial mode | The mode that the Watchdog Manager is in after it has been initialized.
      container WdgMDemEventParameterRefs [0..1]: multiplicity set at pre-compile, post-build-variant-multiplicity=true  # Dem Event Parameters | Container for the references to DemEventParameter elements which shall be invoked using the API Dem_ReportErrorStatus when AR42 selected or Dem_SetEventStatus when AR45 selected in case the corresponding error occurs. The EventId is taken from the referenced DemEventParameter's DemEventId value. The standardized errors are provided in the container and can be extended by vendor specific error references.
        symbolic name reference WDGM_E_SET_MODE [0..1]: multiplicity set at pre-compile, post-build-variant-multiplicity=true, post-build-variant-value=true, set at pre-compile, destination=DemEventParameter  # Mode switch failed detect | Reference to the DemEventParameter which shall be issued when the error "Watchdog drivers' mode switch has failed" has occured.
        symbolic name reference WDGM_E_SUPERVISION [0..1]: multiplicity set at pre-compile, post-build-variant-multiplicity=true, post-build-variant-value=true, set at pre-compile, destination=DemEventParameter  # Supervision failed detect | Reference to the DemEventParameter which shall be issued when the error "Supervision has failed (Global Supervision Status has reached WDGM_GLOBAL_STATUS_STOPPED) and a watchdog reset will occur" has occurred.
      container WdgMMode [1..255]: multiplicity set at pre-compile  # WdgM mode | The container describes one of several modes of the Watchdog Manager.
        integer WdgMExpiredSupervisionCycleTol: 0..65535, scope=ECU, post-build-variant-value=true, set at pre-compile  # Expired supervision cycle tolarance | This parameter shall be used to define a value that fixes the amount of expired supervision cycles for how long the blocking of watchdog triggering shall be postponed, AFTER THE GLOBAL SUPERVISION STATUS HAS REACHED THE STATE EXPIRED.
        integer WdgMModeId: 0..255, set at pre-compile, symbolic-name-value=true, with-auto=true  # Mode Identifier | This parameter fixes the identfier for the mode. This identifier is for instance passed as a parameter to the WdgM_SetMode service.This parameter should not be configured by Integrator. Value for this parameters will be filled(forwarded) by the Id Generate Script
        float WdgMSupervisionCycle: 0.., scope=ECU, set at pre-compile  # WdgM MainFunction Period | This parameter defines the schedule period of the main function WdgM_MainFunction. Unit: [s]
        container WdgMAliveSupervision [0..65535]: multiplicity set at pre-compile, post-build-variant-multiplicity=true  # Alive supervision | This container collects all configuration parameters of Alive-Supervision of one Checkpoint. Note that each Checkpoint may have different parameters. For example, it may have different min and max margin.
          integer WdgMExpectedAliveIndications: 0..65535, post-build-variant-value=true, set at pre-compile  # Expected alive indication | This parameter contains the amount of expected alive indications of the Checkpoint within the referenced amount of defined supervision cycles according to corresponding SE.
          integer WdgMMaxMargin: 0..65535, post-build-variant-value=true, set at pre-compile  # Alive indication maximum margin | This parameter contains the amount of alive indications of the Checkpoint that are acceptable to be additional to the expected alive indications within the corresponding supervision reference cycle. Range specified by Autosar: 0 - 255 It is extended to: 0 - 65535.
          integer WdgMMinMargin: 0..65535, post-build-variant-value=true, set at pre-compile  # Alive indication minimum margin | This parameter contains the amount of alive indications of the Checkpoint that are acceptable to be missed from the expected alive indications within the corresponding supervision reference cycle. Range specified by Autosar: 0 - 255 It is extended to: 0 - 65535.
          integer WdgMSupervisionReferenceCycle: 1..65535, post-build-variant-value=true, set at pre-compile  # Supervision reference cycle | This parameter shall contain the amount of supervision cycles to be used as reference by the alive-supervision mechanism to perform the checkup with counted alive indications according to corresponding SE.
          symbolic name reference WdgMAliveSupervisionCheckpointRef: post-build-variant-value=true, set at pre-compile, destination=WdgMCheckpoint  # Alive supervision checkpoint | Reference to Checkpoint within a Supervised Entity that shall be supervised.
        container WdgMDeadlineSupervision [0..65535]: multiplicity set at pre-compile, post-build-variant-multiplicity=true  # Deadline supervision | This container collects all configuration parameters for Deadline Supervision for a Supervised Entity.
          float WdgMDeadlineMax: 0.., post-build-variant-value=true, set at pre-compile  # Maximum deadline | This parameter contains the longest time span after which the deadline is considered to be met. Unit: [s]
          float WdgMDeadlineMin: 0.., post-build-variant-value=true, set at pre-compile  # Minimum deadline | This parameter contains the shortest time span after which the deadline is considered to be met. Unit: [s]
          symbolic name reference WdgMDeadlineStartRef: post-build-variant-value=true, set at pre-compile, destination=WdgMCheckpoint  # Start checkpoint | This is the reference to the start Checkpoint for Deadline Supervision.
          symbolic name reference WdgMDeadlineStopRef: post-build-variant-value=true, set at pre-compile, destination=WdgMCheckpoint  # Stop checkpoint | This is the reference to the stop Checkpoint for Deadline Supervision.
        container WdgMExternalLogicalSupervision [0..65535]: multiplicity set at pre-compile, post-build-variant-multiplicity=true  # External logical supervision | This container collects all configuration parameters for Logical Supervision for one external graph
          symbolic name reference WdgMExternalCheckpointFinalRef [1..65535]: multiplicity set at pre-compile, post-build-variant-multiplicity=true, post-build-variant-value=true, set at pre-compile, destination=WdgMCheckpoint  # Final checkpoint | This is the reference to the final Checkpoint(s) for this External Graph.
          symbolic name reference WdgMExternalCheckpointInitialRef [1..65535]: multiplicity set at pre-compile, post-build-variant-multiplicity=true, post-build-variant-value=true, set at pre-compile, destination=WdgMCheckpoint  # Initial checkpoint | This is the reference to the initial Checkpoint(s) for this External Graph.
          container WdgMExternalTransition [0..65535]: multiplicity set at pre-compile, post-build-variant-multiplicity=true  # External transition checkpoint | This container collects the Checkpoints for an External Transition across Supervised Entities.
            symbolic name reference WdgMExternalTransitionDestRef: post-build-variant-value=true, set at pre-compile, destination=WdgMCheckpoint  # Destination checkpoint | This is the reference to the destination Checkpoint of an External Transition.
            symbolic name reference WdgMExternalTransitionSourceRef: post-build-variant-value=true, set at pre-compile, destination=WdgMCheckpoint  # Source checkpoint | This is the reference to the source Checkpoint of an External Transition.
        container WdgMLocalStatusParams [0..65535]: multiplicity set at pre-compile, post-build-variant-multiplicity=true  # Local status parameter | This container collects all configuration parameters for the Local Status of a Supervised Entity.
          integer WdgMFailedAliveSupervisionRefCycleTol: 0..255, post-build-variant-value=true, set at pre-compile  # Maximum failed alive supervision | This parameter shall contain the acceptable amount of reference cycles with incorrect/failed alive supervisions for this Supervised Entity.
          symbolic name reference WdgMLocalStatusSupervisedEntityRef: post-build-variant-value=true, set at pre-compile, destination=WdgMSupervisedEntity  # Supervised entity reference | This is the reference to the Supervised Entity for which the Local Status parameters are specified.
        container WdgMTrigger [0..255]: multiplicity set at pre-compile, post-build-variant-multiplicity=true  # Hardware watchdog trigger | This container collects all configuration parameters for the triggering of hardware watchdogs.
          integer WdgMTriggerConditionValue: 1..65535, post-build-variant-value=true, set at pre-compile  # Trigger condition value | This parameter shall contain the value that is passed to WdgIf_SetTriggerCondition for this watchdog. Unit [msec]
          enumeration WdgMWatchDogMode: post-build-variant-value=true, set at pre-compile  # Watchdog mode | This parameter contains the watchdog mode that shall be used for the referenced watchdog in this Watchdog Manager mode. Implementation Type: WdgIf_ModeType
            WDGIF_FAST_MODE  # FastMode
            WDGIF_OFF_MODE  # OffMode
            WDGIF_SLOW_MODE  # SlowMode
          symbolic name reference WdgMTriggerWatchDogRef: post-build-variant-value=true, set at pre-compile, destination=WdgMWatchdog  # Watchdog reference | This parameter is a reference to the configured watchdog.
    container WdgMGeneral  # General configuration | Container defines all general configuration parameters of the Watchdog Manager.
      boolean WdgMDemStoppedSupervisionReport: set at pre-compile  # DEM supervision support | Parameter to enable/disable the error reporting to DEM. true: A notification to DEM is sent if the Watchdog Manager reaches the state WDGM_GLOBAL_STATUS_STOPPED. false: The notification is disabled.
      boolean WdgMDevErrorDetect: set at pre-compile  # Development error enable | Switches the development error detection and notification on or off. true: detection and notification is enabled. false: detection and notification is disabled.
      boolean WdgMImmediateReset: set at pre-compile  # Immediate reset enable | This parameter enables/disables the immediate reset feature in case of alive-supervision failure. true: Immediate reset is enabled false: Immediate reset is disabled. Additional information: If this parameter is set to TRUE and Global Supervision Status reaches the state WDGM_GLOBAL_STATUS_STOPPED, the Watchdog Manager module will call the MCU service Mcu_PerformReset. This parameter can be set to TRUE only if parameter McuPerformResetApi is set to TRUE (McuPerformResetApi is set to TRUE implies, service Mcu_PerformReset will be available).
      boolean WdgMOffModeEnabled: set at pre-compile  # Off mode allowed enable | This parameter enables/disables the selection of the "OffMode" of the watchdog driver. true: "OffMode" selection is allowed false: "OffMode" selection is disallowed.
      boolean WdgMRbDeadlineTimeOutDetect: origin=RB:2.0.0:2013-01-05, set at pre-compile  # Deadline Timeout detection enable | Preprocessor switch to enable/disable deadline Monitoring Timeout detection by WdgM_MainFunction, if the end checkpoint is never reached. Note: If this paremeter is set to True and if 'Os' is selected for parameter "Deadline Supervision timer interface selection" then, ensure the OsCounter referenced in all those Supervised entities containing checkpoints used in Deadline Supervision, are accessible by the Os−Application in whose context WdgM_MainFunction() is called Bugzilla reference: http://www.autosar.org/bugzilla/show_bug.cgi?id=56735 This is an Parameter.
      enumeration WdgMRbDeadlineTimerSelection [0..1]: multiplicity set at pre-compile, origin=RB:6.1.0:2015-03-24, set at pre-compile  # Deadline Supervision timer interface selection | Selection of the Base software module whose interface to be used, to access timer for Deadline supervision. This parameter is not required to be configured if Deadline supervision<WdgMDeadlineSupervision> is not configured. Mcu_Rb: Timer is accessed via vendor (BOSCH) specific Mcu Interface. Non Autosar solution. Reduces interrupt/multicore locking duration when WdgM_CheckPointReached() Api is called. For DGS it is recommended to select this option. Note: If this option is choosen , WdgM Os Counter reference <WdgMOSCounter> should not be configured in any Supervised entity<WdgMSupervisedEntity>. Os: Timer is accessed via Os interface. Autosar solution. Note: If this option is choosen, WdgM Os Counter reference <WdgMOSCounter> should be configured in each Supervised entity<WdgMSupervisedEntity> Whose checkpoint/s is/are part of Deadline supervision<WdgMDeadlineSupervision>. If this parameter is not configured then option "Os" is assumed.
        MCU_RB_TIMER  # Mcu_Rb
        AUTOSAR_OS_TIMER  # Os
      boolean WdgMRbDebugOptionEnable: set at pre-compile  # Debug Option Enable | Preprocessor switch to enable/disable the Debug option. true: Debug Option is enabled. false: Debug Option is disabled.
      boolean WdgMRbInterruptLockDisable: set at pre-compile  # Interrupt Lock disable for WdgM_MainFunction | Preprocessor switch to Enable/Disable the Interrupt Lock with WdgM MainFunction. True: In your use case WdgM_Main function cannot be preempted by WdgM_SetMode vice versa, if WdgM_SetMode is not preempted by MainFunction then keep this switch true i.e Interrupt Lock Disabled. False: Interrupt lock is required in WdgM_MainFunction since SetMode can preempt it vice versa.
      boolean WdgMRbRteDisabled [0..1]: scope=ECU, multiplicity set at pre-compile, origin=RB:2.0.0:2012-10-11, set at pre-compile  # RTE disable | Preprocessor switch to enable/disable the Mode switch indication to RTE. Shall be used to remove unneeded code segments. By default if this switch is not configured, RTE mode indication will be enabled. true: Mode switch indication is disabled false: Mode switch indication is enabled. Note: If configuration parameter "EcuCRbRteInUse" is provided in container "EcuCRbSettings" of module "EcuC" then, Mode switch Indication can be enabled only if "EcuCRbRteInUse" is set to True.
      boolean WdgMVersionInfoApi: set at pre-compile  # Version information enable | Preprocessor switch to enable/disable the existence of the API WdgM_GetVersionInfo. Shall be used to remove unneeded code segments. true: API is enabled false: API is disabled
      container WdgMRbRtePortInterfaces [0..1]: multiplicity set at pre-compile  # Rte Port Interfaces | This container contains the Queue Length parameters for port instances that are created for different operations and modes.
        integer WdgMRbCheckpointReachedQueueLength [0..1]: 1..65535, scope=ECU, multiplicity set at pre-compile, origin=RB:6.1.0:2019-07-29, set at pre-compile, default-value=1  # CheckpointReached Queue Length | This parameter shall contain the size of the queue for each port instance that is created for CheckpointReached operation. If the parameter is not configured by the integrator then default value 1 shall be assumed.
        integer WdgMRbGetFirstExpiredSEIDQueueLength [0..1]: 1..65535, scope=ECU, multiplicity set at pre-compile, origin=RB:6.1.0:2019-09-12, set at pre-compile, default-value=1  # GetFirstExpiredSEID Queue Length | This parameter shall contain the size of the queue for each port instance that is created for GetFirstExpiredSEID operation. If the parameter is not configured by the integrator then default value 1 shall be assumed.
        integer WdgMRbGetGlobalStatusQueueLength [0..1]: 1..65535, scope=ECU, multiplicity set at pre-compile, origin=RB:6.1.0:2019-09-12, set at pre-compile, default-value=1  # GetGlobalStatus Queue Length | This parameter shall contain the size of the queue for each port instance that is created for GetGlobalStatus operation. If the parameter is not configured by the integrator then default value 1 shall be assumed.
        integer WdgMRbGetLocalStatusQueueLength [0..1]: 1..65535, scope=ECU, multiplicity set at pre-compile, origin=RB:6.1.0:2019-08-27, set at pre-compile, default-value=1  # GetLocalStatus Queue Length | This parameter shall contain the size of the queue for each port instance that is created for GetLocalStatus operation. If the parameter is not configured by the integrator then default value 1 shall be assumed.
        integer WdgMRbGetModeQueueLength [0..1]: 1..65535, scope=ECU, multiplicity set at pre-compile, origin=RB:6.1.0:2019-09-12, set at pre-compile, default-value=1  # GetMode Queue Length | This parameter shall contain the size of the queue for each port instance that is created for GetMode operation. If the parameter is not configured by the integrator then default value 1 shall be assumed.
        integer WdgMRbModeSwitchPortGlobalModeQueueLength [0..1]: 1..65535, scope=ECU, multiplicity set at pre-compile, origin=RB:6.1.0:2019-09-04, set at pre-compile, default-value=1  # WdgM_GlobalMode Mode Switch Port Queue Length | This parameter shall contain the size of the queue for the globalMode port of WdgM_GlobalMode mode switch port interface. If the parameter is not configured by the integrator then default value 1 shall be assumed.
        integer WdgMRbModeSwitchPortLocalModeQueueLength [0..1]: 1..65535, scope=ECU, multiplicity set at pre-compile, origin=RB:6.1.0:2019-09-12, set at pre-compile, default-value=1  # WdgM_LocalMode Mode Switch Port Queue Length | This parameter shall contain the size of the queue for each port instance that is created under WdgM_LocalMode mode switch port interface. If the parameter is not configured by the integrator then default value 1 shall be assumed.
        integer WdgMRbPerformResetQueueLength [0..1]: 1..65535, scope=ECU, multiplicity set at pre-compile, origin=RB:6.1.0:2019-09-12, set at pre-compile, default-value=1  # PerformReset Queue Length | This parameter shall contain the size of the queue for each port instance that is created for PerformReset operation. If the parameter is not configured by the integrator then default value 1 shall be assumed.
        integer WdgMRbSetModeQueueLength [0..1]: 1..65535, scope=ECU, multiplicity set at pre-compile, origin=RB:7.0.0:2019-11-19, set at pre-compile, default-value=1  # SetMode Queue Length | This parameter shall contain the size of the queue for each port instance that is created for SetMode operation. If the parameter is not configured by the integrator then default value 1 shall be assumed.
      container WdgMSupervisedEntity [0..65535]: multiplicity set at pre-compile  # Supervised entity | This container collects all common (mode-independent) parameters of a Supervised Entity to be supervised by the Watchdog Manager.
        integer WdgMSupervisedEntityId: 0..65535, set at pre-compile, symbolic-name-value=true, with-auto=true  # Supervised entity identifier | This parameter shall contain the unique identifier of the supervised entity.This parameter should not be configured by Integrator. Value for this parameters will be filled(forwarded) by the Id Generate Script
        reference WdgMEcucPartitionRef [0..1]: multiplicity set at pre-compile, set at pre-compile, destination=EcucPartition  # Supervised entity partition reference | Denotes in which "EcucPartition" the supervised entity is executed. When the partition is stopped, the supervised entity shall be de-activated in the WdgM to avoid an ECU reset.
        symbolic name reference WdgMInternalCheckpointFinalRef [0..65535]: multiplicity set at pre-compile, set at pre-compile, destination=WdgMCheckpoint  # Final checkpoint | This is the reference to the final Checkpoint(s) for this Supervised Entity.
        symbolic name reference WdgMInternalCheckpointInitialRef [0..65535]: set at pre-compile, destination=WdgMCheckpoint  # Initial checkpoint | This is the reference to the initial Checkpoint for this Supervised Entity.
        reference WdgMOSCounter [0..1]: multiplicity set at pre-compile, set at pre-compile, destination=OsCounter  # WdgM Os Counter reference | OS counter used by Watchdog Manager to perform the deadline monitoring of the Supervised Entity. Note: 1) Do not configure this parameter If value selected for configuration parameter "Deadline Supervision timer interface selection" is "Mcu_Rb". 2) It's mandatory to configure this parameter if, value selected for configuration parameter "Deadline Supervision timer interface selection" is "Os" and "Deadline Supervision" is configured using checkpoint/s of this Supervised Entity. In the above mentioned case, also ensure the following. a) Os−Application in whose context WdgM_CheckPointReached() is called for the checkpoint/s (which is/are part of Deadline Supervision) of this Supervised entity, either owns or needs to be configured (OsCounterAccessingApplication) to access this OsCounter. b) If parameter "Deadline Timeout detection enable" is set to True then, ensure that the Os−Application in whose context WdgM_MainFunction() is called, either owns or has access to this OsCounter
        reference WdgMOsApplicationRef [0..1]: multiplicity set at pre-compile, set at pre-compile, destination=OsApplication  # OS application reference | Optional reference to an OS Application. Beware, the Watchdog Manager module will trigger a partition restart of this OS Application when the corresponding Supervised Entity reaches WDGM_LOCAL_STATUS_FAILED.
        container WdgMCheckpoint [1..65535]: multiplicity set at pre-compile  # Supervised entity checkpoint | This container collects all Checkpoints of this Supervised Entity. Each Supervised Entity has at least one Checkpoint.
          integer WdgMCheckpointId: 0..65535, set at pre-compile, symbolic-name-value=true, with-auto=true  # Checkpoint identifer | This parameter shall contain the unique identifier of Checkpoint.This parameter should not be configured by Integrator. Value for this parameters will be filled(forwarded) by the Id Generate Script
        container WdgMInternalTransition [0..65535]: multiplicity set at pre-compile  # Internal transitions container | This container defines the graph of Internal Transitions within this Supervised Entity.
          symbolic name reference WdgMInternalTransitionDestRef: set at pre-compile, destination=WdgMCheckpoint  # Destination checkpoint | This is the reference to the destination Checkpoint of a Internal Transition within this Supervised Entity.
          symbolic name reference WdgMInternalTransitionSourceRef: set at pre-compile, destination=WdgMCheckpoint  # Source checkpoint | This is the reference to the source Checkpoint of a Internal Transition within this Supervised Entity.
      container WdgMWatchdog [0..255]: multiplicity set at pre-compile  # Mode independent watchdog parameter | This container collects all common (mode-independent) parameters of a Watchdog to be triggered by the Watchdog Manager.
        string WdgMWatchdogName: set at pre-compile, symbolic-name-value=true, with-auto=true  # Watch dog name | This parameter shall contain the symbolic name of the watchdog instance.This parameter should not be configured by Integrator. Value for this parameters will be filled(forwarded) by the Id Generate Script
        symbolic name reference WdgMWatchdogDeviceRef: set at pre-compile, destination=WdgIfDevice  # Watch dog device interface reference | Reference to one device container of Watchdog Interface. In the referenced container WdgIfDevice, the parameter WdgIfDeviceIndex contains the Index parameter that WdgM has to use for WdgIf_SetTriggerCondition calls for that watchdog instance.
