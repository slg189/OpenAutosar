AUTOSAR XML (schema 4-2-2)
package /RB/RBA/rba_MemLib/EcucModuleDefs
  module definition rba_MemLib [0..1]: category=VENDOR_SPECIFIC_MODULE_DEFINITION, variants pre-compile  # Memory: Library | Configuration of the rba_MemLib component
    container rba_MemLibCentral [0..1]: multiplicity set at pre-compile  # Memory Library Central Settings | Central configuration parameters applying to the whole Mem stack
      boolean rba_MemLibCentralEnablePrototype [0..1]: multiplicity set at pre-compile, origin=RB:14.1.0:2019-09-20, set at pre-compile, default-value=false  # Memory Library Enable Prototypes | Enable or disable prototypes in the Memstack. IF THIS IS SET TO TRUE THEN THE MEM PACKAGE CAN NOT LONGER BE USED FOR SERIES PRODUCTION! Note: Yet this switch is not reliable since it is currently in introduction phase. Therefore it is mandatory to read the Mem package delivery note to avoid unintentional usage of prototypes for series production.
      boolean rba_MemLibInternalUsage [0..1]: multiplicity set at pre-compile, origin=RB:16.1.0:2020-09-12, set at pre-compile, default-value=false  # MemLib Internal usage information | (do not activate)
      boolean rba_MemLibVersionInfoApi [0..1]: multiplicity set at pre-compile, origin=RB:15.0.0:2019-10-21, set at pre-compile, default-value=false  # MemLibVersionInfoApi | Enable or disable version information
    container rba_MemLibPublished [0..1]: multiplicity set at pre-compile  # Memory Library Published Parameters | Generated configuration parameters which can be used by other Mem components
      integer rba_MemLibPublishedARMajorVersion [0..1]: multiplicity set at pre-compile, origin=RB:15.0.0:2019-11-25, set at pre-compile  # MemLib Published AR Release Major Version | Generated AR release major version info
      integer rba_MemLibPublishedARMinorVersion [0..1]: multiplicity set at pre-compile, origin=RB:15.0.0:2019-11-25, set at pre-compile  # MemLib Published AR Release Minor Version | Generated AR release minor version info
      integer rba_MemLibPublishedARRevisionVersion [0..1]: multiplicity set at pre-compile, origin=RB:15.0.0:2019-11-25, set at pre-compile  # MemLib Published AR Release Revision Version | Generated AR release revision version info
      boolean rba_MemLibPublishedEnablePrototype [0..1]: multiplicity set at pre-compile, origin=RB:15.0.0:2019-10-21, set at pre-compile, default-value=false  # MemLib Published Enable Prototype | Enable or disable prototype handling for the Memstack
      boolean rba_MemLibPublishedEnableRte [0..1]: multiplicity set at pre-compile, origin=RB:16.1.0:2020-09-12, set at pre-compile, default-value=false  # MemLib Published Enable Rte | Indication whether the Rte is considered to be enabled or not.
      boolean rba_MemLibPublishedEnableVecu [0..1]: multiplicity set at pre-compile, origin=RB:16.1.0:2020-09-12, set at pre-compile, default-value=false  # MemLib Published Enable Vecu | true=Forced unconditional enable of the Vecu-support within the Memstack (via Ecuc), false=per default not actived, but activatable via compiler switch RBA_VECU_ENABLED.
      integer rba_MemLibPublishedSwMajorVersion [0..1]: multiplicity set at pre-compile, origin=RB:15.0.0:2019-11-25, set at pre-compile  # MemLib Published Sw Major Version | Generated software major version info
      integer rba_MemLibPublishedSwMinorVersion [0..1]: multiplicity set at pre-compile, origin=RB:15.0.0:2019-11-25, set at pre-compile  # MemLib Published Sw Minor Version | Generated software minor version info
      integer rba_MemLibPublishedSwPatchVersion [0..1]: multiplicity set at pre-compile, origin=RB:15.0.0:2019-11-25, set at pre-compile  # MemLib Published Sw Patch Version | Generated software patch version info
