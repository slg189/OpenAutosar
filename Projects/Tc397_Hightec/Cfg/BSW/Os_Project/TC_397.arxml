AUTOSAR XML (schema 4-2-2)
package /Os
  module config Os
    4 x OsApplication:
      OsApplication_Core0: OsAppIsrRef=Millisecond, OsAppIsrRef=ADC0SR0_ISR, OsAppIsrRef=ADC0SR1_ISR, OsAppIsrRef=ADC1SR0_ISR, OsAppIsrRef=CCU60SR0_ISR, OsAppCounterRef=Rte_TOutCounter, OsAppAlarmRef=Rte_TimeoutAlarm1, OsAppIsrRef=STM0SR1_ISR, OsAppScheduleTableRef=Rte_ScheduleTable, OsAppIsrRef=CAN0SR0_ISR, OsAppIsrRef=CAN0SR1_ISR, OsAppIsrRef=CAN0SR2_ISR, OsAppIsrRef=CAN0SR3_ISR, OsAppIsrRef=CAN1SR0_ISR, OsAppIsrRef=CAN1SR1_ISR, OsAppIsrRef=CAN1SR2_ISR, OsAppIsrRef=CAN1SR3_ISR, OsAppIsrRef=ETHSR2_ISR, OsAppIsrRef=ETHSR6_ISR
      OsApplication_Core{1..3}
    OSDEFAULTAPPMODE (OsAppMode)
    Rte_TickCounter (OsCounter): OsSecondsPerTick=0.001, OsCounterAccessingApplication=OsApplication_Core0
    Rte_ScheduleTable (OsScheduleTable): OsSchTblAccessingApplication=OsApplication_Core0
      rte_Stimulus_1 (OsScheduleTableExpiryPoint)
        TaskActivation1 (OsScheduleTableTaskActivation): OsScheduleTableActivateTaskRef=Core0_OsTask_ASW_100ms
      OsScheduleTableSync: OsScheduleTblSyncStrategy=EXPLICIT, OsScheduleTblExplicitPrecision=1
    Millisecond (OsIsr): OsIsrCategory=CATEGORY_2, OsIsrPriority=254, OsIsrAddress=SRC_STM0SR0
    OsApplication_Core4 (OsApplication)
    OsApplication_Core5 (OsApplication)
    4 x OsIsr, all with OsIsrCategory=CATEGORY_2:
      ADC0SR0_ISR: OsIsrPriority=244, OsIsrAddress=SRC_VADCCG0SR0
      ADC0SR1_ISR: OsIsrPriority=243, OsIsrAddress=SRC_VADCCG0SR1
      ADC1SR0_ISR: OsIsrPriority=242, OsIsrAddress=SRC_VADCCG1SR0
      CCU60SR0_ISR: OsIsrPriority=238, OsIsrAddress=SRC_CCU60SR0
    Rte_TOutCounter (OsCounter): OsSecondsPerTick=0.001, OsCounterAccessingApplication=OsApplication_Core1
    OsOS
      meter_execution (Param): Value=true
      meter_elapsed_time (Param): Value=true
    STM0SR1_ISR (OsIsr): OsIsrCategory=CATEGORY_2, OsIsrPriority=253, OsIsrAddress=SRC_STM0SR1
    Core0_ECU_StartupTask (OsTask): OsTaskResourceRef=RTE_RESOURCE_OS_APP_OsApplication_Core0
    10 x OsIsr, all with OsIsrCategory=CATEGORY_2:
      CAN0SR0_ISR: OsIsrPriority=238, OsIsrAddress=SRC_CAN0INT0
      CAN0SR1_ISR: OsIsrPriority=237, OsIsrAddress=SRC_CAN0INT1
      CAN0SR2_ISR: OsIsrPriority=236, OsIsrAddress=SRC_CAN0INT2
      CAN0SR3_ISR: OsIsrPriority=235, OsIsrAddress=SRC_CAN0INT3
      CAN1SR0_ISR: OsIsrPriority=249, OsIsrAddress=SRC_CAN1INT0
      CAN1SR1_ISR: OsIsrPriority=249, OsIsrAddress=SRC_CAN1INT1
      CAN1SR2_ISR: OsIsrPriority=247, OsIsrAddress=SRC_CAN1INT2
      CAN1SR3_ISR: OsIsrPriority=246, OsIsrAddress=SRC_CAN1INT3
      ETHSR2_ISR: OsIsrPriority=241, OsIsrAddress=SRC_GETH0
      ETHSR6_ISR: OsIsrPriority=240, OsIsrAddress=SRC_GETH6
    OsRTATarget: OsRTATargetName=TriCoreHighTec, OsRTATargetVariant=TC39xB, OsRTATargetVersion=5.0.27
      SpECC (Param): Value=512,512
